## drivers/wifi/synaptics/supp_drv/Kconfig
```kconfig
config WIFI_BUILD_DEVEL
	bool "use MHD submodule for build"
	depends on WIFI_SYNA
	default n
	help
	  Compatibility alias for existing Synaptics Wi-Fi applications.
	  New configurations should enable WIFI_SYNAPTICS directly.
```

## dts/bindings/bluetooth/syna,bt-hci-uart.yaml
```yaml
# Copyright (c) 2026 Synaptics Incorporated
#
# SPDX-License-Identifier: Apache-2.0

description: |
  Synaptics SYNA Bluetooth HCI UART controller node.

  Place this node as a child of the UART bus node used for HCI transport.
  The parent UART must have a "zephyr,bt-hci-uart" child that wraps this node.

  Example in board overlay:

    &ns16550_uart0 {
      status = "okay";
      current-speed = <115200>;
      pinctrl-0 = <&uart0_tx_c &uart0_rx_c &uart0_cts &uart0_rts>;
      pinctrl-names = "default";

      bt_hci_uart: bt_hci_uart {
        compatible = "zephyr,bt-hci-uart";
        status = "okay";

        bt_hci_syna: bt-hci {
          compatible = "syna,bt-hci-uart";
          status = "okay";
          bt-reg-on-gpios = <&gpio0 25 GPIO_ACTIVE_HIGH>;
        };
      };
    };

compatible: "syna,bt-hci-uart"

include: base.yaml

properties:
  bt-reg-on-gpios:
    type: phandle-array
    description: |
      GPIO used to power the BT chip on/off (BT_REGON).
      Assert HIGH to enable the chip before sending HCI commands.
```

## dts/bindings/can/syna,can.yaml
```yaml
# Copyright 2026, Synaptics Incorporated
#
# SPDX-License-Identifier: Apache-2.0

description: Synaptics CAN/CAN FD controller

compatible: "syna,can"

include: [can-fd-controller.yaml, pinctrl-device.yaml, reset-device.yaml]

properties:
  reg:
    required: true

  interrupts:
    required: true

  clocks:
    required: true

  max-filters:
    type: int
    default: 32
    description: Maximum number of RX filters supported by this instance.

  tx-fifo-depth:
    type: int
    default: 8
    description: Number of TX descriptors used by this instance.

  rx-fifo-depth:
    type: int
    default: 8
    description: Number of RX descriptors used by this instance.

  clock-frequency:
    type: int
    required: true
    description: CAN core clock frequency in Hz.
```

## dts/bindings/clock/syna,sl-clk.yaml
```yaml
# Copyright (C) 2026 Synaptics Incorporated
# Author: Jisheng Zhang <jszhang@kernel.org>
# SPDX-License-Identifier: Apache-2.0

description: Synaptics SL family SoCs ACPU domain clk

compatible: "syna,sl-clk"

include: [clock-controller.yaml, base.yaml]

properties:
  reg:
    required: true

  clocks:
    type: phandle-array
    required: true

  "#clock-cells":
    const: 1

clock-cells:
  - clkid
```

## dts/bindings/clock/syna,sl-gateclk.yaml
```yaml
# Copyright (C) 2026 Synaptics Incorporated
# Author: Jisheng Zhang <jszhang@kernel.org>
# SPDX-License-Identifier: Apache-2.0

description: Synaptics SL family SoCs ACPU domain gate clk

compatible: "syna,sl-gateclk"

include: [clock-controller.yaml, base.yaml]

properties:
  reg:
    required: true

  "#clock-cells":
    const: 1

clock-cells:
  - clkid
```

## dts/bindings/clock/syna,sl-pll.yaml
```yaml
# Copyright (C) 2026 Synaptics Incorporated
# Author: Jisheng Zhang <jszhang@kernel.org>
# SPDX-License-Identifier: Apache-2.0

description: Synaptics SL family SoCs ACPU domain pll

compatible: "syna,sl-pll"

include: [clock-controller.yaml, base.yaml]

properties:
  reg:
    type: array
    required: true

  clocks:
    required: true

  bypass-shift:
    type: int
    required: true

  dm:
    type: int

  dn:
    type: int

  dp0:
    type: int

  dp1:
    type: int

  frac:
    type: int

  pd-bypass:
    type: boolean

  "#clock-cells":
    const: 1

clock-cells:
  - clkid
```

## dts/bindings/clock/syna,sl261x-clock.yaml
```yaml
# Copyright (c) 2026 Synaptics, Inc.
# SPDX-License-Identifier: Apache-2.0

description: Synaptics SL261x Clock Controller

compatible: "syna,sl261x-clock"

include: [clock-controller.yaml, base.yaml]

properties:
  reg:
    required: true

  "#clock-cells":
    const: 1

clock-cells:
  - clkid
```

## dts/bindings/clock/syna,srw1500-clock.yaml
```yaml
# Copyright (c) 2026 Synaptics Incorporated
# SPDX-License-Identifier: Apache-2.0

description: Synaptics srw1500 Clock Controller

compatible: "syna,srw1500-clock"

include: [clock-controller.yaml, base.yaml]

properties:
  reg:
    required: true

  reg-names:
    required: true

  clock-frequency:
    type: int
    description: Input crystal frequency in Hz.

  "#clock-cells":
    const: 1

clock-cells:
  - clkid
```

## dts/bindings/counter/arm,corstone-syscounter.yaml
```yaml
# Copyright (c) 2026 Synaptics Incorporated
# SPDX-License-Identifier: Apache-2.0

description: ARM Corstone System Counter

compatible: "arm,corstone-syscounter"

include: base.yaml

properties:
  reg:
    required: true

  clocks:
    required: true
```

## dts/bindings/counter/arm,corstone-timer.yaml
```yaml
# Copyright (c) 2026 Synaptics Incorporated
# SPDX-License-Identifier: Apache-2.0

description: ARM Corstone Timer

compatible: "arm,corstone-timer"

include: base.yaml

properties:
  reg:
    required: true

  system_counter:
    type: phandle
    required: true

  interrupts:
    required: true
```

## dts/bindings/dma/arm,dma-350.yaml
```yaml
# Copyright (c) 2025 Synaptics, Inc.
# SPDX-License-Identifier: Apache-2.0

description: ARM DMA250/350

compatible: "arm,dma-350"

include: [dma-controller.yaml, reset-device.yaml]

properties:
  reg:
    required: true

  "#dma-cells":
    const: 1

  cntxbase:
    type: int
    description: |
      Context area

  nonsecure-triggers:
    type: int
    description: |
      Security setting for each trigger/slot (1: non-secure, 0: secure/default)

  perif-channel:
    type: int
    description: |
      Number of first channel for peripheral transfers (prior channels are for
      memory-to-memory transfers, with larger FIFO and 2D capabilities)

# Parameter syntax
dma-cells:
  - channel
```

## dts/bindings/dmic/syna,sr100-dmic.yaml
```yaml
#
# Copyright 2026 Synaptics Incorporated
#
# SPDX-License-Identifier: Apache-2.0
#

description: Synaptics SR100 digital microphone frontend

compatible: "syna,sr100-dmic"

include:
  - base.yaml
  - pinctrl-device.yaml
  - reset-device.yaml

properties:
  reg:
    required: true

  reg-names:
    required: true
    const:
      - lps
      - global
      - gear1
      - lp_mem
      - ddf0

  interrupts:
    required: true
    description: LP Sense interrupt used for AMIN block-ready signaling.

  clocks:
    required: true
    description: Clock controller entry used to enable the DMIC register domain.

  resets:
    required: true
    description: Reset line for the DMIC/LP Sense register domain.

  dmas:
    type: phandle-array
    required: true
    description: DMA controller/channel used for AMIN ring to slab copies.

  dma-names:
    required: true
    description: DMA name list containing "rx".

  ddf-stride:
    type: int
    required: true
    description: Address stride between adjacent DDF channel register blocks.

  ddf-profile:
    type: array
    required: true
    description: |
      DDF register profile as offset/value pairs. Each even cell is a register
      offset from a DDF channel base, and the following cell is the value to
      write. The array must contain an even number of cells.
```

## dts/bindings/ethernet/mdio/snps,dwmac-mdio.yaml
```yaml
# Copyright (c) 2026 Synaptics Incorporated
# SPDX - License - Identifier : Apache - 2.0

description: Synopsys DWMAC MDIO Driver node

compatible: "snps,dwmac-mdio"

include:
  - name: mdio-controller.yaml
  - name: pinctrl-device.yaml

properties:
  csr-clock-index:
    type: int
    default: 1
    description: |
      MDIO csr reference clock speed
      - 0: "60_100MHZ"
      - 1: "100_150MHZ"
      - 2: "20_35MHZ"
      - 3: "35_60MHZ"
      - 4: "150_250MHZ"
      - 5: "250_300MHZ"
      - 6: "300_500MHZ"
      - 7: "500_800MHZ"
      - 8: "DIV_4"
      - 9: "DIV_6"
      - 10: "DIV_8"
      - 11: "DIV_10"
      - 12: "DIV_12"
      - 13: "DIV_14"
      - 14: "DIV_16"
      - 15: "DIV_18"
```

## dts/bindings/ethernet/syna,dwmac-sl261x.yaml
```yaml
# Copyright (c) 2026 Synaptics Incorporated
# SPDX-License-Identifier: Apache-2.0

description: |
  Synaptics SL261x Ethernet MAC, a child node of the Ethernet controller.

compatible: "syna,dwmac-sl261x"

include:
  - name: ethernet-controller.yaml
  - name: pinctrl-device.yaml

properties:
  interrupts:
    required: true
  phy-handle:
    required: true
```

## dts/bindings/ethernet/syna,sl261x-ethernet-controller.yaml
```yaml
# Copyright 2026 Synaptics Incorporated
# SPDX-License-Identifier: Apache-2.0

title: Synaptics SL261x Ethernet Controller

description: |
  Contains the Ethernet MAC and the MDIO as child nodes.

compatible: "syna,sl261x-ethernet-controller"

include: base.yaml

properties:
  reg:
    required: true
```

## dts/bindings/fc/syna,flight-control.yaml
```yaml
# Copyright (c) 2026 Synaptics Incorporated
# SPDX-License-Identifier: Apache-2.0

description: Syna Flight control

compatible: "syna,flight-control"

include: base.yaml

properties:
  reg:
    required: true
```

## dts/bindings/flash_controller/cdns,xspi.yaml
```yaml
# Copyright (c) 2025 Synaptics Incorporated
# SPDX-License-Identifier: Apache-2.0

description: Cadence XSPI flash controller

compatible: "cdns,xspi"

include: [flash-controller.yaml, pinctrl-device.yaml, reset-device.yaml]

properties:
  pinctrl-0:
    required: false

  pinctrl-names:
    required: false

  assigned-clock-rates:
    type: int
    required: false
    description: |
      The frequency of XSPI_CLK

  erase-block-size:
    type: int
    const: 4096
    description: Minimum erase size for (Q)SPI flashes is usually 4 KiB.

  write-block-size:
    type: int
    const: 1
    description: Smallest programmable unit is 1 bytes.

  size:
    type: int
    description: Flash memory size in bits.

  use-direct-mode:
    type: boolean
    description: Enable direct mode for read/write operations instead of STIG mode

  io-mode:
    type: string
    default: "single"
    enum:
      - "single"
      - "quad"
      - "octa"
    description: |
      Select the flash IO mode used by the controller.

      This property currently applies only to Macronix flashes:
        - "single": SPI mode.
        - "quad": Quad SPI mode.
        - "octa": Octal SPI mode.

  stig-chip-select:
    type: int
    default: 0
    enum:
      - 0
      - 1
    description: Chip select used by STIG and direct access command setup.

  quad-read-dummy:
    type: int
    description: Number of dummy cycles used by quad-read direct mode.

  quad-enable-command:
    type: int
    description: |
      Optional command opcode used to enable quad mode directly.
      Set to 0 to use status-register based quad enable.

  quad-enable-bit:
    type: int
    description: |
      Bit position of the quad-enable bit across status registers (0..15).
      Values 0..7 select SR1, and 8..15 select SR2 bit (value - 8).

  quad-read-sr1-command:
    type: int
    description: Status-register read command opcode for SR1.

  quad-read-sr2-command:
    type: int
    description: |
      Optional status-register read command opcode for SR2.
      Set to 0 when SR2 is not required for the selected quad-enable bit.

  quad-write-sr-command:
    type: int
    description: Status-register write command opcode used to program quad-enable bit.

  phy-dll-ctrl:
    type: int
    default: 0x01000707
    description: PHY DLL control register initialization value.

  phy-dq-timing:
    type: int
    default: 0x00000101
    description: PHY DQ timing register initialization value.

  phy-dqs-timing:
    type: int
    default: 0x00700404
    description: PHY DQS timing register initialization value.

  phy-gate-lpbk-ctrl:
    type: int
    default: 0x00200030
    description: PHY gate loopback control register initialization value.

  phy-dll-master-ctrl:
    type: int
    default: 0x0014008e
    description: PHY DLL master control register initialization value.

  phy-dll-slave-ctrl:
    type: int
    default: 0x00003322
    description: PHY DLL slave control register initialization value.
```

## dts/bindings/i2s/syna,sr100-i2s-sr100.yaml
```yaml
#
# Copyright 2026, Synaptics Incorporated
#
# SPDX-License-Identifier: Apache-2.0
#

description: Synaptics SR100 I2S controller

compatible: "syna,sr100-i2s-sr100"

include:
  - i2s-controller.yaml
  - pinctrl-device.yaml

properties:
  reg:
    required: true
    description: |
      Three register ranges are required:
      - "i2s": SR100 I2S controller registers
      - "global": SR global control registers
      - "lps": SR LPS gear1 registers

  reg-names:
    required: true
    const: ["i2s", "global", "lps"]

  interrupts:
    required: true

  clocks:
    required: true
    description: |
      Three clock IDs are expected in order:
      cfg clock, tx pclk, rx pclk.

  clock-names:
    required: true
    const: ["cfg", "tx", "rx"]

  dmas:
    required: true
    type: phandle-array

  dma-names:
    required: true
    const: ["tx", "rx"]

  resets:
    required: false
    type: phandle-array

  pinctrl-0:
    required: true

  pinctrl-names:
    required: true
```

## dts/bindings/mbox/syna,mbox-sr100.yaml
```yaml
# Copyright (C) 2026 Synaptics Incorporated. All rights reserved.
# SPDX-License-Identifier: Apache-2.0

description: Synaptics SR100 trigger / mailbox

compatible: "syna,mbox-sr100"

include: [base.yaml, mailbox-controller.yaml]

properties:
  reg:
    required: true

  shared-memory:
    required: true
    type: phandle

  shared-memory-size:
    required: true
    type: int

  interrupts:
    required: true

mbox-cells:
  - channel
```

## dts/bindings/mbox/syna,synaprot-mbox.yaml
```yaml
# Copyright (C) 2026 Synaptics Incorporated. All rights reserved.
# SPDX-License-Identifier: Apache-2.0

description: |
  Synaptics Secure Island SPROT_MBOX (H2S/S2H) polled mailbox to the secure
  co-processor. No interrupt line exists for this block; status must be
  polled. reg[0] is the mailbox register block (H2S/S2H CSR + data) for
  the selected role, reg[1] is the MCU_SYSCTRL interface-lock register
  used to arbitrate access to the mailbox between masters.

compatible: "syna,synaprot-mbox"

include: [base.yaml, mailbox-controller.yaml]

properties:
  reg:
    required: true

  reg-names:
    required: true

  syna,mailbox-role:
    type: string
    default: "ree"
    enum:
      - "ree"
      - "tee"
    description: |
      Which secure-side inbox this instance talks to. REE and TEE each have
      their own H2S/S2H register block at a fixed offset from reg[0]; this
      selects that offset. Defaults to "ree" (srw1500's normal Zephyr role).

mbox-cells:
  - channel
```

## dts/bindings/otp/syna,srw1500-otp.yaml
```yaml
# Copyright (c) 2026 Synaptics Incorporated
# SPDX-License-Identifier: Apache-2.0

description: Synaptics SRW1500 memory-mapped OTP public data window

compatible: "syna,srw1500-otp"

include: base.yaml

properties:
  reg:
    required: true

  otp-size:
    type: int
    required: true
    description: Size in bytes of the OTP data window
```

## dts/bindings/phy/syna,sl261x-usb2-phy.yaml
```yaml
# Copyright (C) 2026 Synaptics Incorporated
# Author: Jisheng Zhang <jszhang@kernel.org>
# SPDX-License-Identifier: Apache-2.0

description: |
    Syanptics SL261X USB2 PHY.

compatible: "syna,sl261x-usb2-phy"

include: [phy-controller.yaml, reset-device.yaml]

properties:
  "#phy-cells":
    const: 0

  reg:
    required: true

  resets:
    required: true
```
