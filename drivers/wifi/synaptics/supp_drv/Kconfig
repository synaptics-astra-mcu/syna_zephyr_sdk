## dts/bindings/pinctrl/syna,sl261x-pinctrl.yaml
```yaml
# Copyright (c) 2026 Synaptics Incorporated
# SPDX-License-Identifier: Apache-2.0

description: |
    Synaptics SL261x Pin controller Node
    Based on pincfg-node.yaml binding.

    Note: `bias-disable` is a default pin configuration. It will be applied in
           case no `bias-foo` property is set.

compatible: "syna,sl261x-pinctrl"

include: base.yaml

properties:
  reg:
    required: true

child-binding:
  description: |
      This binding gives a base representation of the Synaptics pins configuration

  include:
    - name: pincfg-node.yaml
      property-allowlist:
        - bias-disable
        - bias-enable
        - bias-pull-down
        - bias-pull-up
        - drive-strength
        - input-disable
        - input-enable
        - input-schmitt-disable
        - input-schmitt-enable
        - slew-rate

  properties:
    pincfg:
      type: int
      description: |
        Register offset of pin configuration (drive strength, slew-rate etc.).
    pinmux:
      required: true
      type: int
      description: |
        Pin muxing configuration. The bitfield contains the following fields:
        - ctrl [ 0.. 2]: Pinmux controller (0..2): in GBL
        - bit  [ 3.. 7]: Bit offset in register for pinmux configuration
        - mode [ 8..10]: Alternate function
        - mask [11..14]: Mask for mode/alternate function setting
        - reg  [16..23]: Register offset for pinmux configuration
        - cfg  [24..31]: Register offset for pin configuration

        To simplify the usage, macros are available to generate the "pinmux"
        field:
        - SLXXX_GBL_PINMUX(reg, bit, mode, cfg)
```

## dts/bindings/pinctrl/syna,srw1500-pinctrl.yaml
```yaml
# Copyright (c) 2026 Synaptics Incorporated
# SPDX-License-Identifier: Apache-2.0

description: |
    Synaptics srw1500 Pin controller Node
    Based on pincfg-node.yaml binding.

    Note: `bias-disable` is a default pin configuration. It is applied when
          no `bias-foo` property is set.

compatible: "syna,srw1500-pinctrl"

include: base.yaml

properties:
  reg:
    required: true

child-binding:
  description: Pin control state node

  include:
    - name: pincfg-node.yaml
      property-allowlist:
        - bias-disable
        - bias-enable
        - bias-pull-down
        - bias-pull-up
        - drive-strength
        - input-disable
        - input-enable
        - input-schmitt-disable
        - input-schmitt-enable
        - slew-rate

  properties:
    pincfg:
      type: array
      description: Register offset of pin configuration.

    pinmux:
      type: array
      description: Pin muxing configuration.

  child-binding:
    description: Pin control group node

    include:
      - name: pincfg-node.yaml
        property-allowlist:
          - bias-disable
          - bias-enable
          - bias-pull-down
          - bias-pull-up
          - drive-strength
          - input-disable
          - input-enable
          - input-schmitt-disable
          - input-schmitt-enable
          - slew-rate

    properties:
      pincfg:
        type: array
        description: Register offset of pin configuration.

      pinmux:
        required: true
        type: array
        description: Pin muxing configuration.
```

## dts/bindings/pwm/syna,tcpwm.yaml
```yaml
description: Synaptics TCPWM controller

compatible: "syna,tcpwm"

include: [pwm-controller.yaml, base.yaml, pinctrl-device.yaml, reset-device.yaml]

properties:
  reg:
    required: true

  gbl:
    type: phandle
    required: true
    description: Global register syscon used for PWM power and output routing.

  interrupts:
    required: true

  clocks:
    required: true

  resets:
    required: true

  pinctrl-0:
    required: true

  pinctrl-names:
    required: true

  clock-frequency:
    type: int
    required: true
    description: Input clock frequency of the SPWM counter, in Hz.

  capture-channel:
    type: int
    description: TCPWM group reserved for input capture.

  capture-input:
    type: int
    description: External SM_CAP input index routed by the capture pinmux.

  "#pwm-cells":
    const: 3

pwm-cells:
  - channel
  - period
  - flags
```
