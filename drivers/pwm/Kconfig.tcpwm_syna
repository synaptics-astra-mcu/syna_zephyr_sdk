## drivers/pwm/Kconfig.tcpwm_syna
```kconfig
# Copyright (c) 2026 Synaptics Incorporated
# SPDX-License-Identifier: Apache-2.0

config PWM_TCPWM_SYNA
	bool "Synaptics TCPWM driver"
	default y
	depends on DT_HAS_SYNA_TCPWM_ENABLED
	select RESET
	help
	  Enable the Synaptics TCPWM-based PWM driver.
```

## drivers/reset/Kconfig
```kconfig
# Copyright (c) 2026 Synaptics Incorporated
# SPDX-License-Identifier: Apache-2.0

if RESET

# zephyr-keep-sorted-start
rsource "Kconfig.syna_srw1500"
rsource "Kconfig.syna_sl"
rsource "Kconfig.syna_sl261x"
# zephyr-keep-sorted-stop

endif # RESET
```

## drivers/reset/Kconfig.syna_sl261x
```kconfig
# Copyright (c) 2026 Synaptics, Inc.
# SPDX-License-Identifier: Apache-2.0

config RESET_SYNA_SL261X
	bool "Synaptics SL261X reset driver"
	default y
	depends on DT_HAS_SYNA_SL261X_RESET_ENABLED
	help
	  This option enables the reset driver for Synaptics SL261X series SOC.
```

## drivers/reset/Kconfig.syna_srw1500
```kconfig
# Copyright (c) 2026 Synaptics Incorporated
# SPDX-License-Identifier: Apache-2.0

config RESET_SYNA_SRW1500
	bool "Synaptics SRW1500 reset driver"
	default y
	depends on DT_HAS_SYNA_SRW1500_RESET_ENABLED
	help
	  This option enables the reset driver for Synaptics SRW1500 series SOC.
```

## drivers/sdhc/Kconfig
```kconfig
# Copyright 2026 Synaptics, Inc.
# SPDX-License-Identifier: Apache-2.0

if SDHC

rsource "Kconfig.sdhc_mshc"

endif # SDHC
```

## drivers/sdhc/Kconfig.sdhc_mshc
```kconfig
# Copyright (c) 2025 Synaptics, Inc.
# SPDX-License-Identifier: Apache-2.0

config SDHC_MSHC
	bool "Synopsys DWC MSHC driver"
	default y
	depends on DT_HAS_SNPS_MSHC_ENABLED
	select SDHC_SUPPORTS_NATIVE_MODE
	select PINCTRL
	select EVENTS
	select REGULATOR
	help
	  Synopsys DWC Mobile Storage Host Controller for SD/SDIO/MMC.
```

## drivers/sdio_device/Kconfig
```kconfig
# Copyright (c) 2026 Synaptics Incorporated
# SPDX-License-Identifier: Apache-2.0

menu "SDIO device function drivers"

config SDIO_DEVICE
	bool
	help
	  Enable SDIO device/function controller driver support.

config SYNA_SDIO_DEVICE
	bool "Synaptics SDIO device function driver"
	default y
	depends on DT_HAS_SYNA_SDIO_DEVICE_ENABLED
	select RESET
	select SDIO_DEVICE
	help
	  Enable the Synaptics SDIO device peripheral function 2 DMA driver.

endmenu
```

## drivers/security/Kconfig
```kconfig
# Copyright (c) 2026 Synaptics Incorporated
# SPDX-License-Identifier: Apache-2.0

menu "Arm TrustZone security attribution drivers"

rsource "Kconfig.sau"
rsource "Kconfig.mpc_sie300"
rsource "Kconfig.ppc"
rsource "Kconfig.tgu"

config ARM_SECURITY_ATTRIBUTION
	bool
	default y if ARM_SAU || ARM_MPC_SIE300 || ARM_PPC || ARM_TGU_ARMV8_M

config ARM_SECURITY_INIT_PRIORITY
	int "Arm security attribution init priority"
	default 20
	depends on ARM_SECURITY_ATTRIBUTION

endmenu
```

## drivers/security/Kconfig.mpc_sie300
```kconfig
# Copyright (c) 2026 Synaptics Incorporated
# SPDX-License-Identifier: Apache-2.0

config ARM_MPC_SIE300
	bool "Arm MPC SIE-300 memory protection controller"
	depends on ARM
	help
	  Generic driver for Arm SIE-300 style MPC instances.
```

## drivers/security/Kconfig.ppc
```kconfig
# Copyright (c) 2026 Synaptics Incorporated
# SPDX-License-Identifier: Apache-2.0

config ARM_PPC
	bool "Arm TrustZone Peripheral Protection Controller"
	depends on ARM
	help
	  Generic Arm PPC driver.
```

## drivers/security/Kconfig.sau
```kconfig
# Copyright (c) 2026 Synaptics Incorporated
# SPDX-License-Identifier: Apache-2.0

config ARM_SAU
	bool "Armv8-M Security Attribution Unit init"
	depends on ARM
	help
	  Configure Cortex-M SAU regions from devicetree.
```

## drivers/security/Kconfig.tgu
```kconfig
# Copyright (c) 2026 Synaptics Incorporated
# SPDX-License-Identifier: Apache-2.0

config ARM_TGU_ARMV8_M
	bool "Armv8-M TCM Gating Unit"
	depends on ARM
	help
	  Optional TGU support for ITCM/DTCM attribution.
```

## drivers/timer/Kconfig
```kconfig
# Copyright (c) 2026 Synaptics, Inc.
# SPDX-License-Identifier: Apache-2.0

if SYS_CLOCK_EXISTS

rsource "Kconfig.arm_sse"

endif # SYS_CLOCK_EXISTS
```

## drivers/timer/Kconfig.arm_sse
```kconfig
# Copyright (c) 2026 Synaptics Incorporated
# SPDX-License-Identifier: Apache-2.0

config ARM_SSE_TIMER
	bool "ARM SSE-IP timer"
	default y
	depends on DT_HAS_ARM_SSE_TIMER_ENABLED
	select TICKLESS_CAPABLE
	select TIMER_HAS_64BIT_CYCLE_COUNTER
	help
	  This module implements a device driver for the ARM SSE-IP timer
```

## drivers/usb/Kconfig
```kconfig
# SPDX-License-Identifier: Apache-2.0

rsource "common/Kconfig"
rsource "cdc/Kconfig"
rsource "hid/Kconfig"
```

## drivers/usb/cdc/Kconfig
```kconfig
# SPDX-License-Identifier: Apache-2.0
# Module: USB CDC stack service configuration options

config USB_CDC_LAYER
	bool "USB CDC stack-owned composite service"
	depends on USBD_CDC_ACM_CLASS
	help
	  Enable the stack-owned dual CDC ACM USB device bring-up. The
	  application must source samples/subsys/usb/common/Kconfig.sample_usbd
	  to provide the SAMPLE_USBD_* descriptor options, and must not enable
	  another owner of zephyr_udc0 such as SERVICE_USB_HOST_API_ENABLED.
	  
```

## drivers/usb/common/syna/Kconfig
```kconfig
# SPDX-License-Identifier: Apache-2.0

config PHY_SYNA_SL261X_USB2
	bool "Synaptics SL261X USB PHY driver"
	default y
        depends on DT_HAS_SYNA_SL261X_USB2_PHY_ENABLED
        help
          Enable SYNA SL261X USB2 PHY driver.
```

## drivers/usb/hid/Kconfig
```kconfig
# SPDX-License-Identifier: Apache-2.0
# Module: USB HID profile configuration options

menu "USB HID Compatibility Layer"

config USB_HID_KEYBOARD
	bool "Enable keyboard HID profile in stack service"
	depends on USBD_HID_SUPPORT
	default y
	help
	  Enables keyboard report generation and submission in the
	  stack-owned HID service.

config USB_HID_MOUSE
	bool "Enable mouse HID profile in stack service"
	depends on USBD_HID_SUPPORT
	default y
	help
	  Enables mouse report generation and submission in the
	  stack-owned HID service.

config USB_HID_LAYER
	bool "USB HID compatibility adapter"
	depends on USBD_HID_SUPPORT
	help
	  Enable a Zephyr USB HID compatibility adapter intended to ease
	  migration from TinyUSB-oriented HID modules.

choice USB_HID_PROFILE_MODE
	prompt "HID compat profile selection mode"
	depends on USB_HID_LAYER
	default USB_HID_PROFILES_ALL
	help
	  Choose whether all compatibility profiles are enabled together,
	  or enabled selectively one by one.

config USB_HID_PROFILES_ALL
	bool "Enable all compat profiles"

config USB_HID_PROFILES_SELECTIVE
	bool "Select compat profiles individually"

endchoice

config USB_HID_ALS
	bool "Enable ALS profile in compat adapter"
	depends on USB_HID_LAYER
	default y if USB_HID_PROFILES_ALL
	default n
	help
	  Enables Ambient Light Sensor HID profile support in the
	  compatibility adapter.

config USB_HID_PTP
	bool "Enable PTP profile in compat adapter"
	depends on USB_HID_LAYER
	default y if USB_HID_PROFILES_ALL
	default n
	help
	  Enables Precision Touchpad HID profile support in the
	  compatibility adapter.

config USB_HID_TSP
	bool "Enable TSP profile in compat adapter"
	depends on USB_HID_LAYER
	default y if USB_HID_PROFILES_ALL
	default n
	help
	  Enables Touch Screen/Pen HID profile support in the
	  compatibility adapter.

config USB_HID_CUSTOM
	bool "Enable Custom profile in compat adapter"
	depends on USB_HID_LAYER
	default y if USB_HID_PROFILES_ALL
	default n
	help
	  Enables vendor custom HID profile support in the
	  compatibility adapter.

config USB_HID_HUMAN_PRESENCE
	bool "Enable Human Presence profile in compat adapter"
	depends on USB_HID_LAYER
	default y if USB_HID_PROFILES_ALL
	default n
	help
	  Enables Human Presence HID profile support in the
	  compatibility adapter.

config USB_HID_GENERIC_ALGO
	bool "Enable Generic Algo profile in compat adapter"
	depends on USB_HID_LAYER
	default y if USB_HID_PROFILES_ALL
	default n
	help
	  Enables Generic Algorithm HID profile support in the
	  compatibility adapter.

endmenu
```

## drivers/video/Kconfig.ov02c10
```kconfig
# Copyright (c) 2026 Synaptics Incorporated
# SPDX-License-Identifier: Apache-2.0

config VIDEO_OV02C10
	bool "OmniVision OV02C10 camera sensor"
	default y
	depends on DT_HAS_OVTI_OV02C10_ENABLED
	depends on I2C
	depends on GPIO
	depends on PINCTRL
	help
	  Enable the OV02C10 video sensor driver.
```

## drivers/watchdog/Kconfig
```kconfig
# Watchdog configuration options

# Copyright (c) 2026 Synaptics Incorporated
# SPDX-License-Identifier: Apache-2.0

if WATCHDOG

rsource "Kconfig.arm_apb"
rsource "Kconfig.syna"
rsource "Kconfig.cmsdk_syna"
rsource "Kconfig.corstone"

endif # WATCHDOG
```

## drivers/watchdog/Kconfig.cmsdk_syna
```kconfig
# ARM CMSDK (Cortex-M System Design Kit) WDOG cfg

# Copyright (c) 2026 Synaptics Incorporated
# SPDX-License-Identifier: Apache-2.0

config WDOG_CMSDK_SYNA
	bool "CMSDK Watchdog Driver for ARM family of MCUs"
	default n
	depends on DT_HAS_ARM_CMSDK_SYNA_WATCHDOG_ENABLED
	select HAS_WDT_MULTISTAGE
	select WDT_MULTISTAGE
	select FLIGHT_CONTROL
	help
	  Enable CMSDK Watchdog (WDOG_CORSTONE_SYNA) Driver for ARM
	  family of MCUs.
```

## drivers/watchdog/Kconfig.corstone
```kconfig
# ARM Corstone WDOG cfg

# Copyright (c) 2026 Synaptics Incorporated
# SPDX-License-Identifier: Apache-2.0

config WDOG_CORSTONE
	bool "Corstone Watchdog Driver for ARM family of MCUs"
	default y
	depends on DT_HAS_ARM_CORSTONE_WATCHDOG_ENABLED
	select HAS_WDT_MULTISTAGE
	select WDT_MULTISTAGE
	select FLIGHT_CONTROL
	help
	  Enable Corstone Watchdog (WDOG_CORSTONE) Driver for ARM
	  family of MCUs.
```

## drivers/wifi/synaptics/Kconfig
```kconfig
# Copyright 2026 Synaptics Incorporated
# SPDX-License-Identifier: Apache-2.0

menuconfig WIFI_SYNA
	bool "Synaptics VEROS SoC Wi-Fi support"
	select NET_L2_ETHERNET
	select NET_L2_WIFI_MGMT
	select WIFI_USE_NATIVE_NETWORKING
	help
	  Synaptics Wi-Fi & BT combos.

config SYNA_WIFI_INIT_PRIORITY
	int "Wi-Fi driver init priority"
	default SDHC_INIT_PRIORITY
	depends on WIFI_SYNA
	help
	  Wi-Fi device driver initialization priority.
	  Do not mess with it unless you know what you are doing.
	  Note that the priority needs to be lower than the net stack
	  so that it can start before the networking sub-system.

choice
    prompt "Select WiFi SoC"
    default WIFI_4612
    depends on WIFI_SYNA

config WIFI_4381
    bool "WIFI_4381"

config WIFI_43711
    bool "WIFI_43711"

config WIFI_4612
    bool "WIFI_4612"
endchoice
```

## drivers/wifi/synaptics/Kconfig.synaptics
```kconfig
#Copyright (c) 2026 Synaptics Incorporated
#SPDX-License-Identifier: Apache-2.0

menuconfig WIFI_SYNA
	bool "Synaptics Wi-Fi driver support"
	depends on WIFI
	select NET_L2_ETHERNET
	select NET_L2_WIFI_MGMT
	select WIFI_ENABLED
	select WIFI_USE_NATIVE_NETWORKING
	help
	  Enable Synaptics SoC Wi-Fi support.

config WIFI_ENABLED
	bool

if WIFI_SYNA

config SYNA_WIFI_INIT_PRIORITY
	int "Wi-Fi driver init priority"
	default SDHC_INIT_PRIORITY if SYNA_WIFI_BACKEND_NATIVE_API
	default WIFI_INIT_PRIORITY
	help
	  Wi-Fi device driver initialization priority.
	  Do not mess with it unless you know what you are doing.
	  Note that the priority needs to be lower than the net stack
	  so that it can start before the networking sub-system.

choice
	prompt "Select WiFi SoC"
	default WIFI_4612

config WIFI_4381
	bool "WIFI_4381"

config WIFI_43711
	bool "WIFI_43711"

config WIFI_4612
	bool "WIFI_4612"

config WIFI_SRW1500
	bool "WIFI_SRW1500"
endchoice

config WIFI_765X
	bool
	default y if WIFI_SRW1500

config WLAN_SECURE_BOOT
	bool "Enable secure WLAN boot"
	default y

config SYNA_WIFI_BACKEND_NATIVE_API
	bool
	default y if WIFI_4381 || WIFI_43711 || WIFI_4612

config SYNA_WIFI_BACKEND_SUPPLICANT
	bool
	default y if WIFI_SRW1500 || WIFI_765X
	select WIFI_NM_WPA_SUPPLICANT

endif

rsource "supp_drv/Kconfig"
```
