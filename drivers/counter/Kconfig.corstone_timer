## drivers/counter/Kconfig.corstone_timer
```kconfig
# Corstone Timer

# Copyright (c) 2026 Synaptics Incorporated
# SPDX-License-Identifier: Apache-2.0

config COUNTER_CORSTONE_TIMER
    bool "ARM Corstone Timer (user-space counter)"
    default y
	  depends on DT_HAS_ARM_CORSTONE_TIMER_ENABLED
    depends on COUNTER_CORSTONE_SYSCOUNTER
    help
      Enable the Corstone timer driver which uses the shared system counter
      as a timebase and provides software alarms for user-space apps.
```

## drivers/dma/Kconfig
```kconfig
# Copyright (c) 2026 Synaptics Incorporated
# SPDX-License-Identifier: Apache-2.0

if DMA

rsource "Kconfig.arm350"

endif # DMA
```

## drivers/dma/Kconfig.arm350
```kconfig
# Copyright (c) 2026 Synaptics Incorporated
# SPDX-License-Identifier: Apache-2.0

config DMA_ARM350
	bool "ARM350 DMA driver"
	default y
	depends on DT_HAS_ARM_DMA_350_ENABLED
	help
	  Enable support for the ARM350 DMA controller.
```

## drivers/dmic/Kconfig
```kconfig
#
# Copyright 2026 Synaptics Incorporated
#
# SPDX-License-Identifier: Apache-2.0
#

config AUDIO_DMIC_SYNA_SR100
	bool "Synaptics SR100/SR110 DMIC driver"
	default y
	depends on DT_HAS_SYNA_SR100_DMIC_ENABLED && CLOCK_CONTROL
	depends on AUDIO_DMIC
	select DMA
	select PINCTRL
	select RESET
	help
	  Enable support for the Synaptics SR100/SR110 digital microphone
	  controller. The driver captures PCM samples through the LP Sense AMIN
	  ring and transfers completed blocks to applications using DMA. It
	  implements the standard Zephyr digital microphone API.
```

## drivers/entropy/Kconfig
```kconfig
# Copyright (c) 2026 Synaptics Incorporated
# SPDX-License-Identifier: Apache-2.0

if ENTROPY_GENERATOR

rsource "Kconfig.syna_bcm"

endif
```

## drivers/entropy/Kconfig.dwc_trng
```kconfig
# Copyright (c) 2026 Synaptics Incorporated
# SPDX-License-Identifier: Apache-2.0

config ENTROPY_DWC_TRNG
	bool "Synopsys DesignWare TRNG"
	default y
	depends on DT_HAS_SNPS_DWC_TRNG_ENABLED
	select ENTROPY_HAS_DRIVER
	help
	  Enable support for the Synopsys DesignWare TRNG.
```

## drivers/entropy/Kconfig.syna_bcm
```kconfig
# Copyright (c) 2026 Synaptics Incorporated
# SPDX-License-Identifier: Apache-2.0

config ENTROPY_SYNA_BCM
	bool "Synaptics BCM TRNG driver"
	default y
	depends on DT_HAS_SYNA_BCM_TRNG_ENABLED
	select ENTROPY_HAS_DRIVER
	help
	  This option enables the true random number generator
	  driver based on the Synaptics BCM-TRNG.
```

## drivers/ethernet/Kconfig
```kconfig
# Ethernet drivers configuration options

# Copyright (c) 2015 Intel Corporation
# SPDX-License-Identifier: Apache-2.0

if ETH_DRIVER

rsource "Kconfig.dwmac_syna_sl261x"

endif # "Ethernet Drivers"
```

## drivers/ethernet/Kconfig.dwmac_syna_sl261x
```kconfig
# Synopsys DesignWare MAC configuration options

# Copyright (c) 2021 BayLibre SAS
# SPDX-License-Identifier: Apache-2.0

menu "Synopsys DesignWare MAC driver"

config ETH_DWMAC_SYNA_SL261X
	bool "Synopsys DesignWare MAC driver for Synaptics SL261x series"
	depends on DT_HAS_SYNA_DWMAC_SL261X_ENABLED
	select ETH_DWMAC
	select NOCACHE_MEMORY if ARCH_HAS_NOCACHE_MEMORY_SUPPORT
	select PINCTRL
	select HWINFO
	select CRC
	default y
	help
	  This enables the Synopsys DesignWare MAC driver on Synaptics SL261x
	  series SoCs.

endmenu
```

## drivers/fc/Kconfig
```kconfig
# Copyright (c) 2026 Synaptics Incorporated
# SPDX-License-Identifier: Apache-2.0

menuconfig FLIGHT_CONTROL
	bool "Flight control driver"
	depends on DT_HAS_SYNA_FLIGHT_CONTROL_ENABLED
	help
	  Include support for flight control block.
```

## drivers/flash/Kconfig
```kconfig
# Copyright (c) 2025 Synaptics Incorporated
# SPDX-License-Identifier: Apache-2.0

#
# Flash driver
#

if FLASH

rsource "Kconfig.cadence_xspi"

endif # FLASH
```

## drivers/flash/Kconfig.cadence_xspi
```kconfig
# Copyright (c) 2025 Synaptics Incorporated
# SPDX-License-Identifier: Apache-2.0

config FLASH_CAD_XSPI
	bool "Cadence Quad XPI Flash driver"
	default y
	depends on DT_HAS_CDNS_XSPI_ENABLED
	select FLASH_HAS_PAGE_LAYOUT
	select FLASH_HAS_DRIVER_ENABLED
	select FLASH_HAS_EXPLICIT_ERASE
	select FLASH_JESD216
	select PINCTRL
	help
	  Enable Cadence XSPI support.

if FLASH_CAD_XSPI

menu "Cadence xSPI read-while-write"

config CDNS_XSPI_RWW
	bool "Enable Cadence xSPI program/erase suspend time slicing"
	default y
	help
	  Enables RWW time slicing using program/erase suspend and resume
	  commands (B0h/4Fh suspend and 30h/CFh resume in OPI). The driver
	  periodically suspends a program/erase operation, returns the controller
	  to DIRECT mode for an XIP window, then resumes the operation.
	  Set CONFIG_CDNS_XSPI_RWW=n in the board or application config to
	  compile out this feature and use the blocking program/erase path.

config CDNS_XSPI_RWW_TICK_US
	int "RWW base tick in microseconds"
	default 125
	depends on CDNS_XSPI_RWW

config CDNS_XSPI_RWW_ACTIVE_TICKS
	int "Ticks per program/erase progress window"
	default 20
	depends on CDNS_XSPI_RWW

config CDNS_XSPI_RWW_XIP_TICKS
	int "Ticks per suspended XIP window"
	default 13
	depends on CDNS_XSPI_RWW

config CDNS_XSPI_RWW_SUSPEND_TIMEOUT_US
	int "Suspend acknowledgement timeout in microseconds"
	default 40
	depends on CDNS_XSPI_RWW
	help
	  Default timing is suitable for devices such as MX25UM25645G, which
	  specifies a maximum tPSL/tESL of 25 us. 40 us leaves margin while still
	  detecting a failed suspend quickly.

config CDNS_XSPI_RWW_NOPS_PER_US
	int "Calibrated delay-loop iterations per microsecond"
	default 64
	depends on CDNS_XSPI_RWW
	help
	  Must be calibrated on SRW1500. The active flash window cannot call
	  Zephyr timing services because those services may execute from XIP.

endmenu

endif # FLASH_CAD_XSPI
```

## drivers/hwinfo/Kconfig
```kconfig
# HW Info driver configuration options

# Copyright (c) 2025 Synaptics Incorporated
# SPDX-License-Identifier: Apache-2.0

if HWINFO

config HWINFO_SYNA_SR100
	bool "Synaptics SR100 hwinfo"
	default y
	depends on SOC_SERIES_SR1XX
	select HWINFO_HAS_DRIVER
	help
	  Enable Synaptics hwinfo driver

config HWINFO_SYNA_SL261X
	bool "Synaptics SL261X hwinfo"
	default y
	depends on SOC_SERIES_SL261X
	select HWINFO_HAS_DRIVER
	help
	  Enable Synaptics hwinfo driver

endif
```

## drivers/i2s/Kconfig
```kconfig
# Copyright (c) 2026 Synaptics, Inc.
# SPDX-License-Identifier: Apache-2.0

config I2S_SYNA_SR100
	bool "Synaptics SR100 I2S driver"
	default y
	depends on DT_HAS_SYNA_SR100_I2S_SR100_ENABLED && CLOCK_CONTROL
	select DMA
	select PINCTRL
	help
	  Enable support for the Synaptics SR100 I2S controller.

	  The driver supports the Zephyr I2S API using the SR100 PCM
	  controller registers, DMA channels, and pinctrl configuration
	  described by devicetree.
```

## drivers/mbox/Kconfig
```kconfig
# Copyright (C) 2026 Synaptics Incorporated. All rights reserved.
# SPDX-License-Identifier: Apache-2.0

if MBOX

rsource "Kconfig.syna_sr100"

endif # MBOX
```

## drivers/mbox/Kconfig.syna_sr100
```kconfig
# Copyright (C) 2026 Synaptics Incorporated. All rights reserved.
# SPDX-License-Identifier: Apache-2.0

config MBOX_SYNA_SR100
	bool "Synaptics SR100 IPC mailbox driver"
	default y
	depends on DT_HAS_SYNA_MBOX_SR100_ENABLED
	help
	  Driver for Synaptics SR100 IPC/mailbox between cores
```

## drivers/mbox/Kconfig.synaprot
```kconfig
# Copyright (C) 2026 Synaptics Incorporated. All rights reserved.
# SPDX-License-Identifier: Apache-2.0

config SYNAPROT_MBOX
	bool "Synaptics SPROT_MBOX driver"
	default y
	depends on DT_HAS_SYNA_SYNAPROT_MBOX_ENABLED
	help
	  Polled H2S/S2H mailbox to the secure co-processor. There is
	  no interrupt line for this block; responses are retrieved via
	  mbox_synaprot_poll_response() (see
	  drivers/synaprot_mbox/mbox_synaprot.h).

if SYNAPROT_MBOX
config SYNAPROT_MBOX_LOCK_TIMEOUT_MS
	int "Timeout waiting for the SPROT_MBOX interface lock [ms]"
	default 100

config SYNAPROT_MBOX_TX_TIMEOUT_US
	int "Timeout waiting for the co-processor to consume a H2S message [us]"
	default 1000000

endif # SYNAPROT_MBOX
```

## drivers/mdio/Kconfig
```kconfig
# Copyright (c) 2021 IP-Logix Inc.
# SPDX-License-Identifier: Apache-2.0

if MDIO

rsource "Kconfig.dwmac"

endif # MDIO
```

## drivers/mdio/Kconfig.dwmac
```kconfig
# Copyright (c) 2023 Intel Corporation
# SPDX-License-Identifier: Apache-2.0

config MDIO_DWMAC
	bool "synopsys mdio driver"
	depends on ETH_DWMAC
	default y
	help
	  Enable Synopsys dwc mac MDIO driver.

if  MDIO_DWMAC

config MDIO_DWMAC_STATUS_BUSY_CHECK_TIMEOUT
	int "A timeout value in us to check software reset status"
	default 10000
	help
	  This option specifies the timeout value in microseconds (us) for checking
	  the software reset status during the MDIO initialization.

endif
```

## drivers/otp/Kconfig
```kconfig
# Copyright (c) 2026 Synaptics Incorporated
# SPDX-License-Identifier: Apache-2.0

if OTP

config SYNA_SRW1500_OTP
	bool "Synaptics SRW1500 memory-mapped OTP driver"
	default y
	depends on DT_HAS_SYNA_SRW1500_OTP_ENABLED
	help
	  Enable read and programming access to the Synaptics SRW1500 OTP
	  public data window when the corresponding Zephyr OTP options are
	  selected.

endif # OTP
```

## drivers/pinctrl/Kconfig
```kconfig
# Copyright (c) 2025 Synaptics Incorporated
# SPDX-License-Identifier: Apache-2.0

if PINCTRL

rsource "Kconfig.syna_sl261x"
rsource "Kconfig.syna_srw1500"

endif # PINCTRL
```

## drivers/pinctrl/Kconfig.syna_sl261x
```kconfig
# Copyright (c) 2026 Synaptics Incorporated
# SPDX-License-Identifier: Apache-2.0

config PINCTRL_SYNA_SL261X
	bool "Pin controller driver for Synaptics SL261X MCUs"
	default y
	depends on DT_HAS_SYNA_SL261X_PINCTRL_ENABLED
	help
	  Enable pin controller driver for Synaptics SL261X MCUs
```

## drivers/pinctrl/Kconfig.syna_srw1500
```kconfig
# Copyright (c) 2026 Synaptics Incorporated
# SPDX-License-Identifier: Apache-2.0

config PINCTRL_SYNA_SRW1500
	bool "Pin controller driver for Synaptics SRW1500 MCU"
	default y
	depends on DT_HAS_SYNA_SRW1500_PINCTRL_ENABLED
	help
	  Enable pin controller driver for Synaptics SRW1500 MCU
```

## drivers/pwm/Kconfig
```kconfig
# Copyright (c) 2026 Synaptics Incorporated
# SPDX-License-Identifier: Apache-2.0

if PWM

rsource "Kconfig.tcpwm_syna"

endif # PWM
```
