## Kconfig
```kconfig
# Copyright (c) 2025 Synaptics, Inc.
# SPDX-License-Identifier: Apache-2.0

rsource "drivers/Kconfig"
```

## boards/syna/astra_sl/sl2619_rdk/Kconfig.sl2619_rdk
```kconfig
# Copyright (c) 2026 Synaptics Incorporated
# SPDX-License-Identifier: Apache-2.0

config BOARD_SL2619_RDK
	select SOC_SL2619_A55 if BOARD_SL2619_RDK_SL2619_A55 || BOARD_SL2619_RDK_SL2619_A55_DDRLESS
	select SOC_SL2619_M52 if BOARD_SL2619_RDK_SL2619_M52

# Enlarge default networking stack
configdefault NET_L2_ETHERNET
	default y

configdefault NET_TX_STACK_SIZE
	default 8192

configdefault NET_RX_STACK_SIZE
	default 8192
```

## boards/syna/astra_sl/sl2619_rdk/board.yml
```yaml
board:
  name: sl2619_rdk
  full_name: Synaptics SL2619 RDK
  vendor: synaptics
  socs:
  - name: sl2619
    variants:
    - name: ddrless
      cpucluster: a55
```

## boards/syna/astra_sl/sl2619_rdk/sl2619_rdk_sl2619_a55_ddrless_defconfig
```kconfig
# Copyright (c) 2026 Synaptics Incorporated
# SPDX-License-Identifier: Apache-2.0

# Zephyr Kernel Configuration
CONFIG_XIP=y
CONFIG_KERNEL_DIRECT_MAP=y

# Serial Drivers
CONFIG_SERIAL=y
CONFIG_CONSOLE=y
CONFIG_UART_CONSOLE=y
CONFIG_UART_NS16550_DW8250_DW_APB=y

# ARM Options
CONFIG_ARM_ARCH_TIMER=y
CONFIG_AARCH64_IMAGE_HEADER=y
```

## boards/syna/astra_sl/sl2619_rdk/sl2619_rdk_sl2619_m52_defconfig
```kconfig
# Copyright (c) 2025 Synaptics Incorporated
# SPDX-License-Identifier: Apache-2.0

CONFIG_CONSOLE=y
CONFIG_SERIAL=y
CONFIG_UART_INTERRUPT_DRIVEN=y
CONFIG_UART_CONSOLE=y
CONFIG_GPIO=y
CONFIG_FLASH=y
CONFIG_I2C=y
CONFIG_I2C_DW=y
CONFIG_ASOC=y
CONFIG_FLASH=y
CONFIG_FLASH_CAD_XSPI=y
CONFIG_ETH_DRIVER=y
CONFIG_MDIO=y
CONFIG_SPI=y
```

## boards/syna/astra_sr/sr100/Kconfig.sysbuild
```kconfig
# Copyright 2026, Synaptics Incorporated
# SPDX-License-Identifier: Apache-2.0

if BOARD_SR100_RDK

config APP_M4
	bool "Build Zephyr M4 image"
	default n
	help
	  Build the M4 companion image as part of the SR100 sysbuild. When
	  enabled, sysbuild adds the M4 image and enforces M4-first
	  configure/flash order relative to the M55 application image.

config APP_M4_SOURCE_DIR
	string "Source directory of the M4 Zephyr application"
	depends on APP_M4
	default "${ZEPHYR_BASE}/samples/subsys/shell/shell_module"
	help
	  Absolute path to the M4 application source directory.

endif # BOARD_SR100_RDK

# Default MCUboot mode for this platform
choice MCUBOOT_MODE
	default MCUBOOT_MODE_RAM_LOAD
endchoice
```

## boards/syna/astra_sr/srw1500/Kconfig.defconfig
```kconfig
# Copyright (c) 2026 Synaptics Incorporated
# SPDX-License-Identifier: Apache-2.0

config SOC
    default "srw1500"

config NUM_IRQS
	default 195

config ROM_START_OFFSET
	default 0x400 if BOOTLOADER_MCUBOOT

if I2C_DW

config I2C_DW_CLOCK_SPEED
	default 48

endif # I2C_DW
```

## boards/syna/astra_sr/srw1500/Kconfig.srw1500_rdk
```kconfig
# Copyright (c) 2026 Synaptics Incorporated
# SPDX-License-Identifier: Apache-2.0

config BOARD_SRW1500_RDK
	select SOC_SRW1500
```

## boards/syna/astra_sr/srw1500/Kconfig.sysbuild
```kconfig
# Copyright (C) 2026 Synaptics Incorporated. All rights reserved.
# SPDX-License-Identifier: Apache-2.0

if SOC_SRW1500

choice BOOTLOADER
	default BOOTLOADER_MCUBOOT
endchoice

choice MCUBOOT_MODE
	default MCUBOOT_MODE_SINGLE_APP
endchoice

choice BOOT_SIGNATURE_TYPE
	prompt "MCUboot signature type"
	default BOOT_SIGNATURE_TYPE_NONE

config BOOT_SIGNATURE_TYPE_NONE
	bool "None"

config BOOT_SIGNATURE_TYPE_RSA
	bool "RSA"

config BOOT_SIGNATURE_TYPE_ECDSA_P256
	bool "ECDSA P-256"

endchoice

endif # SOC_SRW1500
```

## boards/syna/astra_sr/srw1500/board.yml
```yaml
board:
  name: srw1500_rdk
  full_name: Syna SRW1500 RDK
  vendor: synaptics
  socs:
  - name: srw1500
```

## boards/syna/astra_sr/srw1500/srw1500_rdk_defconfig
```kconfig
# Copyright (c) 2026 Synaptics Incorporated
# SPDX-License-Identifier: Apache-2.0

CONFIG_SERIAL=y
CONFIG_UART_NS16550=y
CONFIG_UART_INTERRUPT_DRIVEN=y
CONFIG_CONSOLE=y
CONFIG_UART_CONSOLE=y
CONFIG_PRINTK=y
CONFIG_STDOUT_CONSOLE=y
CONFIG_SYS_CLOCK_HW_CYCLES_PER_SEC=192000000
CONFIG_SYS_CLOCK_TICKS_PER_SEC=1000
CONFIG_XIP=y
CONFIG_FLASH=y
# CONFIG_FLASH_BASE_ADDRESS=0x38000000
# CONFIG_FLASH_SIZE=32768
# CONFIG_USE_DT_CODE_PARTITION=y
CONFIG_CORTEX_M_SYSTICK=y
CONFIG_ARM_MPU=y
CONFIG_DYNAMIC_INTERRUPTS=y
CONFIG_GEN_ISR_TABLES=y
CONFIG_CLOCK_CONTROL=y
CONFIG_SOC_EARLY_INIT_HOOK=y
CONFIG_RESET=y
CONFIG_ARM_SAU=y
CONFIG_ARM_MPC_SIE300=y
CONFIG_ARM_PPC=y
CONFIG_ENTROPY_GENERATOR=y
CONFIG_HEAP_MEM_POOL_SIZE=8192

# Enable Cortex-M52 cache
CONFIG_CACHE_MANAGEMENT=y
CONFIG_ARCH_CACHE=y

# Enable otf-cache
CONFIG_CACHE_ARM_AHB=y

CONFIG_COMPILER_OPT="-mbranch-protection=standard"
```

## drivers/Kconfig
```kconfig
# Copyright (c) 2025 Synaptics Incorporated
# SPDX-License-Identifier: Apache-2.0

menu "Device Drivers"

# zephyr-keep-sorted-start
rsource "cache/Kconfig"
rsource "can/Kconfig"
rsource "clock_control/Kconfig"
rsource "counter/Kconfig"
rsource "dma/Kconfig"
rsource "entropy/Kconfig"
rsource "ethernet/Kconfig"
rsource "bluetooth/Kconfig"
rsource "flash/Kconfig"
rsource "fc/Kconfig"
rsource "pwm/Kconfig"
rsource "hwinfo/Kconfig"
rsource "mbox/Kconfig"
rsource "mdio/Kconfig"
rsource "otp/Kconfig"
rsource "i2s/Kconfig"
rsource "misc/Kconfig"
rsource "pinctrl/Kconfig"
rsource "reset/Kconfig"
rsource "sdhc/Kconfig"
rsource "sdio_device/Kconfig"
rsource "security/Kconfig"
rsource "timer/Kconfig"
rsource "usb/Kconfig"
rsource "video/Kconfig"
rsource "watchdog/Kconfig"
rsource "dmic/Kconfig"
rsource "wifi/Kconfig"
rsource "bluetooth/Kconfig"
# zephyr-keep-sorted-stop

endmenu
```

## drivers/bluetooth/Kconfig
```kconfig
# Copyright (c) 2026 Synaptics Incorporated
#
# SPDX-License-Identifier: Apache-2.0

rsource "hci/Kconfig"
```

## drivers/bluetooth/hci/Kconfig
```kconfig
# Copyright (c) 2026 Synaptics Incorporated
#
# SPDX-License-Identifier: Apache-2.0

config BT_HCI_SYNA
	bool "Synaptics SYNA BT HCI UART driver"
	depends on BT_H4
	select BT_HCI_SETUP
	select UART_USE_RUNTIME_CONFIGURE
	help
	  Enable the vendor HCI UART setup driver for Synaptics SYNA
	  Bluetooth controllers.  This driver implements bt_h4_vnd_setup()
	  to assert BT_REGON and download the patchram firmware before the
	  Zephyr BT HOST stack initializes.

config BT_HCI_SYNA_BAUD_RATE
	int "SYNA HCI UART operating baudrate (after patchram)"
	depends on BT_HCI_SYNA
	default 1500000
	help
	  UART baudrate used for patchram download and normal HCI operation.
	  The driver starts at 115200, sends VS_UPDATE_UART_BAUDRATE to switch
	  to this rate for the download, then switches back after patchram and
	  re-applies this rate for normal BT HOST stack operation.
	  Set to 115200 to disable baudrate switching (debug/compatibility).

config BT_HCI_SNOOP
	bool "HCI packet snoop logging to console"
	default n
	help
	  When enabled, all HCI TX and RX packets are printed to the Zephyr
	  console in a line-oriented hex format that can be post-processed into
	  a btsnoop (.hci) capture file for Wireshark / hcidump.

	  Long packets are automatically split into 100-byte chunks per line.

	  Example output:
	    SNOOP:TX[1](01):TX:01 03 0C 00
	    SNOOP:RX[1](01):RX:04 0E 04 01 03 0C 00
	    SNOOP:RX[2](01):RX:04 0E FC 01 14 0C 00 42 43 4D ...
	    SNOOP:RX[2](02):RX:00 00 00 ...

	  Hooks are inserted in the Zephyr H:4 HCI UART transport (h4.c)
	  for all Zephyr BT stack samples.

	  NOTE: Build with CONFIG_LOG_PRINTK=n so that printk() bypasses the
	  deferred log buffer and snoop lines are never dropped.

	  Disable in production builds to avoid UART overhead.
```

## drivers/cache/Kconfig
```kconfig
# Copyright (c) 2026 Synaptics Incorporated
# SPDX-License-Identifier: Apache-2.0

if CACHE

rsource "Kconfig.arm_ahb"

endif # CACHE
```

## drivers/can/Kconfig
```kconfig
# Copyright 2026, Synaptics Incorporated
#
# SPDX-License-Identifier: Apache-2.0

if CAN

config CAN_SYNA
	bool "Synaptics CAN/CAN FD driver"
	default y
	depends on DT_HAS_SYNA_CAN_ENABLED
	depends on CLOCK_CONTROL
	select CAN_FD_MODE
	select CAN_MANUAL_RECOVERY_MODE
	select PINCTRL
	select STATS
	help
	  Enable the Synaptics CAN/CAN FD controller driver.

	  The driver supports the Synaptics CAN controller IP used across
	  supported Synaptics SoCs. It exposes the standard Zephyr CAN API for
	  classic CAN, CAN FD, loopback, listen-only, one-shot, filtering,
	  statistics, and optional manual bus-off recovery.

endif # CAN
```

## drivers/clock_control/Kconfig
```kconfig
# Copyright (c) 2026 Synaptics Incorporated
# SPDX-License-Identifier: Apache-2.0

#
# Clock controller drivers
#

if CLOCK_CONTROL

rsource "Kconfig.syna_sl"
rsource "Kconfig.syna_sl261x"

endif # CLOCK_CONTROL
```

## drivers/clock_control/Kconfig.syna_sl
```kconfig
# Copyright (c) 2026 Synaptics Incorporated
# SPDX-License-Identifier: Apache-2.0

config CLOCK_CONTROL_SYNA_SL_PLL
	bool "Synaptics SL family SoCs ACPU domain pll Driver"
	default y
	depends on DT_HAS_SYNA_SL_PLL_ENABLED
	help
	  Enable ACPU domain pll support for Synaptics SL family SoCs.

config CLOCK_CONTROL_SYNA_SL_CLK
	bool "Synaptics SL family SoCs ACPU domain CLK Driver"
	default y
	depends on DT_HAS_SYNA_SL_CLK_ENABLED
	depends on CLOCK_CONTROL_SYNA_SL_PLL
	help
	  Enable ACPU domain clk support for Synaptics SL family SoCs.

if CLOCK_CONTROL_SYNA_SL_CLK
config CLOCK_CONTROL_SYNA_SL_CLK_INIT_PRIORITY
	int "Synaptics SL family SoCs ACPU domain CLK driver init priority"
	default 31
	help
	  Synaptics SL family SoCs ACPU domain clk driver initialization priority.
	  This should be lower than the priority of PLL driver.
endif # CLOCK_CONTROL_SYNA_SL_CLK

config CLOCK_CONTROL_SYNA_SL_GATECLK
	bool "Synaptics SL family SoCs ACPU domain GATECLK Driver"
	default y
	depends on DT_HAS_SYNA_SL_GATECLK_ENABLED
	depends on CLOCK_CONTROL_SYNA_SL_CLK
	help
	  Enable ACPU domain gateclk support for Synaptics SL family SoCs.
```

## drivers/clock_control/Kconfig.syna_sl261x
```kconfig
# Copyright (c) 2026 Synaptics, Inc.
# SPDX-License-Identifier: Apache-2.0

config CLOCK_CONTROL_SYNA_SL261X
	bool "Synaptics SL261X Clock Control Driver"
	default y
	depends on DT_HAS_SYNA_SL261X_CLOCK_ENABLED
	help
	  Enable clock control support for Synaptics SL261X SoC series.
```

## drivers/clock_control/Kconfig.syna_srw1500
```kconfig
# Copyright (c) 2026 Synaptics Incorporated
# SPDX-License-Identifier: Apache-2.0

config CLOCK_CONTROL_SYNA_SRW1500
	bool "Synaptics SRW1500 Clock Control Driver"
	default y
	depends on DT_HAS_SYNA_SRW1500_CLOCK_ENABLED
	help
	  Enable clock control support for the Synaptics SRW1500 SoC.
```

## drivers/counter/Kconfig
```kconfig
# Counter configuration options

# Copyright (c) 2026 Synaptics Incorporated
# SPDX-License-Identifier: Apache-2.0

if COUNTER

rsource "Kconfig.corstone_syscounter"
rsource "Kconfig.corstone_timer"

endif # COUNTER
```

## drivers/counter/Kconfig.corstone_syscounter
```kconfig
# Corstone System Counter Kconfig

# Copyright (c) 2026 Synaptics Incorporated
# SPDX-License-Identifier: Apache-2.0

config COUNTER_CORSTONE_SYSCOUNTER
    bool "ARM Corstone System Counter support"
	default y
	depends on DT_HAS_ARM_CORSTONE_SYSCOUNTER_ENABLED
    help
      Enable driver for the Corstone System Counter block.
      Provides 64-bit free-running timer base for other peripherals.
```
