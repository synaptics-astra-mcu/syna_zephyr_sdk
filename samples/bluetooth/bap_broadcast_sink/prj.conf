## CMakeLists.txt
```
# Copyright (c) 2026 Synaptics Incorporated
#
# SPDX-License-Identifier: Apache-2.0

cmake_minimum_required(VERSION 3.20.0)
find_package(Zephyr REQUIRED HINTS $ENV{ZEPHYR_BASE})
project(bap_broadcast_sink)

# Our local src/ must come FIRST so local lc3.h / usb.h shadow the upstream
# versions that include USB headers (not available on SR110).
target_include_directories(app PRIVATE
	src/
	$ENV{ZEPHYR_BASE}/samples/bluetooth/bap_broadcast_sink/src/
)

target_sources(app PRIVATE
	$ENV{ZEPHYR_BASE}/samples/bluetooth/bap_broadcast_sink/src/main.c
	$ENV{ZEPHYR_BASE}/samples/bluetooth/bap_broadcast_sink/src/stream_rx.c
	src/lc3.c
	src/hw_codec.c
	src/usb.c
)
```

## Kconfig
```
# Copyright (c) 2022 Nordic Semiconductor ASA
# Copyright (c) 2026 Synaptics Incorporated
#
# SPDX-License-Identifier: Apache-2.0

mainmenu "Bluetooth: BAP Broadcast Sink (SR110 RDK)"

config SCAN_OFFLOAD
	bool "Whether to wait for a Broadcast Assistant"
	default y
	select BT_PER_ADV_SYNC_TRANSFER_RECEIVER if (!HAS_BT_CTLR || \
						     BT_CTLR_SYNC_TRANSFER_RECEIVER_SUPPORT)
	help
	  If set to true, the sample will start advertising connectable for
	  Broadcast Assistants.

config SCAN_SELF
	bool "Whether to scan for Broadcast Sources without Broadcast Assistant"
	default y
	help
	  If set to true, the sample will start scanning for Broadcast Sources
	  without waiting for a Broadcast Assistant to connect.

config SCAN_DELAY
	int "Delay before starting scan (in seconds)"
	range 0 255
	default 10
	depends on SCAN_SELF

config TARGET_BROADCAST_NAME
	string "Target Broadcast Device Name"
	default ""

config MAX_CODEC_FRAMES_PER_SDU
	int "The maximum number of codec frames per SDU supported"
	default 1
	range 1 255

config ENABLE_LC3
	bool "Enable the LC3 codec"
	default n  # LC3 not available on SR110 (no liblc3 module)

config USE_USB_AUDIO_OUTPUT
	bool "Use USB Audio as output"
	default n  # No USB audio on SR110

config USE_CODEC_AUDIO_OUTPUT
	bool "Use Codec Audio as output"
	default n  # No audio codec hardware on SR110

config USE_SPECIFIC_BROADCAST_CHANNEL
	bool "Use specific Broadcast Channel Audio Location"
	default n

config TARGET_BROADCAST_CHANNEL
	int "Broadcast Channel Audio Location to sync to"
	range 0 3
	default 1
	depends on USE_SPECIFIC_BROADCAST_CHANNEL

config INFO_REPORTING_INTERVAL
	int "Number of SDUs received between each information report"
	default 1000

source "Kconfig.zephyr"
```

## prj.conf
```kconfig
CONFIG_BT=y
CONFIG_LOG=y
CONFIG_UTF8=y
CONFIG_BT_AUDIO=y
CONFIG_BT_SMP=y
CONFIG_BT_PAC_SNK=y
CONFIG_BT_PERIPHERAL=y
CONFIG_BT_GAP_AUTO_UPDATE_CONN_PARAMS=n
CONFIG_BT_PERIPHERAL_PREF_MIN_INT=50
CONFIG_BT_PERIPHERAL_PREF_MAX_INT=70
CONFIG_BT_PERIPHERAL_PREF_LATENCY=0
CONFIG_BT_PERIPHERAL_PREF_TIMEOUT=400
CONFIG_BT_OBSERVER=y
CONFIG_BT_GATT_DYNAMIC_DB=y
CONFIG_BT_EXT_ADV=y
CONFIG_BT_PER_ADV_SYNC=y
CONFIG_BT_ISO_SYNC_RECEIVER=y
CONFIG_BT_BAP_BROADCAST_SINK=y
CONFIG_BT_BAP_SCAN_DELEGATOR=y
CONFIG_BT_ISO_MAX_CHAN=2
CONFIG_BT_ISO_RX_BUF_COUNT=8
CONFIG_BT_BAP_BROADCAST_SNK_SUBGROUP_COUNT=2
CONFIG_BT_BAP_BROADCAST_SNK_STREAM_COUNT=2
CONFIG_BT_BAP_BASS_MAX_SUBGROUPS=2
CONFIG_BT_BUF_ACL_RX_SIZE=255
CONFIG_BT_BUF_ACL_TX_SIZE=251
CONFIG_BT_AUDIO_CODEC_CFG_MAX_METADATA_SIZE=64
CONFIG_BT_AUDIO_CODEC_CFG_MAX_DATA_SIZE=64
CONFIG_BT_AUDIO_CODEC_CAP_MAX_METADATA_SIZE=64
CONFIG_BT_AUDIO_CODEC_CAP_MAX_DATA_SIZE=64
CONFIG_BT_DEVICE_NAME="Broadcast Audio Sink"
# Scan without Broadcast Assistant
CONFIG_SCAN_SELF=y
CONFIG_SCAN_OFFLOAD=y

# ── SR110 + SYNA hardware ──────────────────────────────────────────────────
CONFIG_BT_H4=y
CONFIG_BT_HCI_SYNA=y
CONFIG_GPIO=y
CONFIG_UART_INTERRUPT_DRIVEN=y
CONFIG_UART_NS16550_VARIANT_NS16750=y
CONFIG_SRAM_SIZE=384
CONFIG_MAIN_STACK_SIZE=4096
CONFIG_BT_RX_STACK_SIZE=4096
CONFIG_BT_BUF_CMD_TX_SIZE=255
CONFIG_XIP=n
```

## src/hw_codec.c
```c
/*
 * Copyright (c) 2026 Synaptics Incorporated
 *
 * SPDX-License-Identifier: Apache-2.0
 */

#include <stddef.h>
#include <stdint.h>
/* hw_codec.h is found via the include path set in CMakeLists.txt */
#include "hw_codec.h"

int hw_codec_open(void) { return 0; }
int hw_codec_cfg(uint32_t samplerate) { (void)samplerate; return 0; }
uint32_t hw_codec_write_data(const uint8_t *data, uint32_t len) { (void)data; return len; }
int hw_codec_close(void) { return 0; }
```

## src/lc3.c
```c
/*
 * Copyright (c) 2026 Synaptics Incorporated
 *
 * SPDX-License-Identifier: Apache-2.0
 */

#include <zephyr/sys/printk.h>
#include "lc3.h"

int lc3_init(void)
{
	printk("[lc3] stub: LC3 decoder not available on SR110\n");
	return 0;
}

int lc3_enable(struct stream_rx *stream)
{
	return 0;
}

int lc3_disable(struct stream_rx *stream)
{
	return 0;
}

void lc3_enqueue_for_decoding(struct stream_rx *stream, const struct bt_iso_recv_info *info,
                               struct net_buf *buf)
{
	/* SR110 stub: discard — no audio output hardware */
	(void)stream; (void)info; (void)buf;
}
```

## src/lc3.h
```c
/* Copyright (c) 2026 Synaptics Incorporated — SR110 stub: no LC3 decode on SR110 */
#ifndef SAMPLE_BAP_BROADCAST_SINK_LC3_H
#define SAMPLE_BAP_BROADCAST_SINK_LC3_H

#include <stdbool.h>
#include <stddef.h>
#include <stdint.h>
#include <zephyr/bluetooth/audio/audio.h>
#include <zephyr/bluetooth/iso.h>
#include <zephyr/kernel.h>
#include <zephyr/net_buf.h>
#include "stream_rx.h"

/* LC3 stub prototypes — no actual decoding on SR110 (no liblc3, no USB) */
int lc3_enable(struct stream_rx *stream);
int lc3_disable(struct stream_rx *stream);
void lc3_enqueue_for_decoding(struct stream_rx *stream, const struct bt_iso_recv_info *info,
                               struct net_buf *buf);
int lc3_init(void);

#endif /* SAMPLE_BAP_BROADCAST_SINK_LC3_H */
```

## src/usb.c
```c
/*
 * Copyright (c) 2026 Synaptics Incorporated
 *
 * SPDX-License-Identifier: Apache-2.0
 */

#include "usb.h"

int usb_init(void) { return 0; }

int usb_add_frame_to_usb(enum bt_audio_location chan_allocation, const int16_t *frame,
                          size_t frame_size, uint32_t ts)
{
	(void)chan_allocation; (void)frame; (void)frame_size; (void)ts;
	return 0;
}

void usb_clear_frames_to_usb(void) {}
```

## src/usb.h
```c
/* Copyright (c) 2026 Synaptics Incorporated — SR110 stub: no USB audio on SR110 */
#ifndef SAMPLE_BAP_BROADCAST_SINK_USB_H
#define SAMPLE_BAP_BROADCAST_SINK_USB_H

#include <stdbool.h>
#include <stddef.h>
#include <stdint.h>
#include <zephyr/bluetooth/audio/audio.h>

#define USB_SAMPLE_RATE_HZ 48000U

int usb_add_frame_to_usb(enum bt_audio_location chan_allocation, const int16_t *frame,
                          size_t frame_size, uint32_t ts);
void usb_clear_frames_to_usb(void);
int usb_init(void);

#endif /* SAMPLE_BAP_BROADCAST_SINK_USB_H */
```
