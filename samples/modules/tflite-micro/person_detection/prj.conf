## CMakeLists.txt
```
cmake_minimum_required(VERSION 3.20.0)
find_package(Zephyr REQUIRED HINTS $ENV{ZEPHYR_BASE})
project(person_detection)

set(NO_THREADSAFE_STATICS $<TARGET_PROPERTY:compiler-cpp,no_threadsafe_statics>)
zephyr_compile_options($<$<COMPILE_LANGUAGE:CXX>:${NO_THREADSAFE_STATICS}>)

target_sources(app PRIVATE
  src/main.cpp
  src/infer_utils.c
)
```

## Kconfig
```
# Copyright (c) 2026 Synaptics Incorporated
# SPDX-License-Identifier: Apache-2.0

mainmenu "Person Detection Sample"

config PERSON_DETECTION_MODEL_FLASH_ADDR
	hex "XIP flash address of the model binary"
	default 0x3C629000
	help
	  Start address in the XIP flash region where the TFLite model binary
	  has been programmed. Board-specific; adjust to match the flash
	  partition layout of the target hardware.

config PERSON_DETECTION_INPUT_FLASH_ADDR
	hex "XIP flash address of the input image binary"
	default 0x3CA00000
	help
	  Start address in the XIP flash region where the raw input image
	  binary has been programmed.

config PERSON_DETECTION_MODEL_SIZE
	int "Size of the model binary in bytes"
	default 1160832
	help
	  Byte length of the model binary stored at
	  PERSON_DETECTION_MODEL_FLASH_ADDR. Must match the actual file size
	  of the programmed model; a mismatch will silently copy wrong data.

source "Kconfig.zephyr"
```

## prj.conf
```kconfig
CONFIG_CPP=y
CONFIG_STD_CPP17=y
CONFIG_TENSORFLOW_LITE_MICRO=y
CONFIG_MAIN_STACK_SIZE=65536
CONFIG_REQUIRES_FLOAT_PRINTF=y
CONFIG_SIZE_OPTIMIZATIONS=y
# Ethos-U55 NPU
CONFIG_ETHOS_U=y
CONFIG_ETHOS_U55_128=y
CONFIG_HEAP_MEM_POOL_SIZE=16384
CONFIG_LOG=y
```

## boards/sr100_rdk_sr100_m55.overlay
```dts
/* This forces the driver to pass NULL for fast-memory and lets
 * the model use system RAM for activations.
 */

&ethosu0 {
    /delete-property/ fast-memory-region;
};
```

## src/main.cpp
```c
/*
 * Copyright (c) 2026 Synaptics Incorporated
 *
 * SPDX-License-Identifier: Apache-2.0
 */

/**
 * @file
 * @brief Person detection sample: run TFLite Micro inference and print detections
 */

#include <string.h>
#include <zephyr/kernel.h>
#include <zephyr/logging/log.h>

#include "tensorflow/lite/schema/schema_generated.h"
#include "tensorflow/lite/micro/micro_mutable_op_resolver.h"
#include "tensorflow/lite/micro/micro_interpreter.h"

extern "C" {
#include "infer_utils.h"
}

LOG_MODULE_REGISTER(person_detection, LOG_LEVEL_INF);

/* Model and input flash addresses derived from Kconfig */
#define MODEL_FLASH_ADDRESS CONFIG_PERSON_DETECTION_MODEL_FLASH_ADDR
#define INPUT_FLASH_ADDRESS CONFIG_PERSON_DETECTION_INPUT_FLASH_ADDR
#define MODEL_SIZE          CONFIG_PERSON_DETECTION_MODEL_SIZE

#define INPUT_WIDTH  480
#define INPUT_HEIGHT 256

/* Tensor arena placed in noinit section to host tensors and weights */
const int kTensorArenaSize = 600 * 1024;
uint8_t tensor_arena[kTensorArenaSize] __attribute__((section(".noinit.tensor_arena")));

static uint8_t input_buf[INPUT_HEIGHT * INPUT_WIDTH * 3] __attribute__((section(".noinit.tensor_arena")));

static uint8_t model_sram_copy[MODEL_SIZE] __attribute__((aligned(16), section(".noinit.tensor_arena")));

int main(void)
{
    memcpy(model_sram_copy, reinterpret_cast<const void *>(MODEL_FLASH_ADDRESS), MODEL_SIZE);
    const uint8_t *model_data = model_sram_copy;

    const tflite::Model *model = tflite::GetModel(model_data);
    if (model->version() != TFLITE_SCHEMA_VERSION) {
        LOG_ERR("model schema version %d does not match supported version %d",
                model->version(), TFLITE_SCHEMA_VERSION);
        return -1;
    }

    tflite::MicroMutableOpResolver<1> resolver;
    resolver.AddEthosU();

    tflite::MicroInterpreter interpreter(
        model, resolver, tensor_arena, kTensorArenaSize);

    if (interpreter.AllocateTensors() != kTfLiteOk) {
        LOG_ERR("AllocateTensors() failed");
        return -1;
    }

    TfLiteTensor *input = interpreter.input(0);
    if (!input) {
        LOG_ERR("no input tensor");
        return -1;
    }

    if (input->dims->size != 4 ||
        input->dims->data[0] != 1 ||
        input->dims->data[1] != INPUT_HEIGHT ||
        input->dims->data[2] != INPUT_WIDTH ||
        input->dims->data[3] != 3) {
        LOG_WRN("unexpected input shape, proceeding");
    }

    if (input->type != kTfLiteInt8) {
        LOG_WRN("expected int8 input tensor (type=%d)", input->type);
    }

    size_t input_bytes = INPUT_HEIGHT * INPUT_WIDTH * 3;
    memcpy(input_buf, reinterpret_cast<const void *>(INPUT_FLASH_ADDRESS), sizeof(input_buf));
    infer_preprocess(input_buf, INPUT_WIDTH, INPUT_HEIGHT);
    memcpy(input->data.int8, input_buf, input_bytes);

    LOG_INF("running inference");
    uint32_t t0 = k_uptime_get_32();
    if (interpreter.Invoke() != kTfLiteOk) {
        LOG_ERR("Invoke() failed");
        return -1;
    }
    uint32_t t1 = k_uptime_get_32();
    LOG_INF("Invoke done in %u ms", (unsigned)(t1 - t0));

    TfLiteTensor *out_box1   = interpreter.output(0);
    TfLiteTensor *out_scores = interpreter.output(1);
    TfLiteTensor *out_box2   = interpreter.output(2);

    detection_t detections[MAX_DETECTIONS];
    int det_count = 0;
    int ret = infer_postprocess(
        out_box1->data.int8,   (size_t)out_box1->bytes,
        out_scores->data.int8, (size_t)out_scores->bytes,
        out_box2->data.int8,   (size_t)out_box2->bytes,
        MAX_DETECTIONS, detections, &det_count);

    if (ret != 0) {
        LOG_ERR("infer_postprocess failed: %d", ret);
        return -1;
    }

    LOG_INF("Person Detections: %d", det_count);
    for (int i = 0; i < det_count; ++i) {
        LOG_INF("class=%d score=%.3f box=[%.1f,%.1f,%.1f,%.1f]",
                detections[i].class_id, (double)detections[i].score,
                (double)detections[i].x, (double)detections[i].y,
                (double)detections[i].w, (double)detections[i].h);
    }
    if (det_count == 0) {
        LOG_INF("No persons detected (confidence threshold 0.25)");
    }

    return 0;
}
```
