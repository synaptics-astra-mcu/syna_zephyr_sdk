## samples/shell/sample.yaml
```yaml
sample:
  name: syna_shell

tests:
  sample.syna.shell:
    tags:
      - shell
      - syna
    integration_platforms:
      - sr100_rdk/sr100/m55
    extra_args:
      - DTC_OVERLAY_FILE=sr100_rdk_m55.overlay
```

## soc/syna/astra_sl/Kconfig
```kconfig
# Copyright (c) 2026 Synaptics Incorporated
# SPDX-License-Identifier: Apache-2.0

if SOC_FAMILY_SYNA_SL

rsource "*/Kconfig"

endif # SOC_FAMILY_SYNA_SL
```

## soc/syna/astra_sl/Kconfig.defconfig
```kconfig
# Copyright (c) 2026 Synaptics Incorporated
# SPDX-License-Identifier: Apache-2.0

if SOC_FAMILY_SYNA_SL

rsource "*/Kconfig.defconfig"

endif # SOC_FAMILY_SYNA_SL
```

## soc/syna/astra_sl/sl261x/Kconfig
```kconfig
# Copyright (c) 2026 Synaptics Incorporated
# SPDX-License-Identifier: Apache-2.0

config SOC_SL2619_A55
	select ARM64
	select ARM_ARCH_TIMER
	select CACHE_MANAGEMENT
	select CPU_CORTEX_A55

config SOC_SL2619_M52
	select ARM
	select ARM_MPU
	select ARMV8_M_DSP
	select ARMV8_1_M_MVEI
	select ARMV8_1_M_MVEF
	select CPU_CORTEX_M52
	select CLOCK_CONTROL
	select CPU_CORTEX_M_HAS_SYSTICK if CPU_CORTEX_M
	select CPU_CORTEX_M_HAS_DWT if CPU_CORTEX_M
	select CPU_HAS_ARM_MPU
	select CPU_HAS_ARM_SAU
	select CPU_HAS_DCACHE
	select CPU_HAS_ICACHE
	select HAS_CMSIS_CORE
	select SOC_EARLY_INIT_HOOK
	select RESET
	select SOC_PREP_HOOK
```

## soc/syna/astra_sl/sl261x/Kconfig.defconfig.sl2619.m52
```kconfig
# Copyright (c) 2026 Synaptics Incorporated
# SPDX-License-Identifier: Apache-2.0

if SOC_SL2619_M52

config ASOC
	bool "Synaptics ASOC present"
	default y
	depends on SOC_SERIES_SL261X
	help
	  Enable Synaptics ASOC CPU present

config DDR
	bool "DDR initialization"
	default n
	depends on SOC_SERIES_SL261X
	help
	  Enable DDR initialization

config NPU
	bool "Use NPU memory for Ethernet"
	default n
	depends on SOC_SERIES_SL261X
	help
	  Use NPU memory for Ethernet packets & buffers

config CACHE_MANAGEMENT
	default y

config SYS_CLOCK_HW_CYCLES_PER_SEC
	default $(dt_node_int_prop_int,/cpus/cpu@0,clock-frequency)

config NUM_IRQS
	default 196

endif
```

## soc/syna/astra_sr/sr100/Kconfig.defconfig
```kconfig
# Copyright (c) 2025 Synaptics Incorporated
# SPDX-License-Identifier: Apache-2.0

if SOC_SERIES_SR1XX

config CACHE_MANAGEMENT
	default y

config NUM_IRQS
	default 128

config SYS_CLOCK_HW_CYCLES_PER_SEC
	default $(dt_node_int_prop_int,/cpus/cpu@0,clock-frequency)

config ARCH_SW_ISR_TABLE_ALIGN
	default 32

config ARCH_DEVICE_STATE_ALIGN
	default 32

config SR100_BOOTLOADER
	default n

endif # SOC_SERIES_SR1XX
```

## soc/syna/astra_sr/srw1500/Kconfig.soc
```kconfig
# Copyright (c) 2026 Synaptics Incorporated
# SPDX-License-Identifier: Apache-2.0

config SOC_SERIES_SRW15xx
	bool
	select SOC_FAMILY_SYNA_SR

config SOC_SERIES
	default "srw15xx" if SOC_SERIES_SRW15xx

config SOC_SRW1500
    bool
    select SOC_SERIES_SRW15xx
    select ARM
    select CPU_CORTEX_M52
    select CPU_HAS_ARM_MPU
    select ARCH_HAS_USERSPACE
    select CLOCK_CONTROL_FIXED_RATE_CLOCK if CLOCK_CONTROL
    select CLOCK_CONTROL

config OTP_PROVISIONED_ENABLED
    bool "OTP Provisioned (v1)"
    depends on SOC_SRW1500
    default n
    help
        Enable for OTP provisioned devices using v1 provisioning.

config OTP_PROVISIONED_V2_ENABLED
    bool "OTP Provisioned (v2)"
    depends on SOC_SRW1500
    default n
    help
        Enable for OTP provisioned devices using v2 provisioning.

config OTP_PROVISIONED_DISABLED
    bool "OTP Provisioning Disabled"
    depends on SOC_SRW1500
    default y
    help
        Use this for devices without OTP provisioning.
```

## soc/synaptics/astra_sl/sl261x/Kconfig.defconfig.sl2619.a55
```kconfig
# Copyright (c) 2026 Synaptics Incorporated
# SPDX-License-Identifier: Apache-2.0

if SOC_SL2619_A55

config NUM_IRQS
	default 209

config SYS_CLOCK_HW_CYCLES_PER_SEC
	default 25000000

# Workaround for not being able to have commas in macro arguments
DT_CHOSEN_Z_FLASH := zephyr,flash

config FLASH_SIZE
	default $(dt_chosen_reg_size_int,$(DT_CHOSEN_Z_FLASH),0,K)

config FLASH_BASE_ADDRESS
	default $(dt_chosen_reg_addr_hex,$(DT_CHOSEN_Z_FLASH))

configdefault ARM64_DCACHE_ALL_OPS
	default y

configdefault ARM64_BOOT_DISABLE_DCACHE
	default y

configdefault DCACHE_LINE_SIZE
	default 64

configdefault ICACHE_LINE_SIZE
	default 64

endif
```

## utilities/Kconfig
```kconfig
# SPDX-License-Identifier: Apache-2.0

rsource "nvm/Kconfig"
rsource "fw_update/Kconfig"
rsource "flash_aux/Kconfig"
rsource "host_api/Kconfig"
```

## utilities/flash_aux/Kconfig
```kconfig
# SPDX-License-Identifier: Apache-2.0

config MODULE_FLASH_AUX_ENABLED
	bool "Flash auxiliary backend"
	depends on FLASH
	depends on FLASH_JESD216_API
	select CRC
	default n
	help
	  Enable the flash auxiliary backend used by Host API service ID 3.
```

## utilities/fw_update/Kconfig
```kconfig
# SPDX-License-Identifier: Apache-2.0

config MODULE_FW_UPDATE_ENABLED
	bool "Firmware update core"
	depends on FLASH
	select CRC
	select MODULE_NVM_ENABLED
	default n
	help
	  Enable the firmware update core.

config FW_UPDATE_BOOT_HOOK_ENABLED
	bool "Enable early boot FW update hook"
	depends on MODULE_FW_UPDATE_ENABLED
	select CODE_DATA_RELOCATION
	select CODE_DATA_RELOCATION_SRAM
	default y
	help
	  Enable the Zephyr-side early boot hook that advances STAGED updates
	  into execution of the staged SDK image before Host API validation
	  begins.
```

## utilities/host_api/Kconfig
```kconfig
# SPDX-License-Identifier: Apache-2.0

config SERVICE_HOST_API_ENABLED
	bool "Host API core"
	default n
	help
	  Enable the Host API core.

config SERVICE_USB_HOST_API_ENABLED
	bool "USB CDC transport"
	depends on SERVICE_HOST_API_ENABLED
	depends on SERIAL
	depends on USB_DEVICE_STACK_NEXT && USBD_CDC_ACM_CLASS
	default n
	help
	  Enable the USB CDC transport for Host API.

config HOST_API_AUTO_START
	bool "Auto-start Host API and enabled services"
	depends on SERVICE_HOST_API_ENABLED
	default y
	help
	  Start the Host API transport/bootstrap path and enabled Host API
	  services automatically during application initialization.

if SERVICE_USB_HOST_API_ENABLED

config HOST_API_USB_MANUFACTURER
	string "Host API USB manufacturer string"
	default "Synaptics Incorporated"
	help
	  USB manufacturer string used when Host API USB transport is enabled.

config HOST_API_USB_VID
	hex "Host API USB vendor ID"
	default 0xCAFE
	help
	  USB vendor ID used for the Host API USB device.

config HOST_API_USB_PID
	hex "Host API USB product ID"
	default 0x4002
	help
	  USB product ID used for the Host API USB device.

config HOST_API_USB_SELF_POWERED
	bool "Host API USB self-powered attribute"
	default y
	help
	  Set the USB self-powered attribute for the Host API USB device.

config HOST_API_USB_REMOTE_WAKEUP
	bool "Host API USB remote wakeup attribute"
	default n
	help
	  Set the USB remote wakeup attribute for the Host API USB device.

config HOST_API_USB_MAX_POWER
	int "Host API USB bMaxPower value"
	default 125
	range 0 250
	help
	  bMaxPower value in 2 mA units for the Host API USB device.

endif

choice
	prompt "Active communication interface"
	default ACTIVE_INTERFACE_USB if SERVICE_USB_HOST_API_ENABLED
	depends on SERVICE_HOST_API_ENABLED
	help
	  Select the active communication interface for Host API.

config ACTIVE_INTERFACE_UART
	bool "UART"
	help
	  Reserve UART as a Host API active interface ID.

config ACTIVE_INTERFACE_USB
	bool "USB CDC"
	depends on SERVICE_USB_HOST_API_ENABLED
	help
	  Use USB CDC as the Host API active interface.

config ACTIVE_INTERFACE_I2C
	bool "I2C"
	help
	  Reserve I2C as a Host API active interface ID.

config ACTIVE_INTERFACE_SPI
	bool "SPI"
	help
	  Reserve SPI as a Host API active interface ID.

config ACTIVE_INTERFACE_LAST
	bool "Invalid interface"
	help
	  Use an invalid Host API active interface ID.

endchoice

config HOST_API_ACTIVE_INTERFACE
	int
	default 0 if ACTIVE_INTERFACE_UART
	default 1 if ACTIVE_INTERFACE_USB
	default 2 if ACTIVE_INTERFACE_I2C
	default 3 if ACTIVE_INTERFACE_SPI
	default 4 if ACTIVE_INTERFACE_LAST

config HOST_API_THREAD_STACK_SIZE
	int "Host API thread stack size"
	depends on SERVICE_HOST_API_ENABLED
	default 4096

config HOST_API_TASK_PRIORITY
	int "Host API thread priority"
	depends on SERVICE_HOST_API_ENABLED
	default 5

config HOST_API_SDK_VER_MAJOR
	int "SDK version major"
	depends on SERVICE_HOST_API_ENABLED
	default 0

config HOST_API_SDK_VER_MINOR
	int "SDK version minor"
	depends on SERVICE_HOST_API_ENABLED
	default 9

config HOST_API_SDK_VER_REVISION
	int "SDK version revision"
	depends on SERVICE_HOST_API_ENABLED
	default 7

rsource "services/Kconfig"
```

## utilities/host_api/services/Kconfig
```kconfig
# SPDX-License-Identifier: Apache-2.0

rsource "service_fw_update/Kconfig"
rsource "service_flash_aux/Kconfig"
rsource "service_system/Kconfig"
rsource "service_uc_manager/Kconfig"
```

## utilities/host_api/services/service_flash_aux/Kconfig
```kconfig
# SPDX-License-Identifier: Apache-2.0

config SERVICE_FLASH_AUX_ENABLED
	bool "Host API flash auxiliary service"
	depends on SERVICE_HOST_API_ENABLED
	depends on MODULE_FLASH_AUX_ENABLED
	default n
	help
	  Enable the flash auxiliary Host API service (service ID 3)
	  used by host flash tools.
```

## utilities/host_api/services/service_fw_update/Kconfig
```kconfig
# SPDX-License-Identifier: Apache-2.0

config SERVICE_FW_UPDATE_ENABLED
	bool "Host API firmware update service"
	depends on SERVICE_HOST_API_ENABLED
	depends on MODULE_FW_UPDATE_ENABLED
	default n
	help
	  Enable the Host API firmware update service.

config SERVICE_FW_UPDATE_STACK_SIZE
	int "FW update service thread stack size"
	depends on SERVICE_FW_UPDATE_ENABLED
	default 4096

config SERVICE_FW_UPDATE_TASK_PRIORITY
	int "FW update service thread priority"
	depends on SERVICE_FW_UPDATE_ENABLED
	default 5
```

## utilities/host_api/services/service_system/Kconfig
```kconfig
# SPDX-License-Identifier: Apache-2.0

config SERVICE_SYSTEM_ENABLED
	bool "Host API system service"
	depends on SERVICE_HOST_API_ENABLED
	default y
	help
	  Enable the system Host API service.

config HOST_API_SYSTEM_I2C_BUS
	int "Host API system-service I2C bus"
	depends on SERVICE_SYSTEM_ENABLED && I2C
	range 0 1
	default 1
	help
	  Select the SR100 I2C controller used by the system-service
	  I2C read and write register opcodes.
```

## utilities/host_api/services/service_uc_manager/Kconfig
```kconfig
# SPDX-License-Identifier: Apache-2.0

config SERVICE_UC_MANAGER_ENABLED
	bool "UC manager service"
	depends on SERVICE_HOST_API_ENABLED
	default y
	help
	  Enable the minimal SRSDK-compatible use-case manager Host API service.
```

## utilities/nvm/Kconfig
```kconfig
# SPDX-License-Identifier: Apache-2.0

config MODULE_NVM_ENABLED
	bool "FW update NVM metadata"
	depends on FLASH
	select CRC
	default y if MODULE_FW_UPDATE_ENABLED
	help
	  Enable the NVM metadata layer used by the firmware update core.
```

## utilities/synaprot_services/Kconfig
```kconfig
# Copyright (C) 2026 Synaptics Incorporated. All rights reserved.
# SPDX-License-Identifier: Apache-2.0

if SYNAPROT_SERVICE

rsource "Kconfig.syna_srw1500"

endif # SYNAPROT_SERVICE
```

## utilities/synaprot_services/Kconfig.syna_srw1500
```kconfig
# Copyright (C) 2026 Synaptics Incorporated. All rights reserved.
# SPDX-License-Identifier: Apache-2.0

config MODULE_SPROT_SERVICES_SRW1500
	bool "Synatptics Synaprot services"
	default y
    depends on SYNAPROT_MBOX
	help
	  Enable Synaprot services.
```

## west.yml
```yaml
manifest:
  projects:
    - name: zephyr
      url: https://github.com/zephyrproject-rtos/zephyr
      revision: v4.4.1
      path: zephyr
      west-commands: scripts/west-commands.yml
      import:
        name-allowlist:
          - cmsis_6
          - cmsis-dsp
          - liblc3
          - libsbc
          - littlefs
          - fatfs
          - hal_ethos_u
          - tflite-micro
          - hostap
          - tf-psa-crypto
          - mcuboot
          - mbedtls
          - mbedtls-3.6 # Kept for TF-M migration needs
          - zcbor
          - mldsa-native

    - name: srsdk_tools
      url: https://github.com/synaptics-astra-mcu/srsdk_tools.git
      revision: main
      path: srsdk_tools

  self:
    path: zephyr_srsdk
    west-commands: scripts/west-commands.yml
```

## zephyr/drivers/Kconfig
```kconfig
# Copyright (c) 2025 Synaptics Incorporated
# SPDX-License-Identifier: Apache-2.0

menu "Device Drivers"

# zephyr-keep-sorted-start
rsource "cache/Kconfig"
rsource "clock_control/Kconfig"
rsource "dma/Kconfig"
rsource "flash/Kconfig"
rsource "hwinfo/Kconfig"
rsource "misc/Kconfig"
rsource "pinctrl/Kconfig"
rsource "reset/Kconfig"
rsource "sdhc/Kconfig"
rsource "usb/Kconfig"
rsource "video/Kconfig"
rsource "watchdog/Kconfig"
# zephyr-keep-sorted-stop

endmenu
```

## zephyr/drivers/clock_control/Kconfig
```kconfig
# Copyright (c) 2026 Synaptics Incorporated
# SPDX-License-Identifier: Apache-2.0

#
# Clock controller drivers
#

if CLOCK_CONTROL

rsource "Kconfig.syna_sl"
rsource "Kconfig.syna_sl261x"
rsource "Kconfig.syna_sr100"

endif # CLOCK_CONTROL
```

## zephyr/drivers/reset/Kconfig.syna_sl
```kconfig
# Copyright (c) 2026 Synaptics Incorporated
# SPDX-License-Identifier: Apache-2.0

config RESET_SYNA_SL
	bool "Synaptics SL family SoCs ACPU domain reset driver"
	default y
	depends on DT_HAS_SYNA_SL_RESET_ENABLED
	help
	  This option enables the ACPU domain reset driver for Synaptics SL family SoCs.
```

## zephyr/drivers/sdhc/Kconfig
```kconfig
# Copyright 2026 Synaptics Incorporated
# SPDX-License-Identifier: Apache-2.0

if SDHC

rsource "Kconfig.sdhc_mshc"

endif # SDHC
```
