## CMakeLists.txt
```
cmake_minimum_required(VERSION 3.20.0)
find_package(Zephyr REQUIRED HINTS $ENV{ZEPHYR_BASE})
project(host_api_system)

target_sources(app PRIVATE src/main.c)
```

## Kconfig
```
# SPDX-License-Identifier: Apache-2.0

mainmenu "Host API System Sample"

source "Kconfig.zephyr"
```

## sample.yaml
```
sample:
  name: Host API System

tests:
  sample.subsys.host_api_system:
    build_only: true
    platform_allow:
      - sr100_rdk/sr100/m55
    tags:
      - host_api
      - usb
```

## prj.conf
```kconfig
CONFIG_CONSOLE=y
CONFIG_PRINTK=y
CONFIG_STDOUT_CONSOLE=y

CONFIG_LOG=y
CONFIG_LOG_MODE_IMMEDIATE=y
CONFIG_LOG_DEFAULT_LEVEL=3

CONFIG_GPIO=y
CONFIG_I2C=y
CONFIG_SERIAL=y
CONFIG_UART_INTERRUPT_DRIVEN=y
CONFIG_UART_LINE_CTRL=y
CONFIG_REBOOT=y
CONFIG_FLASH=y
CONFIG_FLASH_JESD216_API=y

CONFIG_MAIN_STACK_SIZE=4096
CONFIG_SYSTEM_WORKQUEUE_STACK_SIZE=2048

CONFIG_USB_DEVICE_STACK_NEXT=y
CONFIG_CDC_ACM_SERIAL_INITIALIZE_AT_BOOT=n
CONFIG_USBD_CDC_ACM_CLASS=y
CONFIG_USBD_MAX_SPEED_FULL=y
CONFIG_UDC_DRIVER_HIGH_SPEED_SUPPORT_ENABLED=n
CONFIG_USBD_BOS_SUPPORT=n
CONFIG_USBD_VREQ_SUPPORT=n
CONFIG_UDC_BUF_POOL_SIZE=2048
CONFIG_USBD_MAX_UDC_MSG=8
CONFIG_USBD_MSG_SLAB_COUNT=8
CONFIG_USBD_HWINFO_DEVID_LENGTH=8
CONFIG_USBD_THREAD_STACK_SIZE=2048
CONFIG_UDC_DWC2_STACK_SIZE=2048
CONFIG_USBD_LOG_LEVEL_ERR=y
CONFIG_UDC_DRIVER_LOG_LEVEL_ERR=y
CONFIG_USBD_CDC_ACM_LOG_LEVEL_ERR=y

CONFIG_SERVICE_HOST_API_ENABLED=y
CONFIG_SERVICE_USB_HOST_API_ENABLED=y
CONFIG_SERVICE_SYSTEM_ENABLED=y
CONFIG_MODULE_FLASH_AUX_ENABLED=y
CONFIG_SERVICE_FLASH_AUX_ENABLED=y
CONFIG_MODULE_FW_UPDATE_ENABLED=y
CONFIG_SERVICE_FW_UPDATE_ENABLED=y
CONFIG_ACTIVE_INTERFACE_USB=y
CONFIG_HOST_API_AUTO_START=y
CONFIG_HOST_API_USB_VID=0xCAFE
CONFIG_HOST_API_USB_PID=0x4002
CONFIG_HOST_API_THREAD_STACK_SIZE=4096
CONFIG_HOST_API_TASK_PRIORITY=5
CONFIG_HOST_API_SDK_VER_MAJOR=0
CONFIG_HOST_API_SDK_VER_MINOR=9
CONFIG_HOST_API_SDK_VER_REVISION=7
```

## boards/sr100_rdk_m55.overlay
```dts
/*
 * Enable a CDC ACM UART instance for the Host API validation sample.
 */

&zephyr_udc0 {
	cdc_acm_uart0: cdc_acm_uart0 {
		compatible = "zephyr,cdc-acm-uart";
		label = "Host API";
	};
};
```

## src/main.c
```c
/*
 * Copyright (c) 2026 Synaptics Incorporated
 *
 * SPDX-License-Identifier: Apache-2.0
 */

#include <errno.h>
#include <stdint.h>

#include <zephyr/kernel.h>
#include <zephyr/logging/log.h>

#include "host_api.h"
#include "service_fw_update.h"

LOG_MODULE_REGISTER(host_api_system, LOG_LEVEL_INF);

static volatile uint32_t host_api_validation_reg = 0x13572468U;

void host_api_loaded_apps_report(void)
{
	LOG_INF("zephyr_host_api_system");
}

int main(void)
{
	int ret = 0;

	LOG_INF("Host API system sample start");

	for (int elapsed = 0; elapsed < 5000; elapsed += 10) {
		if (host_api_is_ready()) {
			ret = 0;
			break;
		}

		ret = -ETIMEDOUT;
		k_msleep(10);
	}

	if (ret != 0) {
		LOG_ERR("Host API did not become ready: %d", ret);
		return ret;
	}

#if defined(CONFIG_SERVICE_FW_UPDATE_ENABLED)
	for (int elapsed = 0; elapsed < 5000; elapsed += 10) {
		if (service_fw_update_is_ready()) {
			ret = 0;
			break;
		}

		ret = -ETIMEDOUT;
		k_msleep(10);
	}

	if (ret != 0) {
		LOG_ERR("FW update service did not become ready: %d", ret);
		return ret;
	}
#endif

	LOG_INF("Host API is ready; open the Host API port on host and send Host API commands");
	LOG_INF("Validation register @ 0x%08lx = 0x%08lx",
		(unsigned long)(uintptr_t)&host_api_validation_reg,
		(unsigned long)host_api_validation_reg);

	while (true) {
		k_sleep(K_FOREVER);
	}
}
```
