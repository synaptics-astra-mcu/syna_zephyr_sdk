/*
 * Copyright (c) 2026 Synaptics Incorporated
 *
 * SPDX-License-Identifier: Apache-2.0
 */

#define DT_DRV_COMPAT ovti_ov02c10

#include <zephyr/drivers/pinctrl.h>
#include <zephyr/kernel.h>
#include <zephyr/device.h>
#include <zephyr/devicetree/port-endpoint.h>
#include <zephyr/logging/log.h>
#include <zephyr/drivers/i2c.h>
#include <zephyr/drivers/gpio.h>
#include <zephyr/drivers/video.h>
#include <zephyr/drivers/video-controls.h>
#include <zephyr/dt-bindings/video/video-interfaces.h>
#include <zephyr/sys/util.h>
#include <zephyr/sys/sys_io.h>

#include "video_common.h"
#include "video_ctrls.h"
#include "video_device.h"

LOG_MODULE_REGISTER(video_ov02c10, CONFIG_VIDEO_LOG_LEVEL);

#define OV02C10_REG8(addr)		((addr) | VIDEO_REG_ADDR16_DATA8)
#define OV02C10_REG16(addr)		((addr) | VIDEO_REG_ADDR16_DATA16_BE)

#define CHIP_ID_REG			0x300a
#define SW_RESET_REG			0x0103
#define SYS_CTRL0_REG			0x0100

#define CHIP_ID				0x5602U
#define SYS_CTRL0_STBY			0x00
#define SYS_CTRL0_START			0x01

/*
 * Delay (ms) after power/reset deassert before sensor access.
 * Board-dependent; keep centralized for easy tuning.
 */
#define OV02C10_DELAY_GPIO_CONFIG_TO_DEASSERT_MS    5

#define OV02C10_VIDEO_FORMAT_CAP(width, height, format) \
	{                                                \
		.pixelformat = (format),                   \
		.width_min = (width),                      \
		.width_max = (width),                      \
		.height_min = (height),                    \
		.height_max = (height),                    \
		.width_step = 0,                           \
		.height_step = 0,                          \
	}

struct ov02c10_config {
	struct i2c_dt_spec i2c;

	/* Board control hooks (used by SR100 RDK DTS). */
	const struct pinctrl_dev_config *pcfg;
#if DT_ANY_INST_HAS_PROP_STATUS_OKAY(powerdown_gpios)
	struct gpio_dt_spec powerdown_gpio;
#endif

#if DT_ANY_INST_HAS_PROP_STATUS_OKAY(shutdown_gpios)
	struct gpio_dt_spec shutdown_gpio;
#endif

#if DT_ANY_INST_HAS_PROP_STATUS_OKAY(mclk_control_reg)
	uint32_t mclk_control_reg;
#endif

#if DT_ANY_INST_HAS_PROP_STATUS_OKAY(mclk_control_reg)
	uint32_t mclk_control_val;
#endif
	uint32_t power_up_delay_ms;
	uint32_t mclk_settle_delay_ms;
	int bus_type;
};

struct ov02c10_ctrls {
	struct video_ctrl pixel_rate;
};

struct ov02c10_mode_config {
	uint16_t width;
	uint16_t height;
	uint8_t bits_per_pixel;
	uint32_t pixelformat;
	const struct video_reg16 *regs;
	size_t num_regs;
	uint32_t fps;
	uint64_t pixel_rate;
};

struct ov02c10_data {
	struct ov02c10_ctrls ctrls;
	struct video_format fmt;
	const struct ov02c10_mode_config *cur_mode;
	bool initialized;
	bool streaming;
};

static int ov02c10_apply_board_config(const struct device *dev)
{
	const struct ov02c10_config *cfg = dev->config;
	int ret;

	if (cfg->pcfg != NULL) {
		ret = pinctrl_apply_state(cfg->pcfg, PINCTRL_STATE_DEFAULT);
		if (ret != 0) {
			LOG_ERR("Failed to apply pinctrl default state: %d",
				ret);
			return ret;
		}
		LOG_INF("pinctrl default state applied");
	}

#if DT_ANY_INST_HAS_PROP_STATUS_OKAY(powerdown_gpios)
	if (cfg->powerdown_gpio.port != NULL) {
		if (!gpio_is_ready_dt(&cfg->powerdown_gpio)) {
			LOG_ERR("Power down GPIO device not ready");
			return -ENODEV;
		}

		ret = gpio_pin_configure_dt(&cfg->powerdown_gpio,
			GPIO_OUTPUT_ACTIVE);
		if (ret < 0) {
			LOG_ERR("Unable to configure power down GPIO: %d", ret);
			return ret;
		}
		LOG_INF("Power down GPIO active: %s pin %u",
			cfg->powerdown_gpio.port->name,
			cfg->powerdown_gpio.pin);
	}
#endif

#if DT_ANY_INST_HAS_PROP_STATUS_OKAY(shutdown_gpios)
	if (cfg->shutdown_gpio.port != NULL) {
		if (!gpio_is_ready_dt(&cfg->shutdown_gpio)) {
			LOG_ERR("Shutdown GPIO device not ready");
			return -ENODEV;
		}

		ret = gpio_pin_configure_dt(&cfg->shutdown_gpio,
			GPIO_OUTPUT_ACTIVE);
		if (ret < 0) {
			LOG_ERR("Unable to configure shutdown GPIO: %d", ret);
			return ret;
		}
		LOG_INF("Shutdown GPIO active: %s pin %u",
			cfg->shutdown_gpio.port->name, cfg->shutdown_gpio.pin);
	}
#endif

#if DT_ANY_INST_HAS_PROP_STATUS_OKAY(mclk_control_reg) && \
			DT_ANY_INST_HAS_PROP_STATUS_OKAY(mclk_control_val)
	if (cfg->power_up_delay_ms != 0U) {
		k_msleep(cfg->power_up_delay_ms);
	}

	if (cfg->mclk_control_reg != 0U) {
		uint32_t val;

		sys_write32(cfg->mclk_control_val, cfg->mclk_control_reg);
		val = sys_read32(cfg->mclk_control_reg);
		LOG_INF("MCLK ctrl: wrote 0x%08x to 0x%08x, read back 0x%08x",
			cfg->mclk_control_val, cfg->mclk_control_reg, val);
	}

	if (cfg->mclk_settle_delay_ms != 0U) {
		k_msleep(cfg->mclk_settle_delay_ms);
	}
#endif
	return 0;
}

/*
 * OV02C10 480x270 RAW8 (SBGGR8), ~3fps, 1lane, MIPI CSI-2.
 *
 * Register value table for the OV2C10 to operate in 480x270 resolution,
 * 3fps, RAW8 format.
 */
static const struct video_reg16 ov02c10_mode_480x270_regs[] = {
	{0x0100, 0x00},
	{0x0103, 0x01},
	{0x0301, 0x08},
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	{0x430d, 0x00},
	/* clk_post fix - START: fix EOF detection failure */
	{0x4802, 0x20},
	{0x4820, 0x03},
	{0x4821, 0x84},
	/* clk_post fix - END */
	{0x4806, 0x00},
	{0x4813, 0x00},
	{0x4837, 0x0a},
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	{0x0100, 0x01},
};

/*
 * OV02C10 640x480 RAW8 (SBGGR8), ~3fps, 1lane, MIPI CSI-2.
 *
 * Register table for OV2C10 640x480 operation: 3fps, RAW8.
 */
static const struct video_reg16 ov02c10_mode_640x480_regs[] = {
	{0x0100, 0x00},
	{0x0103, 0x01},
	{0x0301, 0x08},
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	{0x0100, 0x01},
};

/*
 * OV02C10 1920x1080 RAW10 (SBGGR10), ~60fps, 1lane, MIPI CSI-2.
 *
 * Register table for OV2C10 1920x1080 operation: 60fps, RAW10.
 */
static const struct video_reg16 ov02c10_mode_1920x1080_regs[] = {
	{0x0100, 0x00},
	{0x0103, 0x01},
	{0x0301, 0x08},
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	{0x0100, 0x01},
};

/*
 * OV02C10 480x270 RAW10 packed (SBGGR10P), ~60fps, 1lane, MIPI CSI-2.
 *
 * Register table for OV2C10 480x270 operation: 60fps, RAW10 packed.
 */
static const struct video_reg16 ov02c10_mode_480x270_raw10_regs[] = {
	{0x0100, 0x00},
	{0x0103, 0x01},
	{0x0301, 0x08},
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	{0x0100, 0x01},
};

/*
 * OV02C10 640x480 RAW10 packed (SBGGR10P), ~60fps, 1lane, MIPI CSI-2.
 *
 * Register table for OV2C10 640x480 operation: 60fps, RAW10 packed.
 */
static const struct video_reg16 ov02c10_mode_640x480_raw10_regs[] = {
	{0x0100, 0x00},
	{0x0103, 0x01},
	{0x0301, 0x08},
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	{0x0100, 0x01},
};

/*
 * Sensor mode table. Each entry pairs a resolution/format/FPS combination
 * with its register sequence and pixel-rate metadata.
 *
 * DPHY rate = pixel_rate * bits_per_pixel
 */
static const struct ov02c10_mode_config ov02c10_modes[] = {
	/* 480x270 RAW8, ~3fps */
	{
		.width = 480,
		.height = 270,
		.bits_per_pixel = 8,
		.pixelformat = VIDEO_PIX_FMT_SBGGR8,
		.regs = ov02c10_mode_480x270_regs,
		.num_regs = ARRAY_SIZE(ov02c10_mode_480x270_regs),
		.fps = 3,
		.pixel_rate = 20000000ULL,
	},
	/* 640x480 RAW8, ~3fps */
	{
		.width = 640,
		.height = 480,
		.bits_per_pixel = 8,
		.pixelformat = VIDEO_PIX_FMT_SBGGR8,
		.regs = ov02c10_mode_640x480_regs,
		.num_regs = ARRAY_SIZE(ov02c10_mode_640x480_regs),
		.fps = 3,
		.pixel_rate = 17500000ULL,
	},
	/* 1920x1080 RAW10 packed, ~60fps */
	{
		.width = 1920,
		.height = 1080,
		.bits_per_pixel = 10,
		.pixelformat = VIDEO_PIX_FMT_SBGGR10P,
		.regs = ov02c10_mode_1920x1080_regs,
		.num_regs = ARRAY_SIZE(ov02c10_mode_1920x1080_regs),
		.fps = 60,
		.pixel_rate = 150000000ULL,
	},
	/* 480x270 RAW10 packed, ~60fps */
	{
		.width = 480,
		.height = 270,
		.bits_per_pixel = 10,
		.pixelformat = VIDEO_PIX_FMT_SBGGR10P,
		.regs = ov02c10_mode_480x270_raw10_regs,
		.num_regs = ARRAY_SIZE(ov02c10_mode_480x270_raw10_regs),
		.fps = 60,
		.pixel_rate = 150000000ULL,
	},
	/* 640x480 RAW10 packed, ~60fps */
	{
		.width = 640,
		.height = 480,
		.bits_per_pixel = 10,
		.pixelformat = VIDEO_PIX_FMT_SBGGR10P,
		.regs = ov02c10_mode_640x480_raw10_regs,
		.num_regs = ARRAY_SIZE(ov02c10_mode_640x480_raw10_regs),
		.fps = 60,
		.pixel_rate = 150000000ULL,
	},
};

_Static_assert(ARRAY_SIZE(ov02c10_modes) <= 0xFFU,
		"ov02c10_modes too large for uint8_t loop index");

/*
 * Advertised format capabilities returned by get_caps().
 * Must stay in sync with ov02c10_modes[].
 * 1920x1080 is RAW10 only; RAW8 (SBGGR8) is available at 480x270 and
 * 640x480 only. set_fmt() validates requests against this table first.
 *
 * WARNING: Each entry in ov02c10_fmts must have a corresponding entry in
 * ov02c10_modes with matching width, height, and pixelformat. Mismatches
 * cause format validation to accept formats that cannot be programmed.
 * When adding new modes, update both arrays to avoid drift.
 */
static const struct video_format_cap ov02c10_fmts[] = {
	OV02C10_VIDEO_FORMAT_CAP(480, 270, VIDEO_PIX_FMT_SBGGR8),
	OV02C10_VIDEO_FORMAT_CAP(640, 480, VIDEO_PIX_FMT_SBGGR8),
	OV02C10_VIDEO_FORMAT_CAP(1920, 1080, VIDEO_PIX_FMT_SBGGR10P),
	OV02C10_VIDEO_FORMAT_CAP(480, 270, VIDEO_PIX_FMT_SBGGR10P),
	OV02C10_VIDEO_FORMAT_CAP(640, 480, VIDEO_PIX_FMT_SBGGR10P),
	{0},
};

/*
 * Build-time check: sync caps and modes entry counts. This is a
 * size-only guard; it does not validate semantic pairing across tables.
 */
_Static_assert(ARRAY_SIZE(ov02c10_fmts) - 1 == ARRAY_SIZE(ov02c10_modes),
		"ov02c10_fmts and ov02c10_modes entry count mismatch");

static inline const struct ov02c10_mode_config *
ov02c10_find_mode(const struct video_format *fmt)
{
	uint8_t i;

	for (i = 0; i < ARRAY_SIZE(ov02c10_modes); i++) {
		if (fmt->width == ov02c10_modes[i].width &&
		    fmt->height == ov02c10_modes[i].height &&
		    fmt->pixelformat == ov02c10_modes[i].pixelformat) {
			return &ov02c10_modes[i];
		}
	}
	return NULL;
}

static const struct ov02c10_mode_config *
ov02c10_find_nearest_mode_by_frmival(const struct video_format *fmt,
					const struct video_frmival *frmival)
{
	const struct ov02c10_mode_config *selected_mode = NULL;
	uint64_t best_error = UINT64_MAX;
	uint8_t i;

	/*
	 * Each supported format maps to a single FPS entry in ov02c10_modes[].
	 * Keep nearest-match selection for correct behavior if frame-rate
	 * variants are added later. One discrete frame interval per format.
	 */

	for (i = 0; i < ARRAY_SIZE(ov02c10_modes); i++) {
		uint64_t requested_frames;
		uint64_t candidate_error;

		if (ov02c10_modes[i].width != fmt->width ||
		    ov02c10_modes[i].height != fmt->height ||
		    ov02c10_modes[i].pixelformat != fmt->pixelformat) {
			continue;
		}

		if (ov02c10_modes[i].fps == 0U) {
			continue;
		}

	requested_frames = (uint64_t)frmival->numerator * ov02c10_modes[i].fps;
	candidate_error = (requested_frames > frmival->denominator) ?
				(requested_frames - frmival->denominator) :
				(frmival->denominator - requested_frames);

		if (selected_mode == NULL || candidate_error < best_error) {
			selected_mode = &ov02c10_modes[i];
			best_error = candidate_error;
		}
	}

	return selected_mode;
}

static int ov02c10_set_frmival(const struct device *dev,
			       struct video_frmival *frmival)
{
	struct ov02c10_data *drv_data = dev->data;
	const struct ov02c10_config *cfg = dev->config;
	const struct ov02c10_mode_config *selected_mode;
	int ret = 0;

	if (!drv_data->initialized) {
		return -ENODEV;
	}

	if (drv_data->streaming) {
		return -EBUSY;
	}

	if (drv_data->cur_mode == NULL) {
		return -ENODEV;
	}

	if (frmival->numerator == 0U || frmival->denominator == 0U) {
		return -EINVAL;
	}

	selected_mode = ov02c10_find_nearest_mode_by_frmival(
		&drv_data->fmt, frmival);

	if (selected_mode == NULL) {
		return -ENOTSUP;
	}

	if (drv_data->cur_mode != selected_mode) {
		ret = video_write_cci_multiregs16(&cfg->i2c,
			selected_mode->regs, selected_mode->num_regs);
		if (ret < 0) {
			LOG_ERR("Unable to apply OV02C10 mode %ux%u",
				selected_mode->width,
				selected_mode->height);
			return ret;
		}

		drv_data->cur_mode = selected_mode;
	}

	drv_data->ctrls.pixel_rate.val64 = selected_mode->pixel_rate;
	frmival->numerator = 1U;
	frmival->denominator = selected_mode->fps;
	return ret;
}

static int ov02c10_set_fmt(const struct device *dev,
			   struct video_format *fmt)
{
	struct ov02c10_data *drv_data = dev->data;
	const struct ov02c10_config *cfg = dev->config;
	const struct ov02c10_mode_config *mode;
	struct video_frmival def_frmival;
	size_t caps_idx;
	int ret = 0;

	if (!drv_data->initialized) {
		ret = -ENODEV;
		return ret;
	}

	/* Validate against the advertised caps table */
	ret = video_format_caps_index(ov02c10_fmts, fmt, &caps_idx);
	if (ret < 0) {
		LOG_ERR("Unsupported format %s %ux%u",
			VIDEO_FOURCC_TO_STR(fmt->pixelformat),
			fmt->width, fmt->height);
		ret = -ENOTSUP;
		return ret;
	}

	mode = ov02c10_find_mode(fmt);
	if (mode == NULL) {
		LOG_ERR("No mode config for format %s %ux%u",
			VIDEO_FOURCC_TO_STR(fmt->pixelformat),
			fmt->width, fmt->height);
		ret = -EINVAL;
		return ret;
	}

	if (drv_data->cur_mode == mode &&
	    drv_data->fmt.width == fmt->width &&
	    drv_data->fmt.height == fmt->height &&
	    drv_data->fmt.pixelformat == fmt->pixelformat &&
	    drv_data->fmt.type == fmt->type) {
		return 0;
	}

	ret = video_write_cci_multiregs16(&cfg->i2c, mode->regs,
		mode->num_regs);
	if (ret < 0) {
		LOG_ERR("Unable to apply OV02C10 mode %ux%u", mode->width,
			mode->height);
		return ret;
	}

	drv_data->cur_mode = mode;
	drv_data->fmt = *fmt;

	if (mode->bits_per_pixel == 0U) {
		LOG_ERR("Invalid bits_per_pixel for %s %ux%u",
			VIDEO_FOURCC_TO_STR(fmt->pixelformat),
			fmt->width, fmt->height);
		ret = -EINVAL;
		return ret;
	}

	drv_data->ctrls.pixel_rate.val64 = mode->pixel_rate;

	def_frmival.numerator = 1U;
	def_frmival.denominator = mode->fps;
	ret = ov02c10_set_frmival(dev, &def_frmival);
	if (ret < 0) {
		LOG_ERR("Unable to set OV02C10 frame interval for %ux%u",
			mode->width, mode->height);
	}

	return ret;
}

static int ov02c10_get_fmt(const struct device *dev,
			   struct video_format *fmt)
{
	struct ov02c10_data *drv_data = dev->data;

	*fmt = drv_data->fmt;

	return 0;
}

static int ov02c10_get_caps(const struct device *dev,
			    struct video_caps *caps)
{
	ARG_UNUSED(dev);

	/* Validate buffer type - sensor source only supports OUTPUT buffers */
	if (caps->type != VIDEO_BUF_TYPE_OUTPUT) {
		LOG_ERR("Unsupported buffer type: %u (expected OUTPUT)",
			caps->type);
		return -ENOTSUP;
	}

	caps->format_caps = ov02c10_fmts;
	caps->min_vbuf_count = 0;
	return 0;
}

static int ov02c10_set_stream(const struct device *dev,
			      bool enable,
			      enum video_buf_type type)
{
	const struct ov02c10_config *cfg = dev->config;
	struct ov02c10_data *drv_data = dev->data;
	int ret = 0;

	/* Validate buffer type - sensor source only supports OUTPUT buffers */
	if (type != VIDEO_BUF_TYPE_OUTPUT) {
		LOG_ERR("Unsupported buffer type: %u (expected OUTPUT)",
			type);
		return -ENOTSUP;
	}

	if (!drv_data->initialized) {
		return -ENODEV;
	}

	if (drv_data->streaming == enable) {
		return 0;
	}

	ret = video_write_cci_reg(&cfg->i2c, OV02C10_REG8(SYS_CTRL0_REG),
				 enable ? SYS_CTRL0_START : SYS_CTRL0_STBY);
	if (ret != 0) {
		return ret;
	}

	drv_data->streaming = enable;
	return ret;
}

static int ov02c10_get_frmival(const struct device *dev,
			       struct video_frmival *frmival)
{
	struct ov02c10_data *drv_data = dev->data;

	if (!drv_data->initialized) {
		return -ENODEV;
	}

	if (drv_data->cur_mode == NULL) {
		return -EIO;
	}

	frmival->numerator = 1;
	frmival->denominator = drv_data->cur_mode->fps;

	return 0;
}

static int ov02c10_enum_frmival(const struct device *dev,
				struct video_frmival_enum *fie)
{
	uint32_t match_index = 0U;
	uint8_t i;

	ARG_UNUSED(dev);

	if (fie->format == NULL) {
		return -EINVAL;
	}

	for (i = 0; i < ARRAY_SIZE(ov02c10_modes); i++) {
		if (ov02c10_modes[i].width != fie->format->width ||
		    ov02c10_modes[i].height != fie->format->height ||
		    ov02c10_modes[i].pixelformat != fie->format->pixelformat) {
			continue;
		}

		if (match_index != fie->index) {
			match_index++;
			continue;
		}

		fie->type = VIDEO_FRMIVAL_TYPE_DISCRETE;
		fie->discrete.numerator = 1;
		fie->discrete.denominator = ov02c10_modes[i].fps;

		return 0;
	}

	return -ENOTSUP;
}

static DEVICE_API(video, ov02c10_driver_api) = {
	.set_format = ov02c10_set_fmt,
	.get_format = ov02c10_get_fmt,
	.get_caps = ov02c10_get_caps,
	.set_stream = ov02c10_set_stream,
	.set_frmival = ov02c10_set_frmival,
	.get_frmival = ov02c10_get_frmival,
	.enum_frmival = ov02c10_enum_frmival,
};

static int ov02c10_init_controls(const struct device *dev)
{
	struct ov02c10_data *drv_data = dev->data;
	uint64_t min_rate = UINT64_MAX;
	uint64_t max_rate = 0;
	uint8_t i;
	int ret;

	for (i = 0; i < ARRAY_SIZE(ov02c10_modes); i++) {
		if (ov02c10_modes[i].pixel_rate < min_rate) {
			min_rate = ov02c10_modes[i].pixel_rate;
		}

		if (ov02c10_modes[i].pixel_rate > max_rate) {
			max_rate = ov02c10_modes[i].pixel_rate;
		}
	}

	ret = video_init_ctrl(
		&drv_data->ctrls.pixel_rate, dev, VIDEO_CID_PIXEL_RATE,
		(struct video_ctrl_range){
			.min64 = min_rate,
			.max64 = max_rate,
			.step64 = 1,
			.def64 = ov02c10_modes[0].pixel_rate,
		});

	return ret;
}

static int ov02c10_init(const struct device *dev)
{
	const struct ov02c10_config *cfg = dev->config;
	struct ov02c10_data *drv_data = dev->data;
	struct video_format fmt = {
		.type = VIDEO_BUF_TYPE_OUTPUT,
		.pixelformat = ov02c10_modes[0].pixelformat,
		.width = ov02c10_modes[0].width,
		.height = ov02c10_modes[0].height,
	};
	uint32_t chip_id = 0;
	int ret;

	drv_data->initialized = false;
	drv_data->streaming = false;

	if (!device_is_ready(cfg->i2c.bus)) {
		LOG_ERR("Bus device is not ready");
		return -ENODEV;
	}

	ret = ov02c10_apply_board_config(dev);
	if (ret < 0) {
		return ret;
	}

	/* Small guard delay between GPIO/MCLK enable and first I2C access. */
	k_sleep(K_MSEC(OV02C10_DELAY_GPIO_CONFIG_TO_DEASSERT_MS));

	ret = video_write_cci_reg(&cfg->i2c, OV02C10_REG8(SW_RESET_REG), 0x01);
	if (ret < 0) {
		LOG_ERR("Unable to perform software reset");
		return ret;
	}
	LOG_DBG("Software reset issued");

	ret = video_read_cci_reg(&cfg->i2c, OV02C10_REG16(CHIP_ID_REG),
		&chip_id);
	if (ret < 0) {
		LOG_ERR("Unable to read sensor chip ID, ret = %d", ret);
		return ret;
	}

	if (chip_id != CHIP_ID) {
		LOG_DBG("Unexpected OV02C10 chip ID: 0x%04x expected 0x%04x",
			chip_id, CHIP_ID);
		return -ENODEV;
	}
	LOG_DBG("OV02C10 chip ID verified: 0x%04x", chip_id);

	/* Validate bus type - driver only supports CSI-2 D-PHY */
	if (cfg->bus_type != VIDEO_BUS_TYPE_CSI2_DPHY) {
		LOG_ERR("Unsupported bus type: %u. expected CSI-2 D-PHY.",
			cfg->bus_type);
		return -ENOTSUP;
	}


	ret = ov02c10_init_controls(dev);
	if (ret < 0) {
		LOG_ERR("Unable to initialize controls");
		return ret;
	}
	LOG_DBG("Controls initialized");

	drv_data->initialized = true;

	ret = ov02c10_set_fmt(dev, &fmt);
	if (ret < 0) {
		LOG_ERR("Unable to configure default OV02C10 mode");
		drv_data->initialized = false;
		return ret;
	}
	LOG_DBG("Default format configured: %ux%u pixelformat=0x%08x",
		fmt.width, fmt.height, fmt.pixelformat);

	LOG_DBG("OV02C10 sensor initialized successfully");
	return 0;
}
#if DT_ANY_INST_HAS_PROP_STATUS_OKAY(powerdown_gpios)
#define OV02C10_GET_POWERDOWN_GPIO(n) \
	.powerdown_gpio = GPIO_DT_SPEC_INST_GET_OR(n, powerdown_gpios, {0}),
#else
#define OV02C10_GET_POWERDOWN_GPIO(n)
#endif

#if DT_ANY_INST_HAS_PROP_STATUS_OKAY(shutdown_gpios)
#define OV02C10_GET_SHUTDOWN_GPIO(n) \
	.shutdown_gpio = GPIO_DT_SPEC_INST_GET_OR(n, shutdown_gpios, {0}),
#else
#define OV02C10_GET_SHUTDOWN_GPIO(n)
#endif

#if DT_ANY_INST_HAS_PROP_STATUS_OKAY(mclk_control_reg)
#define OV02C10_GET_MCLK_CONTROL_REG(n) \
	.mclk_control_reg = DT_INST_PROP_OR(n, mclk_control_reg, 0),
#else
#define OV02C10_GET_MCLK_CONTROL_REG(n)
#endif

#if DT_ANY_INST_HAS_PROP_STATUS_OKAY(mclk_control_val)
#define OV02C10_GET_MCLK_CONTROL_VAL(n) \
	.mclk_control_val = DT_INST_PROP_OR(n, mclk_control_val, 0),
#else
#define OV02C10_GET_MCLK_CONTROL_VAL(n)
#endif

#define OV02C10_INIT_PRIORITY \
	UTIL_DEC(UTIL_DEC(UTIL_DEC(CONFIG_VIDEO_OV02C10_INIT_PRIORITY)))

#define OV02C10_INIT(n) \
	COND_CODE_1(DT_INST_NODE_HAS_PROP(n, pinctrl_0), \
		(PINCTRL_DT_INST_DEFINE(n)), ()); \
	static struct ov02c10_data ov02c10_data_##n; \
	static const struct ov02c10_config ov02c10_cfg_##n = { \
		.i2c = I2C_DT_SPEC_INST_GET(n), \
		.pcfg = COND_CODE_1(DT_INST_NODE_HAS_PROP(n, pinctrl_0), \
			(PINCTRL_DT_INST_DEV_CONFIG_GET(n)), (NULL)), \
		.bus_type = DT_PROP_OR(DT_INST_ENDPOINT_BY_ID(n, 0, 0), \
			bus_type, VIDEO_BUS_TYPE_CSI2_DPHY), \
		OV02C10_GET_POWERDOWN_GPIO(n) \
		OV02C10_GET_SHUTDOWN_GPIO(n) \
		OV02C10_GET_MCLK_CONTROL_REG(n) \
		OV02C10_GET_MCLK_CONTROL_VAL(n) \
		.power_up_delay_ms = DT_INST_PROP_OR(n, power_up_delay_ms, 0), \
		.mclk_settle_delay_ms = DT_INST_PROP_OR(n, \
			mclk_settle_delay_ms, 0), \
	}; \
	DEVICE_DT_INST_DEFINE(n, &ov02c10_init, NULL, &ov02c10_data_##n, \
		&ov02c10_cfg_##n, POST_KERNEL, \
		OV02C10_INIT_PRIORITY, &ov02c10_driver_api); \
	VIDEO_DEVICE_DEFINE(ov02c10_##n, DEVICE_DT_INST_GET(n), NULL);

DT_INST_FOREACH_STATUS_OKAY(OV02C10_INIT)
