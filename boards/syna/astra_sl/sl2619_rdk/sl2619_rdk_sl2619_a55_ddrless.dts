/*
 * Copyright (c) 2026 Synaptics Incorporated
 * Author: Jisheng Zhang <jszhang@kernel.org>
 *
 * SPDX-License-Identifier: Apache-2.0
 */

/dts-v1/;

#include "syna/sl2611_m52perif_s.dtsi"
#include "sl2619_rdk_sl2619_a55_common.dtsi"

/ {
	model = "Synaptics SL2619 RDK A55 DDRLESS variant";

	chosen {
		zephyr,console = &uart0;
		zephyr,shell-uart = &uart0;
		zephyr,sram = &lram;
		zephyr,flash = &flash;
	};

	flash: memory@e2300000 {
		reg = <0xe2300000 DT_SIZE_M(13)>;
	};
};
