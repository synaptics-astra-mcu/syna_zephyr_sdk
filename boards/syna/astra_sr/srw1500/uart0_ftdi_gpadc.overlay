/*
 * Copyright (c) 2026 Synaptics Incorporated
 *
 * SPDX-License-Identifier: Apache-2.0
 */

&uart0 {
    pinctrl-0 = <&RF_SW_CTRL_6__GPIO20 &RF_SW_CTRL_5__GPIO21
                 &GPADC_IN4__UART0_TX &GPADC_IN6__UART0_RX>;
};
