/*
 * Copyright (c) 2026 Synaptics Incorporated
 *
 * SPDX-License-Identifier: Apache-2.0
 */

#include <zephyr/device.h>
#include <zephyr/drivers/reset.h>
#include <zephyr/dt-bindings/reset/syna_sr100_reset.h>
#include <zephyr/init.h>
#include <zephyr/kernel.h>
#include <zephyr/logging/log.h>
#include <zephyr/sys/sys_io.h>

LOG_MODULE_REGISTER(board_sr100_rdk, LOG_LEVEL_DBG);

#define SR100_GLOBAL_BASE_ADDRESS                           0x50330000U
#define SR100_GLOBAL_PERIF_XSPI_CTRL0_OFFSET               0xA5CU
#define SR100_GLOBAL_PERIF_XSPI_CTRL1_OFFSET               0xA60U
#define SR100_GLOBAL_PERIF_XSPI_CTRL2_OFFSET               0xA64U
#define SR100_GLOBAL_PERIF_XSPI_CTRL3_OFFSET               0xA68U
#define SR100_GLOBAL_PERIF_XSPI_RB_VALID_TIME_OFFSET       0xA6CU
#define SR100_GLOBAL_PERIF_XSPI_PHY_DQ_TIMING_OFFSET       0xA70U
#define SR100_GLOBAL_PERIF_XSPI_PHY_DQS_TIMING_OFFSET      0xA74U
#define SR100_GLOBAL_PERIF_XSPI_PHY_GATE_LPBK_CTRL_OFFSET  0xA78U
#define SR100_GLOBAL_PERIF_XSPI_PHY_DLL_MASTER_CTRL_OFFSET 0xA7CU
#define SR100_GLOBAL_PERIF_XSPI_PHY_DLL_SLAVE_CTRL_OFFSET  0xA80U
#define SR100_GLOBAL_PERIF_XSPI_STATUS_OFFSET              0xA84U
#define SR100_GLOBAL_PERIF_XSPI_STATUS_INIT_COMP           BIT(0)
#define SR100_GLOBAL_PERIF_XSPI_CTRL1_DQS_REMOD_EN         BIT(1)

#define SR100_XSPI_INIT_READ_P1_MB_DUMMY_CNT 7U
#define SR100_XSPI_INIT_READ_P1_DUMMY_CNT    6U
#define SR100_XSPI_INIT_READ_P1_CMD_VAL      0xEBU
#define SR100_XSPI_INIT_READ_P1_ADDR_CNT     3U
#define SR100_XSPI_INIT_READ_P1_ADDR_IOS     2U
#define SR100_XSPI_INIT_READ_P1_DATA_IOS     2U
#define SR100_XSPI_INIT_RB_VALID_TIME        0x0000000AU
#define SR100_XSPI_INIT_PHY_DQ_TIMING        0x00000101U
#define SR100_XSPI_INIT_PHY_DQS_TIMING       0x00700404U
#define SR100_XSPI_INIT_PHY_GATE_LPBK_CTRL   0x00200030U
#define SR100_XSPI_INIT_PHY_DLL_MASTER_CTRL  0x00800000U
#define SR100_XSPI_INIT_PHY_DLL_SLAVE_CTRL   0x00007801U

#define SR100_RESET_NODE DT_NODELABEL(reset)

static void xspi_bootstrap_init(void)
{
	uint32_t ctrl1;
	uint32_t ctrl2;
	uint32_t ctrl3;

	ctrl2 = (SR100_XSPI_INIT_READ_P1_MB_DUMMY_CNT << 1) |
		(SR100_XSPI_INIT_READ_P1_DUMMY_CNT << 7);
	ctrl3 = (SR100_XSPI_INIT_READ_P1_CMD_VAL << 0) |
		(SR100_XSPI_INIT_READ_P1_ADDR_CNT << 11) |
		(SR100_XSPI_INIT_READ_P1_ADDR_IOS << 14) |
		(SR100_XSPI_INIT_READ_P1_DATA_IOS << 17);

	sys_write32(SR100_XSPI_INIT_RB_VALID_TIME,
		    SR100_GLOBAL_BASE_ADDRESS + SR100_GLOBAL_PERIF_XSPI_RB_VALID_TIME_OFFSET);
	sys_write32(BIT(1),
		    SR100_GLOBAL_BASE_ADDRESS + SR100_GLOBAL_PERIF_XSPI_CTRL0_OFFSET);

	ctrl1 = sys_read32(SR100_GLOBAL_BASE_ADDRESS + SR100_GLOBAL_PERIF_XSPI_CTRL1_OFFSET);
	ctrl1 |= SR100_GLOBAL_PERIF_XSPI_CTRL1_DQS_REMOD_EN;
	sys_write32(ctrl1,
		    SR100_GLOBAL_BASE_ADDRESS + SR100_GLOBAL_PERIF_XSPI_CTRL1_OFFSET);

	sys_write32(ctrl3,
		    SR100_GLOBAL_BASE_ADDRESS + SR100_GLOBAL_PERIF_XSPI_CTRL3_OFFSET);
	sys_write32(ctrl2,
		    SR100_GLOBAL_BASE_ADDRESS + SR100_GLOBAL_PERIF_XSPI_CTRL2_OFFSET);
	sys_write32(SR100_XSPI_INIT_PHY_DQ_TIMING,
		    SR100_GLOBAL_BASE_ADDRESS + SR100_GLOBAL_PERIF_XSPI_PHY_DQ_TIMING_OFFSET);
	sys_write32(SR100_XSPI_INIT_PHY_DQS_TIMING,
		    SR100_GLOBAL_BASE_ADDRESS + SR100_GLOBAL_PERIF_XSPI_PHY_DQS_TIMING_OFFSET);
	sys_write32(SR100_XSPI_INIT_PHY_GATE_LPBK_CTRL,
		    SR100_GLOBAL_BASE_ADDRESS + SR100_GLOBAL_PERIF_XSPI_PHY_GATE_LPBK_CTRL_OFFSET);
	sys_write32(SR100_XSPI_INIT_PHY_DLL_MASTER_CTRL,
		    SR100_GLOBAL_BASE_ADDRESS + SR100_GLOBAL_PERIF_XSPI_PHY_DLL_MASTER_CTRL_OFFSET);
	sys_write32(SR100_XSPI_INIT_PHY_DLL_SLAVE_CTRL,
		    SR100_GLOBAL_BASE_ADDRESS + SR100_GLOBAL_PERIF_XSPI_PHY_DLL_SLAVE_CTRL_OFFSET);
}

static int xspi_wait_init_complete(void)
{
	if (!WAIT_FOR(sys_read32(SR100_GLOBAL_BASE_ADDRESS + SR100_GLOBAL_PERIF_XSPI_STATUS_OFFSET) &
		      SR100_GLOBAL_PERIF_XSPI_STATUS_INIT_COMP, 1000, k_busy_wait(1000))) {
		LOG_ERR("Timeout while waiting for SR100 XSPI init completion");
		return -ETIMEDOUT;
	}

	return 0;
}

static int board_init(void)
{
	const struct device *reset_dev = DEVICE_DT_GET(SR100_RESET_NODE);
	int ret;

	if (!device_is_ready(reset_dev)) {
		LOG_ERR("SR100 reset controller is not ready");
		return -ENODEV;
	}

	xspi_bootstrap_init();

	ret = reset_line_toggle(reset_dev, SYNA_XSPI_RST);
	if (ret < 0) {
		LOG_ERR("Failed to toggle SR100 XSPI reset (%d)", ret);
		return ret;
	}

	return xspi_wait_init_complete();
}

SYS_INIT(board_init, PRE_KERNEL_2, CONFIG_KERNEL_INIT_PRIORITY_DEFAULT);
