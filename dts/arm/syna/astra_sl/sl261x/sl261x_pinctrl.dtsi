/*
 * Copyright (c) 2026 Synaptics Incorporated
 *
 * SPDX-License-Identifier: Apache-2.0
 */

/* /dts-v1/; */
#include <zephyr/dt-bindings/pinctrl/syna-sl261x-pinctrl.h>

&pinctrl_gbl {
	/omit-if-no-ref/ gpio_23: gpio-23 {
		pinmux = <SLXXX_GBL_PINMUX(0x0, 0, 0, 0x00)>;
	};

	/omit-if-no-ref/ tw2_scl: tw2-scl {
		pinmux = <SLXXX_GBL_PINMUX(0x0, 0, 1, 0x00)>;
	};

	/omit-if-no-ref/ rgmii_mdc: rgmii-mdc {
		pinmux = <SLXXX_GBL_PINMUX(0x0, 0, 2, 0x00)>;
	};

	/omit-if-no-ref/ key_row0: key-row0 {
		pinmux = <SLXXX_GBL_PINMUX(0x0, 0, 3, 0x00)>;
	};

	/omit-if-no-ref/ spi3_ss2n: spi3-ss2n {
		pinmux = <SLXXX_GBL_PINMUX(0x0, 0, 5, 0x00)>;
	};

	/omit-if-no-ref/ key_col3: key-col3 {
		pinmux = <SLXXX_GBL_PINMUX(0x0, 0, 6, 0x00)>;
	};

	/omit-if-no-ref/ dbg_out4: dbg-out4 {
		pinmux = <SLXXX_GBL_PINMUX(0x0, 0, 7, 0x00)>;
	};

	/omit-if-no-ref/ gpio_24: gpio-24 {
		pinmux = <SLXXX_GBL_PINMUX(0x0, 3, 0, 0x04)>;
	};

	/omit-if-no-ref/ tw2_sda: tw2-sda {
		pinmux = <SLXXX_GBL_PINMUX(0x0, 3, 1, 0x04)>;
	};

	/omit-if-no-ref/ rgmii_mdio: rgmii-mdio {
		pinmux = <SLXXX_GBL_PINMUX(0x0, 3, 2, 0x04)>;
	};

	/omit-if-no-ref/ key_row1: key-row1 {
		pinmux = <SLXXX_GBL_PINMUX(0x0, 3, 3, 0x04)>;
	};

	/omit-if-no-ref/ spi3_ss3n: spi3-ss3n {
		pinmux = <SLXXX_GBL_PINMUX(0x0, 3, 5, 0x04)>;
	};

	/omit-if-no-ref/ key_col2: key-col2 {
		pinmux = <SLXXX_GBL_PINMUX(0x0, 3, 6, 0x04)>;
	};

	/omit-if-no-ref/ dbg_out5: dbg-out5 {
		pinmux = <SLXXX_GBL_PINMUX(0x0, 3, 7, 0x04)>;
	};

	/omit-if-no-ref/ gpio_25: gpio-25 {
		pinmux = <SLXXX_GBL_PINMUX(0x0, 6, 0, 0x08)>;
	};

	/omit-if-no-ref/ urt5_rxd: urt5-rxd {
		pinmux = <SLXXX_GBL_PINMUX(0x0, 6, 1, 0x08)>;
	};

	/omit-if-no-ref/ gpio_trig1: gpio-trig1 {
		pinmux = <SLXXX_GBL_PINMUX(0x0, 6, 2, 0x08)>;
	};

	/omit-if-no-ref/ key_row2: key-row2 {
		pinmux = <SLXXX_GBL_PINMUX(0x0, 6, 3, 0x08)>;
	};

	/omit-if-no-ref/ sm_urt1_rxd: sm-urt1-rxd {
		pinmux = <SLXXX_GBL_PINMUX(0x0, 6, 4, 0x08)>;
	};

	/omit-if-no-ref/ key_col1: key-col1 {
		pinmux = <SLXXX_GBL_PINMUX(0x0, 6, 6, 0x08)>;
	};

	/omit-if-no-ref/ dbg_out6: dbg-out6 {
		pinmux = <SLXXX_GBL_PINMUX(0x0, 6, 7, 0x08)>;
	};

	/omit-if-no-ref/ gpio_26: gpio-26 {
		pinmux = <SLXXX_GBL_PINMUX(0x0, 9, 0, 0x0c)>;
	};

	/omit-if-no-ref/ urt5_txd: urt5-txd {
		pinmux = <SLXXX_GBL_PINMUX(0x0, 9, 1, 0x0c)>;
	};

	/omit-if-no-ref/ rgmii_ptp_pps_o: rgmii-ptp-pps-o {
		pinmux = <SLXXX_GBL_PINMUX(0x0, 9, 2, 0x0c)>;
	};

	/omit-if-no-ref/ sm_urt1_txd: sm-urt1-txd {
		pinmux = <SLXXX_GBL_PINMUX(0x0, 9, 4, 0x0c)>;
	};

	/omit-if-no-ref/ usb2_drv_vbus: usb2-drv-vbus {
		pinmux = <SLXXX_GBL_PINMUX(0x0, 9, 5, 0x0c)>;
	};

	/omit-if-no-ref/ dbg_out7: dbg-out7 {
		pinmux = <SLXXX_GBL_PINMUX(0x0, 9, 7, 0x0c)>;
	};

	/omit-if-no-ref/ gpio_27: gpio-27 {
		pinmux = <SLXXX_GBL_PINMUX(0x0, 12, 0, 0x10)>;
	};

	/omit-if-no-ref/ tw3_scl: tw3-scl {
		pinmux = <SLXXX_GBL_PINMUX(0x0, 12, 1, 0x10)>;
	};

	/omit-if-no-ref/ urt4_txd: urt4-txd {
		pinmux = <SLXXX_GBL_PINMUX(0x0, 12, 2, 0x10)>;
	};

	/omit-if-no-ref/ sm_urt1_rtsn: sm-urt1-rtsn {
		pinmux = <SLXXX_GBL_PINMUX(0x0, 12, 4, 0x10)>;
	};

	/omit-if-no-ref/ gpio_28: gpio-28 {
		pinmux = <SLXXX_GBL_PINMUX(0x0, 15, 0, 0x14)>;
	};

	/omit-if-no-ref/ tw3_sda: tw3-sda {
		pinmux = <SLXXX_GBL_PINMUX(0x0, 15, 1, 0x14)>;
	};

	/omit-if-no-ref/ urt4_rxd: urt4-rxd {
		pinmux = <SLXXX_GBL_PINMUX(0x0, 15, 2, 0x14)>;
	};

	/omit-if-no-ref/ sm_urt1_ctsn: sm-urt1-ctsn {
		pinmux = <SLXXX_GBL_PINMUX(0x0, 15, 4, 0x14)>;
	};

	/omit-if-no-ref/ gpio_29: gpio-29 {
		pinmux = <SLXXX_GBL_PINMUX(0x0, 18, 0, 0x18)>;
	};

	/omit-if-no-ref/ urt4_de: urt4-de {
		pinmux = <SLXXX_GBL_PINMUX(0x0, 18, 2, 0x18)>;
	};

	/omit-if-no-ref/ key_row4: key-row4 {
		pinmux = <SLXXX_GBL_PINMUX(0x0, 18, 3, 0x18)>;
	};

	/omit-if-no-ref/ sm_urt1_rxd_b: sm-urt1-rxd-b {
		pinmux = <SLXXX_GBL_PINMUX(0x0, 18, 4, 0x18)>;
	};

	/omit-if-no-ref/ key_col4: key-col4 {
		pinmux = <SLXXX_GBL_PINMUX(0x0, 18, 6, 0x18)>;
	};

	/omit-if-no-ref/ spi4_sdi: spi4-sdi {
		pinmux = <SLXXX_GBL_PINMUX(0x0, 18, 7, 0x18)>;
	};

	/omit-if-no-ref/ gpio_30: gpio-30 {
		pinmux = <SLXXX_GBL_PINMUX(0x0, 21, 0, 0x1c)>;
	};

	/omit-if-no-ref/ urt4_ren: urt4-ren {
		pinmux = <SLXXX_GBL_PINMUX(0x0, 21, 2, 0x1c)>;
	};

	/omit-if-no-ref/ key_row5: key-row5 {
		pinmux = <SLXXX_GBL_PINMUX(0x0, 21, 3, 0x1c)>;
	};

	/omit-if-no-ref/ sm_urt1_txd_b: sm-urt1-txd-b {
		pinmux = <SLXXX_GBL_PINMUX(0x0, 21, 4, 0x1c)>;
	};

	/omit-if-no-ref/ key_col5: key-col5 {
		pinmux = <SLXXX_GBL_PINMUX(0x0, 21, 6, 0x1c)>;
	};

	/omit-if-no-ref/ spi4_sclk: spi4-sclk {
		pinmux = <SLXXX_GBL_PINMUX(0x0, 21, 7, 0x1c)>;
	};

	/omit-if-no-ref/ gpio_31: gpio-31 {
		pinmux = <SLXXX_GBL_PINMUX(0x0, 24, 0, 0x20)>;
	};

	/omit-if-no-ref/ rgmii_mdc_b: rgmii-mdc-b {
		pinmux = <SLXXX_GBL_PINMUX(0x0, 24, 2, 0x20)>;
	};

	/omit-if-no-ref/ spi5_ss3n: spi5-ss3n {
		pinmux = <SLXXX_GBL_PINMUX(0x0, 24, 5, 0x20)>;
	};

	/omit-if-no-ref/ spi3_ss2n_b: spi3-ss2n-b {
		pinmux = <SLXXX_GBL_PINMUX(0x0, 24, 6, 0x20)>;
	};

	/omit-if-no-ref/ spi4_ss2n: spi4-ss2n {
		pinmux = <SLXXX_GBL_PINMUX(0x0, 24, 7, 0x20)>;
	};

	/omit-if-no-ref/ gpio_32: gpio-32 {
		pinmux = <SLXXX_GBL_PINMUX(0x0, 27, 0, 0x24)>;
	};

	/omit-if-no-ref/ rgmii_mdio_b: rgmii-mdio-b {
		pinmux = <SLXXX_GBL_PINMUX(0x0, 27, 2, 0x24)>;
	};

	/omit-if-no-ref/ spi3_ss3n_b: spi3-ss3n-b {
		pinmux = <SLXXX_GBL_PINMUX(0x0, 27, 6, 0x24)>;
	};

	/omit-if-no-ref/ spi4_ss3n: spi4-ss3n {
		pinmux = <SLXXX_GBL_PINMUX(0x0, 27, 7, 0x24)>;
	};

	/omit-if-no-ref/ gpio_33: gpio-33 {
		pinmux = <SLXXX_GBL_PINMUX(0x4, 0, 0, 0x28)>;
	};

	/omit-if-no-ref/ rgmii1_td0: rgmii1-td0 {
		pinmux = <SLXXX_GBL_PINMUX(0x4, 0, 1, 0x28)>;
	};

	/omit-if-no-ref/ rmii1_txd0: rmii1-txd0 {
		pinmux = <SLXXX_GBL_PINMUX(0x4, 0, 2, 0x28)>;
	};

	/omit-if-no-ref/ can0_tx: can0-tx {
		pinmux = <SLXXX_GBL_PINMUX(0x4, 0, 5, 0x28)>;
	};

	/omit-if-no-ref/ spi3_ss1n: spi3-ss1n {
		pinmux = <SLXXX_GBL_PINMUX(0x4, 0, 6, 0x28)>;
	};

	/omit-if-no-ref/ spi4_ss1n: spi4-ss1n {
		pinmux = <SLXXX_GBL_PINMUX(0x4, 0, 7, 0x28)>;
	};

	/omit-if-no-ref/ gpio_34: gpio-34 {
		pinmux = <SLXXX_GBL_PINMUX(0x4, 3, 0, 0x2c)>;
	};

	/omit-if-no-ref/ rgmii1_td1: rgmii1-td1 {
		pinmux = <SLXXX_GBL_PINMUX(0x4, 3, 1, 0x2c)>;
	};

	/omit-if-no-ref/ rmii1_txd1: rmii1-txd1 {
		pinmux = <SLXXX_GBL_PINMUX(0x4, 3, 2, 0x2c)>;
	};

	/omit-if-no-ref/ sm_can0_rx: sm_can0-rx {
		pinmux = <SLXXX_GBL_PINMUX(0x4, 3, 5, 0x2c)>;
	};

	/omit-if-no-ref/ gpio_35: gpio-35 {
		pinmux = <SLXXX_GBL_PINMUX(0x4, 6, 0, 0x30)>;
	};

	/omit-if-no-ref/ rgmii1_td2: rgmii1-td2 {
		pinmux = <SLXXX_GBL_PINMUX(0x4, 6, 1, 0x30)>;
	};

	/omit-if-no-ref/ rmii2_txd0: rmii2-txd0 {
		pinmux = <SLXXX_GBL_PINMUX(0x4, 6, 2, 0x30)>;
	};

	/omit-if-no-ref/ key_col7: key-col7 {
		pinmux = <SLXXX_GBL_PINMUX(0x4, 6, 3, 0x30)>;
	};

	/omit-if-no-ref/ urt5_rxd_b: urt5-rxd-b {
		pinmux = <SLXXX_GBL_PINMUX(0x4, 6, 4, 0x30)>;
	};

	/omit-if-no-ref/ spi4_ss0n: spi4-ss0n {
		pinmux = <SLXXX_GBL_PINMUX(0x4, 6, 7, 0x30)>;
	};

	/omit-if-no-ref/ gpio_36: gpio-36 {
		pinmux = <SLXXX_GBL_PINMUX(0x4, 9, 0, 0x34)>;
	};

	/omit-if-no-ref/ rgmii1_td3: rgmii1-td3 {
		pinmux = <SLXXX_GBL_PINMUX(0x4, 9, 1, 0x34)>;
	};

	/omit-if-no-ref/ rmii2_txd1: rmii2-txd1 {
		pinmux = <SLXXX_GBL_PINMUX(0x4, 9, 2, 0x34)>;
	};

	/omit-if-no-ref/ urt5_txd_b: urt5-txd-b {
		pinmux = <SLXXX_GBL_PINMUX(0x4, 9, 4, 0x34)>;
	};

	/omit-if-no-ref/ spi4_sdo: spi4-sdo {
		pinmux = <SLXXX_GBL_PINMUX(0x4, 9, 7, 0x34)>;
	};

	/omit-if-no-ref/ gpio_37: gpio-37 {
		pinmux = <SLXXX_GBL_PINMUX(0x4, 12, 0, 0x38)>;
	};

	/omit-if-no-ref/ rgmii1_rd0: rgmii1-rd0 {
		pinmux = <SLXXX_GBL_PINMUX(0x4, 12, 1, 0x38)>;
	};

	/omit-if-no-ref/ rmii1_rxd0: rmii1-rxd0 {
		pinmux = <SLXXX_GBL_PINMUX(0x4, 12, 2, 0x38)>;
	};

	/omit-if-no-ref/ can1_tx: can1-tx {
		pinmux = <SLXXX_GBL_PINMUX(0x4, 12, 5, 0x38)>;
	};

	/omit-if-no-ref/ spi5_sdi: spi5-sdi {
		pinmux = <SLXXX_GBL_PINMUX(0x4, 12, 7, 0x38)>;
	};

	/omit-if-no-ref/ gpio_38: gpio-38 {
		pinmux = <SLXXX_GBL_PINMUX(0x4, 15, 0, 0x3c)>;
	};

	/omit-if-no-ref/ rgmii1_rd1: rgmii1-rd1 {
		pinmux = <SLXXX_GBL_PINMUX(0x4, 15, 1, 0x3c)>;
	};

	/omit-if-no-ref/ rmii1_rxd1: rmii1-rxd1 {
		pinmux = <SLXXX_GBL_PINMUX(0x4, 15, 2, 0x3c)>;
	};

	/omit-if-no-ref/ can1_rx: can1-rx {
		pinmux = <SLXXX_GBL_PINMUX(0x4, 15, 5, 0x3c)>;
	};

	/omit-if-no-ref/ spi5_sdo: spi5-sdo {
		pinmux = <SLXXX_GBL_PINMUX(0x4, 15, 7, 0x3c)>;
	};

	/omit-if-no-ref/ gpio_39: gpio-39 {
		pinmux = <SLXXX_GBL_PINMUX(0x4, 18, 0, 0x40)>;
	};

	/omit-if-no-ref/ rgmii1_rd2: rgmii1-rd2 {
		pinmux = <SLXXX_GBL_PINMUX(0x4, 18, 1, 0x40)>;
	};

	/omit-if-no-ref/ rmii2_rxd0: rmii2-rxd0 {
		pinmux = <SLXXX_GBL_PINMUX(0x4, 18, 2, 0x40)>;
	};

	/omit-if-no-ref/ key_row6: key-row6 {
		pinmux = <SLXXX_GBL_PINMUX(0x4, 18, 3, 0x40)>;
	};

	/omit-if-no-ref/ urt6_rxd: urt6-rxd {
		pinmux = <SLXXX_GBL_PINMUX(0x4, 18, 4, 0x40)>;
	};

	/omit-if-no-ref/ spi5_ss1n: spi5-ss1n {
		pinmux = <SLXXX_GBL_PINMUX(0x4, 18, 5, 0x40)>;
	};

	/omit-if-no-ref/ spi4_ss3n_b: spi4-ss3n-b {
		pinmux = <SLXXX_GBL_PINMUX(0x4, 18, 6, 0x40)>;
	};

	/omit-if-no-ref/ gpio_40: gpio-40 {
		pinmux = <SLXXX_GBL_PINMUX(0x4, 21, 0, 0x44)>;
	};

	/omit-if-no-ref/ rgmii1_rd3: rgmii1-rd3 {
		pinmux = <SLXXX_GBL_PINMUX(0x4, 21, 1, 0x44)>;
	};

	/omit-if-no-ref/ rmii2_rxd1: rmii2-rxd1 {
		pinmux = <SLXXX_GBL_PINMUX(0x4, 21, 2, 0x44)>;
	};

	/omit-if-no-ref/ key_row7: key-row7 {
		pinmux = <SLXXX_GBL_PINMUX(0x4, 21, 3, 0x44)>;
	};

	/omit-if-no-ref/ urt6_txd: urt6-txd {
		pinmux = <SLXXX_GBL_PINMUX(0x4, 21, 4, 0x44)>;
	};

	/omit-if-no-ref/ spi5_ss2n: spi5-ss2n {
		pinmux = <SLXXX_GBL_PINMUX(0x4, 21, 5, 0x44)>;
	};

	/omit-if-no-ref/ spi4_ss2n_b: spi4-ss2n-b {
		pinmux = <SLXXX_GBL_PINMUX(0x4, 21, 6, 0x44)>;
	};

	/omit-if-no-ref/ gpio_41: gpio-41 {
		pinmux = <SLXXX_GBL_PINMUX(0x4, 24, 0, 0x48)>;
	};

	/omit-if-no-ref/ rgmii1_rxc: rgmii1-rxc {
		pinmux = <SLXXX_GBL_PINMUX(0x4, 24, 1, 0x48)>;
	};

	/omit-if-no-ref/ rmii1_crsdv: rmii1-crsdv {
		pinmux = <SLXXX_GBL_PINMUX(0x4, 24, 2, 0x48)>;
	};

	/omit-if-no-ref/ spi5_sclk: spi5-sclk {
		pinmux = <SLXXX_GBL_PINMUX(0x4, 24, 7, 0x48)>;
	};

	/omit-if-no-ref/ gpio_42: gpio-42 {
		pinmux = <SLXXX_GBL_PINMUX(0x4, 27, 0, 0x4c)>;
	};

	/omit-if-no-ref/ rgmii1_txc: rgmii1-txc {
		pinmux = <SLXXX_GBL_PINMUX(0x4, 27, 1, 0x4c)>;
	};

	/omit-if-no-ref/ rmii2_crsdv: rmii2-crsdv {
		pinmux = <SLXXX_GBL_PINMUX(0x4, 27, 2, 0x4c)>;
	};

	/omit-if-no-ref/ key_row8: key-row8 {
		pinmux = <SLXXX_GBL_PINMUX(0x4, 27, 3, 0x4c)>;
	};

	/omit-if-no-ref/ urt7_rxd: urt7-rxd {
		pinmux = <SLXXX_GBL_PINMUX(0x4, 27, 4, 0x4c)>;
	};

	/omit-if-no-ref/ spi4_sclk_b: spi4-sclk-b {
		pinmux = <SLXXX_GBL_PINMUX(0x4, 27, 6, 0x4c)>;
	};

	/omit-if-no-ref/ gpio_43: gpio-43 {
		pinmux = <SLXXX_GBL_PINMUX(0x8, 0, 0, 0x50)>;
	};

	/omit-if-no-ref/ rgmii1_txctl: rgmii1-txctl {
		pinmux = <SLXXX_GBL_PINMUX(0x8, 0, 1, 0x50)>;
	};

	/omit-if-no-ref/ rmii1_txen: rmii1-txen {
		pinmux = <SLXXX_GBL_PINMUX(0x8, 0, 2, 0x50)>;
	};

	/omit-if-no-ref/ spi4_ss0n_b: spi4-ss0n-b {
		pinmux = <SLXXX_GBL_PINMUX(0x8, 0, 6, 0x50)>;
	};

	/omit-if-no-ref/ gpio_44: gpio-44 {
		pinmux = <SLXXX_GBL_PINMUX(0x8, 3, 0, 0x54)>;
	};

	/omit-if-no-ref/ rgmii1_rxctl: rgmii1-rxctl {
		pinmux = <SLXXX_GBL_PINMUX(0x8, 3, 1, 0x54)>;
	};

	/omit-if-no-ref/ rmii2_txen: rmii2-txen {
		pinmux = <SLXXX_GBL_PINMUX(0x8, 3, 2, 0x54)>;
	};

	/omit-if-no-ref/ key_row9: key-row9 {
		pinmux = <SLXXX_GBL_PINMUX(0x8, 3, 3, 0x54)>;
	};

	/omit-if-no-ref/ urt7_txd: urt7-txd {
		pinmux = <SLXXX_GBL_PINMUX(0x8, 3, 4, 0x54)>;
	};

	/omit-if-no-ref/ spi4_sdi_b: spi4-sdi-b {
		pinmux = <SLXXX_GBL_PINMUX(0x8, 3, 6, 0x54)>;
	};

	/omit-if-no-ref/ gpio_45: gpio-45 {
		pinmux = <SLXXX_GBL_PINMUX(0x8, 6, 0, 0x58)>;
	};

	/omit-if-no-ref/ rgmii1_clkout: rgmii1-clkout {
		pinmux = <SLXXX_GBL_PINMUX(0x8, 6, 1, 0x58)>;
	};

	/omit-if-no-ref/ rmii1_refclk: rmii1-refclk {
		pinmux = <SLXXX_GBL_PINMUX(0x8, 6, 2, 0x58)>;
	};

	/omit-if-no-ref/ gpio_46: gpio-46 {
		pinmux = <SLXXX_GBL_PINMUX(0x8, 9, 0, 0x5c)>;
	};

	/omit-if-no-ref/ sdio1_cdn: sdio1-cdn {
		pinmux = <SLXXX_GBL_PINMUX(0x8, 9, 1, 0x5c)>;
	};

	/omit-if-no-ref/ sdio2_cdn: sdio2-cdn {
		pinmux = <SLXXX_GBL_PINMUX(0x8, 9, 2, 0x5c)>;
	};

	/omit-if-no-ref/ key_col0: key-col0 {
		pinmux = <SLXXX_GBL_PINMUX(0x8, 9, 3, 0x5c)>;
	};

	/omit-if-no-ref/ sm_urt1_rtsn_b: sm-urt1-rtsn-b {
		pinmux = <SLXXX_GBL_PINMUX(0x8, 9, 5, 0x5c)>;
	};

	/omit-if-no-ref/ key_row9_b: key-row9-b {
		pinmux = <SLXXX_GBL_PINMUX(0x8, 9, 6, 0x5c)>;
	};

	/omit-if-no-ref/ dsi_te: dsi-te {
		pinmux = <SLXXX_GBL_PINMUX(0x8, 9, 7, 0x5c)>;
	};

	/omit-if-no-ref/ gpio_47: gpio-47 {
		pinmux = <SLXXX_GBL_PINMUX(0x8, 12, 0, 0x60)>;
	};

	/omit-if-no-ref/ sdio1_wp: sdio1-wp {
		pinmux = <SLXXX_GBL_PINMUX(0x8, 12, 1, 0x60)>;
	};

	/omit-if-no-ref/ sdio2_wp: sdio2-wp {
		pinmux = <SLXXX_GBL_PINMUX(0x8, 12, 2, 0x60)>;
	};

	/omit-if-no-ref/ key_col1_b: key-col1-b {
		pinmux = <SLXXX_GBL_PINMUX(0x8, 12, 3, 0x60)>;
	};

	/omit-if-no-ref/ rmii2_refclk: rmii2-refclk {
		pinmux = <SLXXX_GBL_PINMUX(0x8, 12, 4, 0x60)>;
	};

	/omit-if-no-ref/ sm_urt1_ctsn_b: sm-urt1-ctsn-b {
		pinmux = <SLXXX_GBL_PINMUX(0x8, 12, 5, 0x60)>;
	};

	/omit-if-no-ref/ key_row8_b: key-row8-b {
		pinmux = <SLXXX_GBL_PINMUX(0x8, 12, 6, 0x60)>;
	};

	/omit-if-no-ref/ gpio_48: gpio-48 {
		pinmux = <SLXXX_GBL_PINMUX(0x8, 15, 0, 0x64)>;
	};

	/omit-if-no-ref/ rgmii2_td0: rgmii2-td0 {
		pinmux = <SLXXX_GBL_PINMUX(0x8, 15, 1, 0x64)>;
	};

	/omit-if-no-ref/ spi5_ss0n: spi5-ss0n {
		pinmux = <SLXXX_GBL_PINMUX(0x8, 15, 5, 0x64)>;
	};

	/omit-if-no-ref/ spi4_ss2n_c: spi4-ss2n-c {
		pinmux = <SLXXX_GBL_PINMUX(0x8, 15, 6, 0x64)>;
	};

	/omit-if-no-ref/ spi3_ss3n_c: spi3-ss3n_c {
		pinmux = <SLXXX_GBL_PINMUX(0x8, 15, 7, 0x64)>;
	};

	/omit-if-no-ref/ gpio_49: gpio-49 {
		pinmux = <SLXXX_GBL_PINMUX(0x8, 18, 0, 0x68)>;
	};

	/omit-if-no-ref/ rgmii2_td1: rgmii2-td1 {
		pinmux = <SLXXX_GBL_PINMUX(0x8, 18, 1, 0x68)>;
	};

	/omit-if-no-ref/ spi5_sdo_b: spi5-sdo-b {
		pinmux = <SLXXX_GBL_PINMUX(0x8, 18, 5, 0x68)>;
	};

	/omit-if-no-ref/ spi4_ss3n_c: spi4-ss3n-c {
		pinmux = <SLXXX_GBL_PINMUX(0x8, 18, 6, 0x68)>;
	};

	/omit-if-no-ref/ spi3_ss2n_c: spi3-ss2n-c {
		pinmux = <SLXXX_GBL_PINMUX(0x8, 18, 7, 0x68)>;
	};

	/omit-if-no-ref/ gpio_50: gpio-50 {
		pinmux = <SLXXX_GBL_PINMUX(0x8, 21, 0, 0x6c)>;
	};

	/omit-if-no-ref/ rgmii2_td2: rgmii2-td2 {
		pinmux = <SLXXX_GBL_PINMUX(0x8, 21, 1, 0x6c)>;
	};

	/omit-if-no-ref/ spi5_sclk_b: spi5-sclk-b {
		pinmux = <SLXXX_GBL_PINMUX(0x8, 21, 5, 0x6c)>;
	};

	/omit-if-no-ref/ spi3_ss1n_b: spi3-ss1n-b {
		pinmux = <SLXXX_GBL_PINMUX(0x8, 21, 7, 0x6c)>;
	};

	/omit-if-no-ref/ gpio_51: gpio-51 {
		pinmux = <SLXXX_GBL_PINMUX(0x8, 24, 0, 0x70)>;
	};

	/omit-if-no-ref/ rgmii2_td3: rgmii2-td3 {
		pinmux = <SLXXX_GBL_PINMUX(0x8, 24, 1, 0x70)>;
	};

	/omit-if-no-ref/ spi3_ss0n: spi3-ss0n {
		pinmux = <SLXXX_GBL_PINMUX(0x8, 24, 7, 0x70)>;
	};

	/omit-if-no-ref/ gpio_52: gpio-52 {
		pinmux = <SLXXX_GBL_PINMUX(0x8, 27, 0, 0x74)>;
	};

	/omit-if-no-ref/ rgmii2_rd0: rgmii2-rd0 {
		pinmux = <SLXXX_GBL_PINMUX(0x8, 27, 1, 0x74)>;
	};

	/omit-if-no-ref/ spi4_ss2n_d: spi4-ss2n-d {
		pinmux = <SLXXX_GBL_PINMUX(0x8, 27, 6, 0x74)>;
	};

	/omit-if-no-ref/ spi3_sdo: spi3-sdo {
		pinmux = <SLXXX_GBL_PINMUX(0x8, 27, 7, 0x74)>;
	};

	/omit-if-no-ref/ gpio_53: gpio-53 {
		pinmux = <SLXXX_GBL_PINMUX(0xc, 0, 0, 0x78)>;
	};

	/omit-if-no-ref/ rgmii2_rd1: rgmii2-rd1 {
		pinmux = <SLXXX_GBL_PINMUX(0xc, 0, 1, 0x78)>;
	};

	/omit-if-no-ref/ spi4_ss3n_d: spi4-ss3n-d {
		pinmux = <SLXXX_GBL_PINMUX(0xc, 0, 6, 0x78)>;
	};

	/omit-if-no-ref/ spi3_sclk: spi3-sclk {
		pinmux = <SLXXX_GBL_PINMUX(0xc, 0, 7, 0x78)>;
	};

	/omit-if-no-ref/ gpio_54: gpio-54 {
		pinmux = <SLXXX_GBL_PINMUX(0xc, 3, 0, 0x7c)>;
	};

	/omit-if-no-ref/ rgmii2_rd2: rgmii2-rd2 {
		pinmux = <SLXXX_GBL_PINMUX(0xc, 3, 1, 0x7c)>;
	};

	/omit-if-no-ref/ spi3_sdi: spi3-sdi {
		pinmux = <SLXXX_GBL_PINMUX(0xc, 3, 7, 0x7c)>;
	};

	/omit-if-no-ref/ gpio_55: gpio-55 {
		pinmux = <SLXXX_GBL_PINMUX(0xc, 6, 0, 0x80)>;
	};

	/omit-if-no-ref/ rgmii2_rd3: rgmii2-rd3 {
		pinmux = <SLXXX_GBL_PINMUX(0xc, 6, 1, 0x80)>;
	};

	/omit-if-no-ref/ spi5_sdi_b: spi5-sdi-b {
		pinmux = <SLXXX_GBL_PINMUX(0xc, 6, 5, 0x80)>;
	};

	/omit-if-no-ref/ spi4_ss1n_b: spi4-ss1n-b {
		pinmux = <SLXXX_GBL_PINMUX(0xc, 6, 7, 0x80)>;
	};

	/omit-if-no-ref/ gpio_56: gpio-56 {
		pinmux = <SLXXX_GBL_PINMUX(0xc, 9, 0, 0x84)>;
	};

	/omit-if-no-ref/ rgmii2_rxc: rgmii2-rxc {
		pinmux = <SLXXX_GBL_PINMUX(0xc, 9, 1, 0x84)>;
	};

	/omit-if-no-ref/ spi4_ss0n_c: spi4-ss0n-c {
		pinmux = <SLXXX_GBL_PINMUX(0xc, 9, 7, 0x84)>;
	};

	/omit-if-no-ref/ gpio_57: gpio-57 {
		pinmux = <SLXXX_GBL_PINMUX(0xc, 12, 0, 0x88)>;
	};

	/omit-if-no-ref/ rgmii2_txc: rgmii2-txc {
		pinmux = <SLXXX_GBL_PINMUX(0xc, 12, 1, 0x88)>;
	};

	/omit-if-no-ref/ spi4_sdo_b: spi4-sdo-b {
		pinmux = <SLXXX_GBL_PINMUX(0xc, 12, 7, 0x88)>;
	};

	/omit-if-no-ref/ gpio_58: gpio-58 {
		pinmux = <SLXXX_GBL_PINMUX(0xc, 15, 0, 0x8c)>;
	};

	/omit-if-no-ref/ rgmii2_txctl: rgmii2-txctl {
		pinmux = <SLXXX_GBL_PINMUX(0xc, 15, 1, 0x8c)>;
	};

	/omit-if-no-ref/ spi4_sclk_c: spi4-sclk-c {
		pinmux = <SLXXX_GBL_PINMUX(0xc, 15, 7, 0x8c)>;
	};

	/omit-if-no-ref/ gpio_59: gpio-59 {
		pinmux = <SLXXX_GBL_PINMUX(0xc, 18, 0, 0x90)>;
	};

	/omit-if-no-ref/ rgmii2_rxctl: rgmii2-rxctl {
		pinmux = <SLXXX_GBL_PINMUX(0xc, 18, 1, 0x90)>;
	};

	/omit-if-no-ref/ spi4_sdi_c: spi4-sdi-c {
		pinmux = <SLXXX_GBL_PINMUX(0xc, 18, 7, 0x90)>;
	};

	/omit-if-no-ref/ gpio_0: gpio-0 {
		pinmux = <SLXXX_GBL_PINMUX(0xc, 21, 0, 0x94)>;
	};

	/omit-if-no-ref/ i2s1_lrck: i2s1-lrck {
		pinmux = <SLXXX_GBL_PINMUX(0xc, 21, 1, 0x94)>;
	};

	/omit-if-no-ref/ spi3_ss0n_b: spi3-ss0n-b {
		pinmux = <SLXXX_GBL_PINMUX(0xc, 21, 7, 0x94)>;
	};

	/omit-if-no-ref/ gpio_1: gpio-1 {
		pinmux = <SLXXX_GBL_PINMUX(0xc, 24, 0, 0x98)>;
	};

	/omit-if-no-ref/ i2s1_bclk: i2s1-bclk {
		pinmux = <SLXXX_GBL_PINMUX(0xc, 24, 1, 0x98)>;
	};

	/omit-if-no-ref/ spi3_sclk_b: spi3-sclk-b {
		pinmux = <SLXXX_GBL_PINMUX(0xc, 24, 7, 0x98)>;
	};

	/omit-if-no-ref/ gpio_2: gpio-2 {
		pinmux = <SLXXX_GBL_PINMUX(0xc, 27, 0, 0x9c)>;
	};

	/omit-if-no-ref/ i2s1_do: i2s1-do {
		pinmux = <SLXXX_GBL_PINMUX(0xc, 27, 1, 0x9c)>;
	};

	/omit-if-no-ref/ spdif_o: spdif-o {
		pinmux = <SLXXX_GBL_PINMUX(0xc, 27, 4, 0x9c)>;
	};

	/omit-if-no-ref/ spi3_sdo_b: spi3-sdo-b {
		pinmux = <SLXXX_GBL_PINMUX(0xc, 27, 7, 0x9c)>;
	};

	/omit-if-no-ref/ gpio_3: gpio-3 {
		pinmux = <SLXXX_GBL_PINMUX(0x10, 0, 0, 0xa0)>;
	};

	/omit-if-no-ref/ i2s1_mclk: i2s1-mclk {
		pinmux = <SLXXX_GBL_PINMUX(0x10, 0, 1, 0xa0)>;
	};

	/omit-if-no-ref/ spi3_ss1n_c: spi3-ss1n-c {
		pinmux = <SLXXX_GBL_PINMUX(0x10, 0, 7, 0xa0)>;
	};

	/omit-if-no-ref/ gpio_4: gpio-4 {
		pinmux = <SLXXX_GBL_PINMUX(0x10, 3, 0, 0xa4)>;
	};

	/omit-if-no-ref/ i2s1_di: i2s1-di {
		pinmux = <SLXXX_GBL_PINMUX(0x10, 3, 1, 0xa4)>;
	};

	/omit-if-no-ref/ spdif_i: spdif-i {
		pinmux = <SLXXX_GBL_PINMUX(0x10, 3, 4, 0xa4)>;
	};

	/omit-if-no-ref/ spi3_sdi_b: spi3-sdi-b {
		pinmux = <SLXXX_GBL_PINMUX(0x10, 3, 7, 0xa4)>;
	};

	/omit-if-no-ref/ gpio_5: gpio-5 {
		pinmux = <SLXXX_GBL_PINMUX(0x10, 6, 0, 0xa8)>;
	};

	/omit-if-no-ref/ i2s2_lrck: i2s2-lrck {
		pinmux = <SLXXX_GBL_PINMUX(0x10, 6, 1, 0xa8)>;
	};

	/omit-if-no-ref/ cam_pixclk: cam-pixclk {
		pinmux = <SLXXX_GBL_PINMUX(0x10, 6, 2, 0xa8)>;
	};

	/omit-if-no-ref/ key_row0_b: key-row0-b {
		pinmux = <SLXXX_GBL_PINMUX(0x10, 6, 3, 0xa8)>;
	};

	/omit-if-no-ref/ spdif_i_b: spdif-i-b {
		pinmux = <SLXXX_GBL_PINMUX(0x10, 6, 4, 0xa8)>;
	};

	/omit-if-no-ref/ key_col7_b: key-col7-b {
		pinmux = <SLXXX_GBL_PINMUX(0x10, 6, 6, 0xa8)>;
	};

	/omit-if-no-ref/ gpio_6: gpio-6 {
		pinmux = <SLXXX_GBL_PINMUX(0x10, 9, 0, 0xac)>;
	};

	/omit-if-no-ref/ i2s2_bclk: i2s2-bclk {
		pinmux = <SLXXX_GBL_PINMUX(0x10, 9, 1, 0xac)>;
	};

	/omit-if-no-ref/ cam_hsync: cam-hsync {
		pinmux = <SLXXX_GBL_PINMUX(0x10, 9, 2, 0xac)>;
	};

	/omit-if-no-ref/ key_row1_b: key-row1-b {
		pinmux = <SLXXX_GBL_PINMUX(0x10, 9, 3, 0xac)>;
	};

	/omit-if-no-ref/ spdif_o_b: spdif-o-b {
		pinmux = <SLXXX_GBL_PINMUX(0x10, 9, 4, 0xac)>;
	};

	/omit-if-no-ref/ key_col6: key-col6 {
		pinmux = <SLXXX_GBL_PINMUX(0x10, 9, 6, 0xac)>;
	};

	/omit-if-no-ref/ gpio_7: gpio-7 {
		pinmux = <SLXXX_GBL_PINMUX(0x10, 12, 0, 0xb0)>;
	};

	/omit-if-no-ref/ i2s2_do: i2s2-do {
		pinmux = <SLXXX_GBL_PINMUX(0x10, 12, 1, 0xb0)>;
	};

	/omit-if-no-ref/ key_row2_b: key-row2-b {
		pinmux = <SLXXX_GBL_PINMUX(0x10, 12, 3, 0xb0)>;
	};

	/omit-if-no-ref/ spdif_o_c: spdif-o-c {
		pinmux = <SLXXX_GBL_PINMUX(0x10, 12, 4, 0xb0)>;
	};

	/omit-if-no-ref/ sm_pdm_clkio: sm-pdm-clkio {
		pinmux = <SLXXX_GBL_PINMUX(0x10, 12, 5, 0xb0)>;
	};

	/omit-if-no-ref/ key_col5_b: key-col5-b {
		pinmux = <SLXXX_GBL_PINMUX(0x10, 12, 6, 0xb0)>;
	};

	/omit-if-no-ref/ gpio_8: gpio-8 {
		pinmux = <SLXXX_GBL_PINMUX(0x10, 15, 0, 0xb4)>;
	};

	/omit-if-no-ref/ i2s2_di: i2s2-di {
		pinmux = <SLXXX_GBL_PINMUX(0x10, 15, 1, 0xb4)>;
	};

	/omit-if-no-ref/ cam_vsync: cam-vsync {
		pinmux = <SLXXX_GBL_PINMUX(0x10, 15, 2, 0xb4)>;
	};

	/omit-if-no-ref/ key_row3: key-row3 {
		pinmux = <SLXXX_GBL_PINMUX(0x10, 15, 3, 0xb4)>;
	};

	/omit-if-no-ref/ spdif_i_c: spdif-i-c {
		pinmux = <SLXXX_GBL_PINMUX(0x10, 15, 4, 0xb4)>;
	};

	/omit-if-no-ref/ key_col4_b: key-col4-b {
		pinmux = <SLXXX_GBL_PINMUX(0x10, 15, 6, 0xb4)>;
	};

	/omit-if-no-ref/ gpio_9: gpio-9 {
		pinmux = <SLXXX_GBL_PINMUX(0x10, 18, 0, 0xb8)>;
	};

	/omit-if-no-ref/ cam_data0: cam-data0 {
		pinmux = <SLXXX_GBL_PINMUX(0x10, 18, 2, 0xb8)>;
	};

	/omit-if-no-ref/ pdm_di1: pdm-di1 {
		pinmux = <SLXXX_GBL_PINMUX(0x10, 18, 4, 0xb8)>;
	};

	/omit-if-no-ref/ gpio_10: gpio-10 {
		pinmux = <SLXXX_GBL_PINMUX(0x10, 21, 0, 0xbc)>;
	};

	/omit-if-no-ref/ cam_data1: cam-data1 {
		pinmux = <SLXXX_GBL_PINMUX(0x10, 21, 2, 0xbc)>;
	};

	/omit-if-no-ref/ pdm_di2: pdm-di2 {
		pinmux = <SLXXX_GBL_PINMUX(0x10, 21, 4, 0xbc)>;
	};

	/omit-if-no-ref/ dsi_te_b: dsi-te-b {
		pinmux = <SLXXX_GBL_PINMUX(0x10, 21, 5, 0xbc)>;
	};

	/omit-if-no-ref/ gpio_11: gpio-11 {
		pinmux = <SLXXX_GBL_PINMUX(0x10, 24, 0, 0xc0)>;
	};

	/omit-if-no-ref/ i2s2_mclk: i2s2-mclk {
		pinmux = <SLXXX_GBL_PINMUX(0x10, 24, 1, 0xc0)>;
	};

	/omit-if-no-ref/ cam_data2: cam-data2 {
		pinmux = <SLXXX_GBL_PINMUX(0x10, 24, 2, 0xc0)>;
	};

	/omit-if-no-ref/ sm_pdm_clkio_b: sm-pdm-clkio-b {
		pinmux = <SLXXX_GBL_PINMUX(0x10, 24, 4, 0xc0)>;
	};

	/omit-if-no-ref/ dbg_clk: dbg-clk {
		pinmux = <SLXXX_GBL_PINMUX(0x10, 24, 7, 0xc0)>;
	};

	/omit-if-no-ref/ gpio_12: gpio-12 {
		pinmux = <SLXXX_GBL_PINMUX(0x10, 27, 0, 0xc4)>;
	};

	/omit-if-no-ref/ i2s3_lrck: i2s3-lrck {
		pinmux = <SLXXX_GBL_PINMUX(0x10, 27, 1, 0xc4)>;
	};

	/omit-if-no-ref/ cam_data3: cam-data3 {
		pinmux = <SLXXX_GBL_PINMUX(0x10, 27, 2, 0xc4)>;
	};

	/omit-if-no-ref/ sdio2_wp_b: sdio2-wp-b {
		pinmux = <SLXXX_GBL_PINMUX(0x10, 27, 3, 0xc4)>;
	};

	/omit-if-no-ref/ sdio1_wp_b: sdio1-wp-b {
		pinmux = <SLXXX_GBL_PINMUX(0x10, 27, 4, 0xc4)>;
	};

	/omit-if-no-ref/ dbg_out0: dbg-out0 {
		pinmux = <SLXXX_GBL_PINMUX(0x10, 27, 7, 0xc4)>;
	};

	/omit-if-no-ref/ gpio_13: gpio-13 {
		pinmux = <SLXXX_GBL_PINMUX(0x14, 0, 0, 0xc8)>;
	};

	/omit-if-no-ref/ i2s3_bclk: i2s3-bclk {
		pinmux = <SLXXX_GBL_PINMUX(0x14, 0, 1, 0xc8)>;
	};

	/omit-if-no-ref/ pdm_di1_b: pdm-di1-b {
		pinmux = <SLXXX_GBL_PINMUX(0x14, 0, 2, 0xc8)>;
	};

	/omit-if-no-ref/ rgmii_ptp_pps_o_b: rgmii-ptp-pps-o-b {
		pinmux = <SLXXX_GBL_PINMUX(0x14, 0, 3, 0xc8)>;
	};

	/omit-if-no-ref/ usb2_drv_vbus_b: usb2-drv-vbus-b {
		pinmux = <SLXXX_GBL_PINMUX(0x14, 0, 4, 0xc8)>;
	};

	/omit-if-no-ref/ dbg_out1: dbg-out1 {
		pinmux = <SLXXX_GBL_PINMUX(0x14, 0, 7, 0xc8)>;
	};

	/omit-if-no-ref/ gpio_14: gpio-14 {
		pinmux = <SLXXX_GBL_PINMUX(0x14, 3, 0, 0xcc)>;
	};

	/omit-if-no-ref/ i2s3_do: i2s3-do {
		pinmux = <SLXXX_GBL_PINMUX(0x14, 3, 1, 0xcc)>;
	};

	/omit-if-no-ref/ pdm_di3: pdm-di3 {
		pinmux = <SLXXX_GBL_PINMUX(0x14, 3, 4, 0xcc)>;
	};

	/omit-if-no-ref/ spdif_o_d: spdif-o-d {
		pinmux = <SLXXX_GBL_PINMUX(0x14, 3, 6, 0xcc)>;
	};

	/omit-if-no-ref/ dbg_out2: dbg-out2 {
		pinmux = <SLXXX_GBL_PINMUX(0x14, 3, 7, 0xcc)>;
	};

	/omit-if-no-ref/ gpio_15: gpio-15 {
		pinmux = <SLXXX_GBL_PINMUX(0x14, 6, 0, 0xd0)>;
	};

	/omit-if-no-ref/ i2s3_di: i2s3-di {
		pinmux = <SLXXX_GBL_PINMUX(0x14, 6, 1, 0xd0)>;
	};

	/omit-if-no-ref/ cam_data4: cam-data4 {
		pinmux = <SLXXX_GBL_PINMUX(0x14, 6, 2, 0xd0)>;
	};

	/omit-if-no-ref/ sm_pdm_di_0: sm-pdm-di-0 {
		pinmux = <SLXXX_GBL_PINMUX(0x14, 6, 4, 0xd0)>;
	};

	/omit-if-no-ref/ spdif_i_d: spdif-i-d {
		pinmux = <SLXXX_GBL_PINMUX(0x14, 6, 6, 0xd0)>;
	};

	/omit-if-no-ref/ dbg_out3: dbg-out3 {
		pinmux = <SLXXX_GBL_PINMUX(0x14, 6, 7, 0xd0)>;
	};

	/omit-if-no-ref/ gpio_16: gpio-16 {
		pinmux = <SLXXX_GBL_PINMUX(0x14, 9, 0, 0xd4)>;
	};

	/omit-if-no-ref/ spi2_ss0n: spi2-ss0n {
		pinmux = <SLXXX_GBL_PINMUX(0x14, 9, 1, 0xd4)>;
	};

	/omit-if-no-ref/ sdio2_dat3: sdio2-dat3 {
		pinmux = <SLXXX_GBL_PINMUX(0x14, 9, 3, 0xd4)>;
	};

	/omit-if-no-ref/ gpio_17: gpio-17 {
		pinmux = <SLXXX_GBL_PINMUX(0x14, 12, 0, 0xd8)>;
	};

	/omit-if-no-ref/ spi2_ss1n: spi2-ss1n {
		pinmux = <SLXXX_GBL_PINMUX(0x14, 12, 1, 0xd8)>;
	};

	/omit-if-no-ref/ cam_data5: cam-data5 {
		pinmux = <SLXXX_GBL_PINMUX(0x14, 12, 2, 0xd8)>;
	};

	/omit-if-no-ref/ sdio2_dat2: sdio2-dat2 {
		pinmux = <SLXXX_GBL_PINMUX(0x14, 12, 3, 0xd8)>;
	};

	/omit-if-no-ref/ dsi_te_c: dsi-te-c {
		pinmux = <SLXXX_GBL_PINMUX(0x14, 12, 5, 0xd8)>;
	};

	/omit-if-no-ref/ gpio_18: gpio-18 {
		pinmux = <SLXXX_GBL_PINMUX(0x14, 15, 0, 0xdc)>;
	};

	/omit-if-no-ref/ spi2_ss2n: spi2-ss2n {
		pinmux = <SLXXX_GBL_PINMUX(0x14, 15, 1, 0xdc)>;
	};

	/omit-if-no-ref/ cam_data6: cam-data6 {
		pinmux = <SLXXX_GBL_PINMUX(0x14, 15, 2, 0xdc)>;
	};

	/omit-if-no-ref/ sdio2_dat1: sdio2-dat1 {
		pinmux = <SLXXX_GBL_PINMUX(0x14, 15, 3, 0xdc)>;
	};

	/omit-if-no-ref/ pdm_di2_b: pdm-di2-b {
		pinmux = <SLXXX_GBL_PINMUX(0x14, 15, 4, 0xdc)>;
	};

	/omit-if-no-ref/ sm_can1_rx: sm-can1-rx {
		pinmux = <SLXXX_GBL_PINMUX(0x14, 15, 5, 0xdc)>;
	};

	/omit-if-no-ref/ gpio_19: gpio-19 {
		pinmux = <SLXXX_GBL_PINMUX(0x14, 18, 0, 0xe0)>;
	};

	/omit-if-no-ref/ spi2_ss3n: spi2-ss3n {
		pinmux = <SLXXX_GBL_PINMUX(0x14, 18, 1, 0xe0)>;
	};

	/omit-if-no-ref/ cam_data7: cam-data7 {
		pinmux = <SLXXX_GBL_PINMUX(0x14, 18, 2, 0xe0)>;
	};

	/omit-if-no-ref/ sdio2_dat0: sdio2-dat0 {
		pinmux = <SLXXX_GBL_PINMUX(0x14, 18, 3, 0xe0)>;
	};

	/omit-if-no-ref/ pdm_di3_b: pdm-di3-b {
		pinmux = <SLXXX_GBL_PINMUX(0x14, 18, 4, 0xe0)>;
	};

	/omit-if-no-ref/ sm_can1_tx: sm-can1-tx {
		pinmux = <SLXXX_GBL_PINMUX(0x14, 18, 5, 0xe0)>;
	};

	/omit-if-no-ref/ gpio_20: gpio-20 {
		pinmux = <SLXXX_GBL_PINMUX(0x14, 21, 0, 0xe4)>;
	};

	/omit-if-no-ref/ spi2_sdo: spi2-sdo {
		pinmux = <SLXXX_GBL_PINMUX(0x14, 21, 1, 0xe4)>;
	};

	/omit-if-no-ref/ sdio2_cmd: sdio2-cmd {
		pinmux = <SLXXX_GBL_PINMUX(0x14, 21, 3, 0xe4)>;
	};

	/omit-if-no-ref/ gpio_21: gpio-21 {
		pinmux = <SLXXX_GBL_PINMUX(0x14, 24, 0, 0xe8)>;
	};

	/omit-if-no-ref/ spi2_sclk: spi2-sclk {
		pinmux = <SLXXX_GBL_PINMUX(0x14, 24, 1, 0xe8)>;
	};

	/omit-if-no-ref/ sdio2_clk: sdio2-clk {
		pinmux = <SLXXX_GBL_PINMUX(0x14, 24, 3, 0xe8)>;
	};

	/omit-if-no-ref/ clk_out: clk-out {
		pinmux = <SLXXX_GBL_PINMUX(0x14, 24, 5, 0xe8)>;
	};

	/omit-if-no-ref/ gpio_22: gpio-22 {
		pinmux = <SLXXX_GBL_PINMUX(0x14, 27, 0, 0xec)>;
	};

	/omit-if-no-ref/ spi2_sdi: spi2-sdi {
		pinmux = <SLXXX_GBL_PINMUX(0x14, 27, 1, 0xec)>;
	};

	/omit-if-no-ref/ sdio2_cdn_b: sdio2-cdn-b {
		pinmux = <SLXXX_GBL_PINMUX(0x14, 27, 3, 0xec)>;
	};

	/omit-if-no-ref/ sdio1_cdn_b: sdio1-cdn-b {
		pinmux = <SLXXX_GBL_PINMUX(0x14, 27, 4, 0xec)>;
	};
};

&pinctrl_sm {
	/omit-if-no-ref/ sm_gpio31: sm-gpio31 {
		pinmux = <SLXXX_SM_PINMUX(0x0, 0, 0, 0x00)>;
	};

	/omit-if-no-ref/ sm_pwm0: sm-pwm0 {
		pinmux = <SLXXX_SM_PINMUX(0x0, 0, 1, 0x00)>;
	};

	/omit-if-no-ref/ sm_urt1_rxd_c: sm-urt1-rxd-c {
		pinmux = <SLXXX_SM_PINMUX(0x0, 0, 2, 0x00)>;
	};

	/omit-if-no-ref/ key_row7_b: key-row7-b {
		pinmux = <SLXXX_SM_PINMUX(0x0, 0, 3, 0x00)>;
	};

	/omit-if-no-ref/ sm_pdm_di0: sm-pdm-di0 {
		pinmux = <SLXXX_SM_PINMUX(0x0, 0, 4, 0x00)>;
	};

	/omit-if-no-ref/ sm_urt0_rxd_b: sm-urt0-rxd-b {
		pinmux = <SLXXX_SM_PINMUX(0x0, 0, 5, 0x00)>;
	};

	/omit-if-no-ref/ sm_can1_rxd: sm-can1-rxd {
		pinmux = <SLXXX_SM_PINMUX(0x0, 0, 6, 0x00)>;
	};

	/omit-if-no-ref/ sm_gpio32: sm-gpio32 {
		pinmux = <SLXXX_SM_PINMUX(0x0, 3, 0, 0x04)>;
	};

	/omit-if-no-ref/ sm_pwm1: sm-pwm1 {
		pinmux = <SLXXX_SM_PINMUX(0x0, 3, 1, 0x04)>;
	};

	/omit-if-no-ref/ sm_urt1_txd_c: sm-urt1-txd-c {
		pinmux = <SLXXX_SM_PINMUX(0x0, 3, 2, 0x04)>;
	};

	/omit-if-no-ref/ key_col0_b: key-col0-b {
		pinmux = <SLXXX_SM_PINMUX(0x0, 3, 3, 0x04)>;
	};

	/omit-if-no-ref/ sm_pdm_clkio_c: sm-pdm-clkio-c {
		pinmux = <SLXXX_SM_PINMUX(0x0, 3, 4, 0x04)>;
	};

	/omit-if-no-ref/ sm_urt0_txd_c: sm-urt0-txd-c {
		pinmux = <SLXXX_SM_PINMUX(0x0, 3, 5, 0x04)>;
	};

	/omit-if-no-ref/ sm_can1_tx: sm-can1-tx {
		pinmux = <SLXXX_SM_PINMUX(0x0, 3, 6, 0x04)>;
	};

	/omit-if-no-ref/ sm_gpio33: sm-gpio33 {
		pinmux = <SLXXX_SM_PINMUX(0x0, 6, 0, 0x08)>;
	};

	/omit-if-no-ref/ sm_pwm2: sm-pwm2 {
		pinmux = <SLXXX_SM_PINMUX(0x0, 6, 1, 0x08)>;
	};

	/omit-if-no-ref/ sm_urt2_txd: sm-urt2-txd {
		pinmux = <SLXXX_SM_PINMUX(0x0, 6, 3, 0x08)>;
	};

	/omit-if-no-ref/ sm_urt3_rts: sm-urt3-rts {
		pinmux = <SLXXX_SM_PINMUX(0x0, 6, 4, 0x08)>;
	};

	/omit-if-no-ref/ key_row5_b: key-row5-b {
		pinmux = <SLXXX_SM_PINMUX(0x0, 6, 5, 0x08)>;
	};

	/omit-if-no-ref/ sm_urt3_de: sm-urt3-de {
		pinmux = <SLXXX_SM_PINMUX(0x0, 6, 6, 0x08)>;
	};

	/omit-if-no-ref/ sm_gpio34: sm-gpio34 {
		pinmux = <SLXXX_SM_PINMUX(0x0, 9, 0, 0x0c)>;
	};

	/omit-if-no-ref/ sm_pwm3: sm-pwm3 {
		pinmux = <SLXXX_SM_PINMUX(0x0, 9, 1, 0x0c)>;
	};

	/omit-if-no-ref/ sm_urt2_rxd: sm-urt2-rxd {
		pinmux = <SLXXX_SM_PINMUX(0x0, 9, 3, 0x0c)>;
	};

	/omit-if-no-ref/ sm_urt3_cts: sm-urt3-cts {
		pinmux = <SLXXX_SM_PINMUX(0x0, 9, 4, 0x0c)>;
	};

	/omit-if-no-ref/ key_row4_b: key-row4-b {
		pinmux = <SLXXX_SM_PINMUX(0x0, 9, 5, 0x0c)>;
	};

	/omit-if-no-ref/ sm_urt3_re: sm-urt3-re {
		pinmux = <SLXXX_SM_PINMUX(0x0, 9, 6, 0x0c)>;
	};

	/omit-if-no-ref/ sm_gpio35: sm-gpio35 {
		pinmux = <SLXXX_SM_PINMUX(0x0, 12, 0, 0x10)>;
	};

	/omit-if-no-ref/ sm_pwm4: sm-pwm4 {
		pinmux = <SLXXX_SM_PINMUX(0x0, 12, 1, 0x10)>;
	};

	/omit-if-no-ref/ sm_urt1_rtsn_c: sm-urt1-rtsn-c {
		pinmux = <SLXXX_SM_PINMUX(0x0, 12, 2, 0x10)>;
	};

	/omit-if-no-ref/ sm_urt3_txd: sm-urt3-txd {
		pinmux = <SLXXX_SM_PINMUX(0x0, 12, 3, 0x10)>;
	};

	/omit-if-no-ref/ sm_urt2_rts: sm-urt2-rts {
		pinmux = <SLXXX_SM_PINMUX(0x0, 12, 4, 0x10)>;
	};

	/omit-if-no-ref/ key_row3: key-row3 {
		pinmux = <SLXXX_SM_PINMUX(0x0, 12, 5, 0x10)>;
	};

	/omit-if-no-ref/ sm_urt0_rts: sm-urt0-rts {
		pinmux = <SLXXX_SM_PINMUX(0x0, 12, 6, 0x10)>;
	};

	/omit-if-no-ref/ sm_gpio36: sm-gpio36 {
		pinmux = <SLXXX_SM_PINMUX(0x0, 15, 0, 0x14)>;
	};

	/omit-if-no-ref/ sm_pwm5: sm-pwm5 {
		pinmux = <SLXXX_SM_PINMUX(0x0, 15, 1, 0x14)>;
	};

	/omit-if-no-ref/ sm_urt1_cts_c: sm-urt1-cts-c {
		pinmux = <SLXXX_SM_PINMUX(0x0, 15, 2, 0x14)>;
	};

	/omit-if-no-ref/ sm_urt3_rxd: sm-urt3-rxd {
		pinmux = <SLXXX_SM_PINMUX(0x0, 15, 3, 0x14)>;
	};

	/omit-if-no-ref/ sm_urt2_cts: sm-urt2-cts {
		pinmux = <SLXXX_SM_PINMUX(0x0, 15, 4, 0x14)>;
	};

	/omit-if-no-ref/ key_row2_c: key-row2-c {
		pinmux = <SLXXX_SM_PINMUX(0x0, 15, 5, 0x14)>;
	};

	/omit-if-no-ref/ sm_urt0_cts: sm-urt0-cts {
		pinmux = <SLXXX_SM_PINMUX(0x0, 15, 6, 0x14)>;
	};

	/omit-if-no-ref/ sm_gpio37: sm-gpio37 {
		pinmux = <SLXXX_SM_PINMUX(0x0, 18, 0, 0x18)>;
	};

	/omit-if-no-ref/ sm_pwm6: sm-pwm6 {
		pinmux = <SLXXX_SM_PINMUX(0x0, 18, 1, 0x18)>;
	};

	/omit-if-no-ref/ sm_tw0_scl: sm-tw0-scl {
		pinmux = <SLXXX_SM_PINMUX(0x0, 18, 3, 0x18)>;
	};

	/omit-if-no-ref/ key_row6_b: key-row6-b {
		pinmux = <SLXXX_SM_PINMUX(0x0, 18, 4, 0x18)>;
	};

	/omit-if-no-ref/ sm_pdm_clkio_d: sm-pdm-clkio-d {
		pinmux = <SLXXX_SM_PINMUX(0x0, 18, 5, 0x18)>;
	};

	/omit-if-no-ref/ sm_gpio38: sm-gpio38 {
		pinmux = <SLXXX_SM_PINMUX(0x0, 21, 0, 0x1c)>;
	};

	/omit-if-no-ref/ sm_pwm7: sm-pwm7 {
		pinmux = <SLXXX_SM_PINMUX(0x0, 21, 1, 0x1c)>;
	};

	/omit-if-no-ref/ sm_tw0_sda: sm-tw0-sda {
		pinmux = <SLXXX_SM_PINMUX(0x0, 21, 3, 0x1c)>;
	};

	/omit-if-no-ref/ sm_pdm_di0_b: sm-pdm-di0-b {
		pinmux = <SLXXX_SM_PINMUX(0x0, 21, 5, 0x1c)>;
	};

	/omit-if-no-ref/ sm_gpio3: sm-gpio3 {
		pinmux = <SLXXX_SM_PINMUX(0x0, 24, 0, 0x20)>;
	};

	/omit-if-no-ref/ sm_spi1_ss0n: sm-spi1-ss0n {
		pinmux = <SLXXX_SM_PINMUX(0x0, 24, 1, 0x20)>;
	};

	/omit-if-no-ref/ sm_tw1_scl: sm-tw1-scl {
		pinmux = <SLXXX_SM_PINMUX(0x0, 24, 2, 0x20)>;
	};

	/omit-if-no-ref/ sm_pwm8: sm-pwm8 {
		pinmux = <SLXXX_SM_PINMUX(0x0, 24, 3, 0x20)>;
	};

	/omit-if-no-ref/ i3c_ms_scl: i3c-ms-scl {
		pinmux = <SLXXX_SM_PINMUX(0x0, 24, 4, 0x20)>;
	};

	/omit-if-no-ref/ sm_gpio4: sm-gpio4 {
		pinmux = <SLXXX_SM_PINMUX(0x0, 27, 0, 0x24)>;
	};

	/omit-if-no-ref/ sm_spi1_ss1n: sm-spi1-ssn1 {
		pinmux = <SLXXX_SM_PINMUX(0x0, 27, 1, 0x24)>;
	};

	/omit-if-no-ref/ sm_tw1_sda: sm-tw1-sda {
		pinmux = <SLXXX_SM_PINMUX(0x0, 27, 2, 0x24)>;
	};

	/omit-if-no-ref/ sm_pwm0_b: sm-pwm0-b {
		pinmux = <SLXXX_SM_PINMUX(0x0, 27, 3, 0x24)>;
	};

	/omit-if-no-ref/ i3c_ms_sda: i3c-ms-sda {
		pinmux = <SLXXX_SM_PINMUX(0x0, 27, 4, 0x24)>;
	};

	/omit-if-no-ref/ sm_gpio5: sm-gpio5 {
		pinmux = <SLXXX_SM_PINMUX(0x4, 0, 0, 0x28)>;
	};

	/omit-if-no-ref/ sm_spi1_ss2n: sm-spi1-ss2n {
		pinmux = <SLXXX_SM_PINMUX(0x4, 0, 1, 0x28)>;
	};

	/omit-if-no-ref/ sm_pwm1_b: sm-pwm1-b {
		pinmux = <SLXXX_SM_PINMUX(0x4, 0, 3, 0x28)>;
	};

	/omit-if-no-ref/ sm_gpio6: sm-gpio6 {
		pinmux = <SLXXX_SM_PINMUX(0x4, 3, 0, 0x2c)>;
	};

	/omit-if-no-ref/ sm_spi1_ss3n: sm-spi1-ss3n {
		pinmux = <SLXXX_SM_PINMUX(0x4, 3, 1, 0x2c)>;
	};

	/omit-if-no-ref/ sm_spi1s_ssn: sm-spi1s-ssn {
		pinmux = <SLXXX_SM_PINMUX(0x4, 3, 2, 0x2c)>;
	};

	/omit-if-no-ref/ sm_pwm2_b: sm-pwm2-b {
		pinmux = <SLXXX_SM_PINMUX(0x4, 3, 3, 0x2c)>;
	};

	/omit-if-no-ref/ sm_gpio9: sm-gpio9 {
		pinmux = <SLXXX_SM_PINMUX(0x4, 6, 0, 0x30)>;
	};

	/omit-if-no-ref/ sm_spi1_sdo: sm-spi1-sdo {
		pinmux = <SLXXX_SM_PINMUX(0x4, 6, 1, 0x30)>;
	};

	/omit-if-no-ref/ sm_spi1s_sdo: sm-spi1s-sdo {
		pinmux = <SLXXX_SM_PINMUX(0x4, 6, 2, 0x30)>;
	};

	/omit-if-no-ref/ sm_pwm3_b: sm-pwm3-b {
		pinmux = <SLXXX_SM_PINMUX(0x4, 6, 3, 0x30)>;
	};

	/omit-if-no-ref/ sm_gpio10: sm-gpio10 {
		pinmux = <SLXXX_SM_PINMUX(0x4, 9, 0, 0x34)>;
	};

	/omit-if-no-ref/ sm_spi1_clk: sm-spi1-clk {
		pinmux = <SLXXX_SM_PINMUX(0x4, 9, 1, 0x34)>;
	};

	/omit-if-no-ref/ sm_spi1s_clk: sm-spi1s-clk {
		pinmux = <SLXXX_SM_PINMUX(0x4, 9, 2, 0x34)>;
	};

	/omit-if-no-ref/ sm_pwm4_b: sm-pwm4-b {
		pinmux = <SLXXX_SM_PINMUX(0x4, 9, 3, 0x34)>;
	};

	/omit-if-no-ref/ sm_gpio11: sm-gpio11 {
		pinmux = <SLXXX_SM_PINMUX(0x4, 12, 0, 0x38)>;
	};

	/omit-if-no-ref/ sm_spi1_sdi: spi1-sdi {
		pinmux = <SLXXX_SM_PINMUX(0x4, 12, 1, 0x38)>;
	};

	/omit-if-no-ref/ sm_spi1s_sdi: sm-spi1s-sdi {
		pinmux = <SLXXX_SM_PINMUX(0x4, 12, 2, 0x38)>;
	};

	/omit-if-no-ref/ sm_pwm5_b: sm-pwm5-b {
		pinmux = <SLXXX_SM_PINMUX(0x4, 12, 3, 0x38)>;
	};

	/omit-if-no-ref/ sm_gpio30: sm-gpio30 {
		pinmux = <SLXXX_SM_PINMUX(0x4, 15, 0, 0x44)>;
	};

	/omit-if-no-ref/ sm_xspi_data7: sm-xspi_data7 {
		pinmux = <SLXXX_SM_PINMUX(0x4, 15, 1, 0x44)>;
	};

	/omit-if-no-ref/ key_col6: key-col6 {
		pinmux = <SLXXX_SM_PINMUX(0x4, 15, 3, 0x44)>;
	};

	/omit-if-no-ref/ sm_clkout: sm-clkout {
		pinmux = <SLXXX_SM_PINMUX(0x4, 15, 7, 0x44)>;
	};

	/omit-if-no-ref/ sm_gpio29: sm-gpio29 {
		pinmux = <SLXXX_SM_PINMUX(0x4, 18, 0, 0x48)>;
	};

	/omit-if-no-ref/ sm_xspi_data6: sm-xspi_data6 {
		pinmux = <SLXXX_SM_PINMUX(0x4, 18, 1, 0x48)>;
	};

	/omit-if-no-ref/ sm_urt3_rxd_b: sm-urt3-rxd-b {
		pinmux = <SLXXX_SM_PINMUX(0x4, 18, 2, 0x48)>;
	};

	/omit-if-no-ref/ key_col5_c: key-col5-c {
		pinmux = <SLXXX_SM_PINMUX(0x4, 18, 3, 0x48)>;
	};

	/omit-if-no-ref/ sm_urt2_cts_b: sm-urt2-cts-b {
		pinmux = <SLXXX_SM_PINMUX(0x4, 18, 4, 0x48)>;
	};

	/omit-if-no-ref/ sm_urt0_cts_b: sm-urt0-cts-b {
		pinmux = <SLXXX_SM_PINMUX(0x4, 18, 5, 0x48)>;
	};

	/omit-if-no-ref/ key_row2_b: key-row2-b {
		pinmux = <SLXXX_SM_PINMUX(0x4, 18, 6, 0x48)>;
	};

	/omit-if-no-ref/ sm_urt1_cts_d: sm-urt1-cts-d {
		pinmux = <SLXXX_SM_PINMUX(0x4, 18, 7, 0x48)>;
	};

	/omit-if-no-ref/ sm_gpio28: sm-gpio28 {
		pinmux = <SLXXX_SM_PINMUX(0x4, 21, 0, 0x4c)>;
	};

	/omit-if-no-ref/ sm_xspi_data5: sm-xspi-data5 {
		pinmux = <SLXXX_SM_PINMUX(0x4, 21, 1, 0x4c)>;
	};

	/omit-if-no-ref/ sm_urt3_txd_b: sm-urt3-txd-b {
		pinmux = <SLXXX_SM_PINMUX(0x4, 21, 2, 0x4c)>;
	};

	/omit-if-no-ref/ key_col4_c: key-col4-c {
		pinmux = <SLXXX_SM_PINMUX(0x4, 21, 3, 0x4c)>;
	};

	/omit-if-no-ref/ sm_urt2_rts_b: sm-urt2-rts-b {
		pinmux = <SLXXX_SM_PINMUX(0x4, 21, 4, 0x4c)>;
	};

	/omit-if-no-ref/ sm_urt0_rts_b: sm-urt0-rts-b {
		pinmux = <SLXXX_SM_PINMUX(0x4, 21, 5, 0x4c)>;
	};

	/omit-if-no-ref/ key_row3_b: key-row3-b {
		pinmux = <SLXXX_SM_PINMUX(0x4, 21, 6, 0x4c)>;
	};

	/omit-if-no-ref/ sm_urt1_rtsn_d: sm-urt1-rtsn-d {
		pinmux = <SLXXX_SM_PINMUX(0x4, 21, 7, 0x4c)>;
	};

	/omit-if-no-ref/ sm_gpio27: sm-gpio27 {
		pinmux = <SLXXX_SM_PINMUX(0x4, 24, 0, 0x50)>;
	};

	/omit-if-no-ref/ sm_xspi_data4: sm-xspi-data4 {
		pinmux = <SLXXX_SM_PINMUX(0x4, 24, 1, 0x50)>;
	};

	/omit-if-no-ref/ sm_urt2_rxd_b: sm-urt2-rxd-b {
		pinmux = <SLXXX_SM_PINMUX(0x4, 24, 2, 0x50)>;
	};

	/omit-if-no-ref/ key_col3_b: key-col3-b {
		pinmux = <SLXXX_SM_PINMUX(0x4, 24, 3, 0x50)>;
	};

	/omit-if-no-ref/ sm_urt3_cts_b: sm-urt3-cts-b {
		pinmux = <SLXXX_SM_PINMUX(0x4, 24, 4, 0x50)>;
	};

	/omit-if-no-ref/ sm_urt3_re_b: sm-urt3-re-b {
		pinmux = <SLXXX_SM_PINMUX(0x4, 24, 5, 0x50)>;
	};

	/omit-if-no-ref/ key_row4_c: key-row4-c {
		pinmux = <SLXXX_SM_PINMUX(0x4, 24, 6, 0x50)>;
	};

	/omit-if-no-ref/ sm_gpio26: sm-gpio26 {
		pinmux = <SLXXX_SM_PINMUX(0x4, 27, 0, 0x54)>;
	};

	/omit-if-no-ref/ sm_xspi_cs1: sm-xspi-cs1 {
		pinmux = <SLXXX_SM_PINMUX(0x4, 27, 1, 0x54)>;
	};

	/omit-if-no-ref/ sm_urt2_txd_b: sm-urt2-txd-b {
		pinmux = <SLXXX_SM_PINMUX(0x4, 27, 2, 0x54)>;
	};

	/omit-if-no-ref/ key_col2: key-col2 {
		pinmux = <SLXXX_SM_PINMUX(0x4, 27, 3, 0x54)>;
	};

	/omit-if-no-ref/ sm_urt3_rts_b: sm-urt3-rts-b {
		pinmux = <SLXXX_SM_PINMUX(0x4, 27, 4, 0x54)>;
	};

	/omit-if-no-ref/ sm_urt3_de_b: sm-urt3-de-b {
		pinmux = <SLXXX_SM_PINMUX(0x4, 27, 5, 0x54)>;
	};

	/omit-if-no-ref/ key_row5_c: key-row5-c {
		pinmux = <SLXXX_SM_PINMUX(0x4, 27, 6, 0x54)>;
	};

	/omit-if-no-ref/ sm_clkout_b: sm-clkout-b {
		pinmux = <SLXXX_SM_PINMUX(0x4, 27, 7, 0x54)>;
	};

	/omit-if-no-ref/ sm_gpio25: sm-gpio25 {
		pinmux = <SLXXX_SM_PINMUX(0x8, 0, 0, 0x58)>;
	};

	/omit-if-no-ref/ sm_xspi_dqs: sm-xspi-dqs {
		pinmux = <SLXXX_SM_PINMUX(0x8, 0, 1, 0x58)>;
	};

	/omit-if-no-ref/ key_row6_c: key-row6-c {
		pinmux = <SLXXX_SM_PINMUX(0x8, 0, 6, 0x58)>;
	};

	/omit-if-no-ref/ sm_gpio24: sm-gpio24 {
		pinmux = <SLXXX_SM_PINMUX(0x8, 3, 0, 0x58)>;
	};

	/omit-if-no-ref/ sm_xspi_clk_n: sm-xspi-clk-n {
		pinmux = <SLXXX_SM_PINMUX(0x8, 3, 1, 0x5C)>;
	};

	/omit-if-no-ref/ sm_gpio23: sm-gpio23 {
		pinmux = <SLXXX_SM_PINMUX(0x8, 6, 0, 0x60)>;
	};

	/omit-if-no-ref/ sm_xspi_clk: sm-xspi-clk {
		pinmux = <SLXXX_SM_PINMUX(0x8, 6, 1, 0x60)>;
	};

	/omit-if-no-ref/ sm_gpio22: sm-gpio22 {
		pinmux = <SLXXX_SM_PINMUX(0x8, 9, 0, 0x60)>;
	};

	/omit-if-no-ref/ sm_xspi_data3: sm-xspi-data3 {
		pinmux = <SLXXX_SM_PINMUX(0x8, 9, 1, 0x64)>;
	};

	/omit-if-no-ref/ sm_gpio21: sm-gpio21 {
		pinmux = <SLXXX_SM_PINMUX(0x8, 12, 0, 0x60)>;
	};

	/omit-if-no-ref/ sm_xspi_data2: sm-xspi-data2 {
		pinmux = <SLXXX_SM_PINMUX(0x8, 12, 1, 0x68)>;
	};

	/omit-if-no-ref/ sm_gpio20: sm-gpio20 {
		pinmux = <SLXXX_SM_PINMUX(0x8, 15, 0, 0x60)>;
	};

	/omit-if-no-ref/ sm_xspi_data1: sm-xspi-data1 {
		pinmux = <SLXXX_SM_PINMUX(0x8, 15, 1, 0x6c)>;
	};

	/omit-if-no-ref/ sm_gpio19: sm-gpio19 {
		pinmux = <SLXXX_SM_PINMUX(0x8, 18, 0, 0x60)>;
	};

	/omit-if-no-ref/ sm_xspi_data0: sm-xspi-data0 {
		pinmux = <SLXXX_SM_PINMUX(0x8, 18, 1, 0x70)>;
	};

	/omit-if-no-ref/ sm_gpio18: sm-gpio18 {
		pinmux = <SLXXX_SM_PINMUX(0x8, 21, 0, 0x60)>;
	};

	/omit-if-no-ref/ sm_xspi_cs0: sm-xspi-cs0 {
		pinmux = <SLXXX_SM_PINMUX(0x8, 21, 1, 0x74)>;
	};

	/omit-if-no-ref/ sm_gpio17: sm-gpio17 {
		pinmux = <SLXXX_SM_PINMUX(0x8, 24, 0, 0x78)>;
	};

	/omit-if-no-ref/ sm_urt1_txd_d: sm-urt1-txd-d {
		pinmux = <SLXXX_SM_PINMUX(0x8, 24, 1, 0x78)>;
	};

	/omit-if-no-ref/ sm_can0_tx: sm-can0-tx {
		pinmux = <SLXXX_SM_PINMUX(0x8, 24, 2, 0x78)>;
	};

	/omit-if-no-ref/ sm_pwm8_b: sm-pwm8-b {
		pinmux = <SLXXX_SM_PINMUX(0x8, 24, 4, 0x78)>;
	};

	/omit-if-no-ref/ sm_urt0_txd_b: sm-urt0-txd-b {
		pinmux = <SLXXX_SM_PINMUX(0x8, 24, 6, 0x78)>;
	};

	/omit-if-no-ref/ sm_gpio15: sm-gpio15 {
		pinmux = <SLXXX_SM_PINMUX(0x8, 27, 0, 0x80)>;
	};

	/omit-if-no-ref/ sm_tw1_sda_b: sm-tw1-sda-b {
		pinmux = <SLXXX_SM_PINMUX(0x8, 27, 1, 0x80)>;
	};

	/omit-if-no-ref/ sm_urt0_rts_c: sm-urt0-rts-c {
		pinmux = <SLXXX_SM_PINMUX(0x8, 27, 2, 0x80)>;
	};

	/omit-if-no-ref/ sm_pwm11: sm-pwm11 {
		pinmux = <SLXXX_SM_PINMUX(0x8, 27, 3, 0x80)>;
	};

	/omit-if-no-ref/ sm_can0_tx_b: sm-can0-tx-b {
		pinmux = <SLXXX_SM_PINMUX(0x8, 27, 4, 0x80)>;
	};

	/omit-if-no-ref/ sm_urt1_rtsn_e: sm-urt1-rtsn-e {
		pinmux = <SLXXX_SM_PINMUX(0x8, 27, 6, 0x80)>;
	};

	/omit-if-no-ref/ mcu_dbg_out2: mcu-dbg-out2 {
		pinmux = <SLXXX_SM_PINMUX(0x8, 27, 7, 0x80)>;
	};

	/omit-if-no-ref/ sm_gpio14: sm-gpio14 {
		pinmux = <SLXXX_SM_PINMUX(0xc, 0, 0, 0x80)>;
	};

	/omit-if-no-ref/ sm_tw1_scl_b: sm-tw1-scl-b {
		pinmux = <SLXXX_SM_PINMUX(0xc, 0, 1, 0x80)>;
	};

	/omit-if-no-ref/ sm_urt0_cts_c: sm-urt0-cts-c {
		pinmux = <SLXXX_SM_PINMUX(0xc, 0, 2, 0x80)>;
	};

	/omit-if-no-ref/ sm_pwm10: sm-pwm10 {
		pinmux = <SLXXX_SM_PINMUX(0xc, 0, 3, 0x80)>;
	};

	/omit-if-no-ref/ sm_can0_rxd: sm-can0-rxd {
		pinmux = <SLXXX_SM_PINMUX(0xc, 0, 4, 0x80)>;
	};

	/omit-if-no-ref/ sm_urt1_cts_e: sm-urt1-cts-e {
		pinmux = <SLXXX_SM_PINMUX(0xc, 0, 6, 0x80)>;
	};

	/omit-if-no-ref/ mcu_dbg_out1: mcu-dbg-out1 {
		pinmux = <SLXXX_SM_PINMUX(0xc, 0, 7, 0x80)>;
	};

	/omit-if-no-ref/ sm_gpio16: sm-gpio16 {
		pinmux = <SLXXX_SM_PINMUX(0xc, 3, 0, 0x84)>;
	};

	/omit-if-no-ref/ sm_urt1_rxd_d: sm-urt1-rxd-d {
		pinmux = <SLXXX_SM_PINMUX(0xc, 3, 1, 0x84)>;
	};

	/omit-if-no-ref/ sm_can0_rxd_b: sm-can0-rxd-b {
		pinmux = <SLXXX_SM_PINMUX(0xc, 3, 2, 0x84)>;
	};

	/omit-if-no-ref/ sm_pwm7_b: sm-pwm7-b {
		pinmux = <SLXXX_SM_PINMUX(0xc, 3, 4, 0x84)>;
	};

	/omit-if-no-ref/ sm_urt0_rxd_c: sm-urt0-rxd-c {
		pinmux = <SLXXX_SM_PINMUX(0xc, 3, 6, 0x84)>;
	};

	/omit-if-no-ref/ sm_gpio13: sm-gpio13 {
		pinmux = <SLXXX_SM_PINMUX(0xc, 6, 0, 0x88)>;
	};

	/omit-if-no-ref/ sm_tw0_sda_b: sm-tw0-sda-b {
		pinmux = <SLXXX_SM_PINMUX(0xc, 6, 1, 0x88)>;
	};

	/omit-if-no-ref/ i3c_ms_sda_b: i3c-ms-sda-b {
		pinmux = <SLXXX_SM_PINMUX(0xc, 6, 2, 0x88)>;
	};

	/omit-if-no-ref/ sm_clkout_c: sm-clkout-c {
		pinmux = <SLXXX_SM_PINMUX(0xc, 6, 3, 0x88)>;
	};

	/omit-if-no-ref/ mcu_dbg_out0: mcu-dbg-out0 {
		pinmux = <SLXXX_SM_PINMUX(0xc, 6, 7, 0x88)>;
	};

	/omit-if-no-ref/ sm_gpio12: sm-gpio12 {
		pinmux = <SLXXX_SM_PINMUX(0xc, 9, 0, 0x8c)>;
	};

	/omit-if-no-ref/ sm_tw0_scl_b: sm-tw0-scl-b {
		pinmux = <SLXXX_SM_PINMUX(0xc, 9, 1, 0x8c)>;
	};

	/omit-if-no-ref/ i3c_ms_scl_b: i3c-ms-scl-b {
		pinmux = <SLXXX_SM_PINMUX(0xc, 9, 2, 0x8c)>;
	};

	/omit-if-no-ref/ sm_pwm6_b: sm-pwm6-b {
		pinmux = <SLXXX_SM_PINMUX(0xc, 9, 3, 0x8c)>;
	};

	/omit-if-no-ref/ mcu_dbg_clk: mcu-dbg-clk {
		pinmux = <SLXXX_SM_PINMUX(0xc, 9, 7, 0x8c)>;
	};

	/omit-if-no-ref/ sm_gpio8: sm-gpio8 {
		pinmux = <SLXXX_SM_PINMUX(0xc, 12, 0, 0x90)>;
	};

	/omit-if-no-ref/ sm_urt0_txd: sm-urt0-txd {
		pinmux = <SLXXX_SM_PINMUX(0xc, 12, 1, 0x90)>;
	};

	/omit-if-no-ref/ sm_can0_tx_c: sm-can0-tx-c {
		pinmux = <SLXXX_SM_PINMUX(0xc, 12, 2, 0x90)>;
	};

	/omit-if-no-ref/ sm_clkout_d: sm-clkout-d {
		pinmux = <SLXXX_SM_PINMUX(0xc, 12, 3, 0x90)>;
	};

	/omit-if-no-ref/ sm_urt1_txd_e: sm-urt1-txd-e {
		pinmux = <SLXXX_SM_PINMUX(0xc, 12, 6, 0x90)>;
	};

	/omit-if-no-ref/ sm_gpio7: sm-gpio7 {
		pinmux = <SLXXX_SM_PINMUX(0xc, 15, 0, 0x94)>;
	};

	/omit-if-no-ref/ sm_urt0_rxd: sm-urt0-rxd {
		pinmux = <SLXXX_SM_PINMUX(0xc, 15, 1, 0x94)>;
	};

	/omit-if-no-ref/ sm_can0_rxd_c: sm-can0-rxd-c {
		pinmux = <SLXXX_SM_PINMUX(0xc, 15, 2, 0x94)>;
	};

	/omit-if-no-ref/ gpio_trig2: gpio-trig2 {
		pinmux = <SLXXX_SM_PINMUX(0xc, 15, 4, 0x94)>;
	};

	/omit-if-no-ref/ sm_pwm9: sm-pwm9 {
		pinmux = <SLXXX_SM_PINMUX(0xc, 15, 5, 0x94)>;
	};

	/omit-if-no-ref/ sm_urt1_rxd_e: sm-urt1-rxd-e {
		pinmux = <SLXXX_SM_PINMUX(0xc, 15, 6, 0x94)>;
	};

	/omit-if-no-ref/ sm_tdo: sm-tdo {
		pinmux = <SLXXX_SM_PINMUX(0xc, 18, 0, 0x98)>;
	};

	/omit-if-no-ref/ sm_gpio2: sm-gpio2 {
		pinmux = <SLXXX_SM_PINMUX(0xc, 18, 1, 0x98)>;
	};

	/omit-if-no-ref/ sm_pdm_clkio_e: sm-pdm-clkio-e {
		pinmux = <SLXXX_SM_PINMUX(0xc, 18, 2, 0x98)>;
	};

	/omit-if-no-ref/ i2s2_mclk: i2s2-mclk {
		pinmux = <SLXXX_SM_PINMUX(0xc, 18, 3, 0x98)>;
	};

	/omit-if-no-ref/ sm_pwm11_b: sm-pwm11-b {
		pinmux = <SLXXX_SM_PINMUX(0xc, 18, 6, 0x98)>;
	};

	/omit-if-no-ref/ sm_tdi: sm-tdi {
		pinmux = <SLXXX_SM_PINMUX(0xc, 21, 0, 0x9c)>;
	};

	/omit-if-no-ref/ sm_gpio1: sm-gpio1 {
		pinmux = <SLXXX_SM_PINMUX(0xc, 21, 1, 0x9c)>;
	};

	/omit-if-no-ref/ sm_urt0_rxd_d: sm-urt0-rxd-d {
		pinmux = <SLXXX_SM_PINMUX(0xc, 21, 2, 0x9c)>;
	};

	/omit-if-no-ref/ key_col1_c: key-col1-c {
		pinmux = <SLXXX_SM_PINMUX(0xc, 21, 3, 0x9c)>;
	};

	/omit-if-no-ref/ gpio_trig0: gpio-trig0 {
		pinmux = <SLXXX_SM_PINMUX(0xc, 21, 4, 0x9c)>;
	};

	/omit-if-no-ref/ sm_pwm9_b: sm-pwm9-b {
		pinmux = <SLXXX_SM_PINMUX(0xc, 21, 5, 0x9c)>;
	};

	/omit-if-no-ref/ key_row7_c: key-row7-c {
		pinmux = <SLXXX_SM_PINMUX(0xc, 21, 6, 0x9c)>;
	};

	/omit-if-no-ref/ sm_tms: sm-tms {
		pinmux = <SLXXX_SM_PINMUX(0xc, 24, 0, 0xa0)>;
	};

	/omit-if-no-ref/ sm_gpio0: sm-gpio0 {
		pinmux = <SLXXX_SM_PINMUX(0xc, 24, 1, 0xa0)>;
	};

	/omit-if-no-ref/ sm_urt0_tx_d: sm-urt0-tx-d {
		pinmux = <SLXXX_SM_PINMUX(0xc, 24, 2, 0xa0)>;
	};

	/omit-if-no-ref/ key_col0_c: key-col0-c {
		pinmux = <SLXXX_SM_PINMUX(0xc, 24, 3, 0xa0)>;
	};

	/omit-if-no-ref/ sm_pdm_di0_c: sm-pdm-di0-c {
		pinmux = <SLXXX_SM_PINMUX(0xc, 24, 5, 0xa0)>;
	};

	/omit-if-no-ref/ sm_pwm10_b: sm-pwm10-b {
		pinmux = <SLXXX_SM_PINMUX(0xc, 24, 6, 0xa0)>;
	};
};
