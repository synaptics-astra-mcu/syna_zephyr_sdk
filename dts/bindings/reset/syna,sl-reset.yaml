## dts/bindings/reset/syna,sl-reset.yaml
```yaml
# Copyright (C) 2026 Synaptics Incorporated
# Author: Jisheng Zhang <jszhang@kernel.org>
# SPDX-License-Identifier: Apache-2.0

title: Synaptics SL family SoCs ACPU domain Reset Driver

description: |
  Synaptics SL family SoCs ACPU domain Reset driver bindings.

include: [base.yaml, reset-controller.yaml]

compatible: "syna,sl-reset"

properties:
  reg:
    required: true

  "#reset-cells":
    const: 1

reset-cells:
- id
```

## dts/bindings/reset/syna,srw1500-reset.yaml
```yaml
# Copyright (c) 2026 Synaptics Incorporated
# SPDX-License-Identifier: Apache-2.0

title: Synaptics SRW1500 Reset Driver

description: |
  Synaptics SRW1500 Reset driver bindings.

include: [base.yaml, reset-controller.yaml]

compatible: "syna,srw1500-reset"

properties:
  reg:
    required: true

  reg-names:
    required: true

  "#reset-cells":
    const: 1

reset-cells:
- id
```

## dts/bindings/rng/snps,dwc-trng.yaml
```yaml
# SPDX-License-Identifier: Apache-2.0

description: Synopsys DesignWare True Random Number Generator

compatible: "snps,dwc-trng"

include: [base.yaml, reset-device.yaml]

properties:
  reg:
    required: true

  clocks:
    type: phandle-array
```

## dts/bindings/rng/syna,bcm-trng.yaml
```yaml
# Copyright (c) 2026 Synaptics Incorporated
# SPDX-License-Identifier: Apache-2.0

description: |
    Synaptics BCM TRNG (True Random Number Generator).

    This module is a non-deterministic random number generator based on a full hardware solution.

compatible: "syna,bcm-trng"

include: base.yaml

properties:
  reg:
    required: true
```

## dts/bindings/sdhc/snps,mshc.yaml
```yaml
# Copyright (c) 2025 Synaptics Incorporated
# SPDX-License-Identifier: Apache-2.0

description: Synopsys DWC Mobile Storage Host Controller

compatible: "snps,mshc"

include: [sdhc.yaml, pinctrl-device.yaml, reset-device.yaml]

properties:
  reg:
    required: true

  pinctrl-0:
    required: true

  pinctrl-names:
    required: true

  clock-frequency:
    type: int
    description: Clock frequency input to controller

  no-dma:
    type: boolean
    description: Always use PIO

  vmmc-supply:
    type: phandle
    description: |
      Supply for the card power
      If the level shifter is controlled by a GPIO line, this shall
      be modeled as a "regulator-fixed" with a GPIO line for
      switching the level shifter on/off.

  vmmcq-supply:
    type: phandle
    description: |
      Supply for the card power - 1.8 or 3.3V
      If the level shifter is controlled by a GPIO line, this shall
      be modeled as a "regulator-fixed" with a GPIO line for
      switching the level shifter on/off.
```

## dts/bindings/sdio_device/syna,sdio-device.yaml
```yaml
# Copyright (c) 2026 Synaptics Incorporated
# SPDX-License-Identifier: Apache-2.0

description: Synaptics SDIO device peripheral

compatible: "syna,sdio-device"

include: [base.yaml, pinctrl-device.yaml, reset-device.yaml]

properties:
  reg:
    required: true

  resets:
    required: true
```

## dts/bindings/security/arm,mpc-sie300.yaml
```yaml
# Copyright (c) 2026 Synaptics Incorporated
# SPDX-License-Identifier: Apache-2.0

description: Arm MPC SIE-300 Memory Protection Controller
compatible: "arm,mpc-sie300"

include: base.yaml

properties:
  reg:
    required: true
  arm,controlled-ranges:
    type: array
    description: |
      Deprecated for this port. The Srw1500 range map is programmed from C.
  arm,nonsecure-regions:
    type: array
    description: |
      Deprecated for this port. The Srw1500 NS memory policy is programmed
      from C.
  lockdown:
    type: boolean
    description: Set MPC secure lockdown bit after configuration.
```

## dts/bindings/security/arm,ppc.yaml
```yaml
# Copyright (c) 2026 Synaptics Incorporated
# SPDX-License-Identifier: Apache-2.0

description: Arm TrustZone Peripheral Protection Controller register group
compatible: "arm,ppc"

include: base.yaml

properties:
  ns-reg:
    type: int
    required: true
    description: Absolute address of non-secure attribution register.
  priv-reg:
    type: int
    required: true
    description: Absolute address of privileged-access register.
  sresp-reg:
    type: int
    required: true
    description: Absolute address of secure-response register.
  arm,peripherals:
    type: array
    description: |
      Flattened tuples: <ns_pos priv_pos sresp_pos flags>.
      flags bit0: non-secure, bit1: user/non-privileged allowed,
      bit2: error response instead of RAZ/WI.
```

## dts/bindings/security/arm,sau.yaml
```yaml
# Copyright (c) 2026 Synaptics Incorporated
# SPDX-License-Identifier: Apache-2.0

description: Armv8-M Security Attribution Unit configuration enable node
compatible: "arm,sau"

include: base.yaml

properties:
  arm,sau-regions:
    type: array
    description: |
      Deprecated for this port. Security policy is programmed from C so DTS
      remains a hardware/enable description only.
```

## dts/bindings/security/arm,tgu-armv8-m.yaml
```yaml
# Copyright (c) 2026 Synaptics Incorporated
# SPDX-License-Identifier: Apache-2.0

description: Armv8-M TCM Gating Unit
compatible: "arm,tgu-armv8-m"

include: base.yaml

properties:
  reg:
    required: true
  arm,controlled-ranges:
    type: array
    description: |
      Deprecated for this port. The Srw1500 TCM range map is programmed from C.
  arm,nonsecure-regions:
    type: array
    description: |
      Deprecated for this port. TCM remains secure by default.
```

## dts/bindings/timer/arm,sse-timer.yaml
```yaml
# Copyright (c) 2026 Synaptics Incorporated
# SPDX-License-Identifier: Apache-2.0

description: ARM SSE timer

compatible: "arm,sse-timer"

include: base.yaml

properties:
  reg:
    required: true

  clock-frequency:
    type: int
    required: true
    description: |
      Clock rate
```

## dts/bindings/usb/syna,sl-usb2.yaml
```yaml
# Copyright (C) 2026 Synaptics Incorporated
# Author: Jisheng Zhang <jszhang@kernel.org>
# SPDX-License-Identifier: Apache-2.0
#
description: Synaptics SL family SoCs' DWC2 compatible controller

compatible: "syna,sl-usb2"

include: ["snps,dwc2.yaml", reset-device.yaml]

properties:
  clocks:
    required: true

  resets:
    required: true

  phys:
    type: phandle
```

## dts/bindings/usb/syna,srw1500-usb.yaml
```yaml
# Copyright (c) 2026 Synaptics Incorporated
# SPDX-License-Identifier: Apache-2.0

description: Synaptics SRW1500 USB device controller

compatible: "syna,srw1500-usb"

include: ["snps,dwc2.yaml", reset-device.yaml]

properties:
  ghwcfg3:
    type: int
    required: true
    description: Value of the GHWCFG3 register.

  phy-utmi-width:
    type: int
    required: true
    enum:
      - 8
      - 16
    description: UTMI+ interface width.
```

## dts/bindings/usb/syna,usb.yaml
```yaml
# Copyright (c) 2025 Synaptics, Inc.
# SPDX-License-Identifier: Apache-2.0
#
description: Synaptics SR11X DWC2 compatible controller

compatible: "syna,usb"

include: ["snps,dwc2.yaml", pinctrl-device.yaml]
```

## dts/bindings/video/ovti,ov02c10.yaml
```yaml
# Copyright (c) 2026 Synaptics Incorporated
# SPDX-License-Identifier: Apache-2.0

description: OmniVision OV02C10 CMOS image sensor

compatible: "ovti,ov02c10"

include: [i2c-device.yaml, pinctrl-device.yaml]

properties:
  powerdown-gpios:
    type: phandle-array
    description: |
      GPIO that enables the external supply for the sensor. The driver
      drives this GPIO to its active state before enabling MCLK and
      accessing the sensor over I2C.

  shutdown-gpios:
    type: phandle-array
    description: |
      Board-level sensor shutdown/control GPIO. The driver drives this
      GPIO to its active state before enabling MCLK and accessing the
      sensor over I2C.

  mclk-control-reg:
    type: int
    description: |
      Optional Synaptics SoC register address used to enable the external
      sensor clock.

  mclk-control-val:
    type: int
    description: |
      Value written to mclk-control-reg.

  power-up-delay-ms:
    type: int
    default: 100
    description: |
      Delay after board power/control GPIOs are enabled.

  mclk-settle-delay-ms:
    type: int
    default: 10
    description: |
      Delay after the sensor MCLK register is programmed.

  data-lanes:
    type: int
    required: false
    description: |
      Number of CSI-2 data lanes used by the sensor.

child-binding:
  child-binding:
    include: video-interfaces.yaml
```

## dts/bindings/video/syna,enc-video.yaml
```yaml
# Copyright (c) 2026 Synaptics, Inc.
# SPDX-License-Identifier: Apache-2.0

description: Synaptics JPEG video encoder

compatible: "syna,enc-video"

include:
  - name: base.yaml

properties:
  interrupts:
    required: true
    description: |
      JPEG encoder interrupts exposed by the SoC NVIC.
      Index 0 is frame processing done ("frame-done").
      Index 1 is FMIN1 frame stored ("fmin1-stored").
      Index 2 is an optional status/miscellaneous event interrupt ("status").
      The driver supports up to three IRQ lines.

  interrupt-names:
    required: true
    description: |
      Interrupt names in index order.
      Use "frame-done", "fmin1-stored", and optional "status".

  mode:
    type: int
    default: 0
    enum:
      - 0
      - 1
    description: |
      Wrapper mode selection.
      0: Sensor/CSI -> JPEG encoder in reserved memory. The application must configure
         the connected sensor format before starting the wrapper. The live
         path currently supports RAW8 Bayer sensor input only. In this mode,
         provide a child ``port/endpoint`` input with ``data-lanes`` set to
         the CSI-2 lane count and a remote endpoint to the sensor.
      1: Static/raw memory -> JPEG encoder in reserved memory. A child
         ``port/endpoint`` is optional in this mode.

  memory-region:
    type: phandle
    required: true
    description: |
      Required reserved memory region used as the JPEG encoder raw/JPEG working
      area (raw input region + JPEG output region). The referenced node must be writable, CPU-accessible to the
      driver, and marked non-cacheable via ``zephyr,memory-attr``.

  max-jpeg-size:
    type: int
    description: |
      Maximum JPEG bytes to scan/copy from the JPEG output region.
      This should be sized for the worst-case JPEG output for the selected
      resolution/quality and must fit within the reserved ``memory-region``.

  frame-raw-offset:
    type: int
    default: 0
    description: |
      Byte offset from the ``memory-region`` base where the raw frame starts in
      mode 0.

  # In mode=1 (memory-input), the driver manages the internal layout within the
  # provided ``memory-region``. The application only needs to populate the raw
  # input frame at ``frame-raw-offset``; the JPEG output region is placed after
  # the raw input region.

  csi-id:
    type: int
    default: 0
    description: LP sense CSI receiver instance id.

  csi-timing:
    type: int
    default: 0
    description: LP sense CSI timing selector.

  csi-interface:
    type: int
    default: 1
    description: LP sense CSI interface selector.

  csi-virt-ch:
    type: int
    default: 0
    description: CSI virtual channel.

  csi-auto-flush:
    type: int
    default: 1
    description: LP sense CSI auto flush enable.

child-binding:
  child-binding:
    description: |
      Video interface ``port/endpoint`` child nodes.
      The endpoint ``data-lanes`` value is used as ``csi_lanes`` by the
      driver in mode 0.
    include: [video-interfaces.yaml]
```

## dts/bindings/video/syna,mipi-video.yaml
```yaml
# Copyright (c) 2026 Synaptics Incorporated
# SPDX-License-Identifier: Apache-2.0

description: Synaptics MIPI Video Driver

compatible: "syna,mipi-video"

include: [base.yaml]

child-binding:
  child-binding:
    description: Video interface port/endpoint nodes
    include: [video-interfaces.yaml]

properties:
  clocks:
    required: true
    description: Clock controller phandle used for ImgProc clock gating.

  num-lanes:
    type: int
    description: Number of CSI-2 data lanes used by this MIPI input.

  interface-width:
    type: int
    default: 0
    description: Internal IPI interface width, 0 for 48-bit and 1 for 16-bit.

  memory-region:
    type: phandle
    required: false
    description: |
      Optional reserved memory region used as the DMA destination pool for
      CSI/MIPI captures. Preferred over raw shm_pool_addr/size.

  shm_pool_addr:
    type: int
    required: false
    deprecated: true
    description: |
      Start address of the shared memory pool for frames.
      Deprecated; use memory-region instead.

  shm_pool_size:
    type: int
    required: false
    deprecated: true
    description: |
      Size of the shared memory pool.
      Deprecated; use memory-region instead.

  datapath:
    type: int
    required: false
    description: Hardware datapath selection.
    enum:
      - 1   # CSIHOST0RX_TO_MEM
```

## dts/bindings/watchdog/arm,apb-wtd.yaml
```yaml
# Copyright (c) 2025 Synaptics Incorporated
# SPDX-License-Identifier: Apache-2.0

description: ARM APB Watchdog

compatible: "arm,apb-wdt"

include: base.yaml

properties:
  reg:
    required: true

  clock-frequency:
    type: int
    required: true
```

## dts/bindings/watchdog/arm,cmsdk-syna-watchdog.yaml
```yaml
# Copyright (c) 2026 Synaptics Incorporated
# SPDX-License-Identifier: Apache-2.0

description: ARM CMSDK watchdog

compatible: "arm,cmsdk-syna-watchdog"

include: base.yaml

properties:
  reg:
    required: true
  
  clocks:
    required: true

  flight_control:
    type: phandle
    required: true

  interrupts:
    required: true

  fault_num:
    type: int
    required: true
```

## dts/bindings/watchdog/arm,corstone-watchdog.yaml
```yaml
# Copyright (c) 2026 Synaptics Incorporated
# SPDX-License-Identifier: Apache-2.0

description: ARM CMSDK watchdog

compatible: "arm,corstone-watchdog"

include: base.yaml

properties:
  reg:
    required: true

  system_counter:
    type: phandle
    required: true

  flight_control:
    type: phandle
    required: true

  interrupts:
    required: true

  fault_num:
    type: int
    required: true
```

## dts/bindings/watchdog/syna,watchdog.yaml
```yaml
# Copyright (c) 2025 Synaptics Incorporated
# SPDX-License-Identifier: Apache-2.0

description: Synaptics Watchdog

compatible: "syna,watchdog"

include: base.yaml

properties:
  reg:
    required: true

  clock-frequency:
    type: int
    required: true

  interrupts:
    required: true
```

## samples/bluetooth/bap_broadcast_source/Kconfig
```kconfig
# Copyright (c) 2023 Nordic Semiconductor ASA
# Copyright (c) 2026 Synaptics Incorporated
#
# SPDX-License-Identifier: Apache-2.0

mainmenu "Bluetooth: BAP Broadcast Source (SR110 RDK)"

choice BAP_LC3_PRESET
	prompt "The BAP LC3 Preset to be used"
	default BAP_BROADCAST_16_2_1

config BAP_BROADCAST_16_2_1
	bool "BAP_LC3_BROADCAST_PRESET_16_2_1 preset"

config BAP_BROADCAST_24_2_1
	bool "BAP_LC3_BROADCAST_PRESET_24_2_1 preset"

config BAP_BROADCAST_48_2_1
	bool "BAP_LC3_BROADCAST_PRESET_48_2_1 preset"

endchoice

config ENABLE_LC3
	bool "Enable the LC3 codec"
	default n  # LC3 not available on SR110

config ISO_PACKING_INTERLEAVED
	bool "Use interleaved packing"
	default n

config USE_USB_AUDIO_INPUT
	bool "Use USB Audio as input"
	default n  # No USB on SR110

config BROADCAST_CODE
	string "Broadcast code for encrypted broadcast (empty = unencrypted)"
	default ""

config STATIC_BROADCAST_ID
	bool "Use static broadcast ID"
	default y

config BROADCAST_ID
	hex "Static broadcast ID"
	range 0x000000 0xFFFFFF
	depends on STATIC_BROADCAST_ID
	default 0x123456

config BROADCAST_NAME
	string "Bluetooth broadcast name"
	default BT_DEVICE_NAME

source "Kconfig.zephyr"
```
