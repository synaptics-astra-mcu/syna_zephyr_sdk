## samples/bluetooth/bap_unicast_server/Kconfig
```kconfig
# Copyright (c) 2025 Nordic Semiconductor ASA
# Copyright (c) 2026 Synaptics Incorporated
#
# SPDX-License-Identifier: Apache-2.0

mainmenu "Bluetooth: BAP Unicast Server (SR110 RDK)"

config INFO_REPORTING_INTERVAL
	int "Number of SDUs received between each information report"
	default 1000
	help
	  Determines how often information about received data is logged.
	  Set to 0 to disable reporting.

source "Kconfig.zephyr"
```

## samples/bluetooth/bt_shell_fw_uart_dual_acm/Kconfig
```kconfig
mainmenu "BT shell + FW UART dual ACM sample"

source "Kconfig.zephyr"
source "samples/subsys/usb/common/Kconfig.sample_usbd"

menu "BT shell + FW UART dual ACM sample"

config FW_UART_LOG_LEVEL
	int "FW UART log level"
	range 0 4
	default 0

endmenu
```
